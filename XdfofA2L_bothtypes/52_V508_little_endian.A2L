/* === Source: MSS52_M1.ROX === */
/* === Config: MSS_ROX.CFG === */
/* === Created: via ROX2ASAP V0.32á === */
/begin MODULE 52_V508.A2L "52_V508.A2L"
/* Dies ist ein Kommentar fuer die A2L-Datei. */
/* Hier kann z.B. projektbezogene Information fuer die A2L-Datei */
/* bereitgestellt werden. */
/begin MOD_COMMON "BMSCOMMON" /* Definition der Standard-Byteorder */ BYTE_ORDER LITTLE_ENDIAN /* Motorola byte order */ /end MOD_COMMON
/begin CHARACTERISTIC KL_FZ_RADIUS_LRW "-" CURVE 0x1B3E VALUE_KL_FZ_RADIUS_LRW 100.000000 F00002 0.000000 6553.000000
 /begin AXIS_DESCR /* can_lws_u */ COM_AXIS can_lws_u F00001 10 0.000000 1433.000000 AXIS_PTS_REF KL_FZ_RADIUS_LRW_can_lws_u_AXIS /end AXIS_DESCR
 FUNCTION_LIST AQUER /end CHARACTERISTIC
/begin RECORD_LAYOUT VALUE_KL_FZ_RADIUS_LRW FNC_VALUES 0 UWORD ROW_DIR DIRECT /end RECORD_LAYOUT
/begin AXIS_PTS KL_FZ_RADIUS_LRW_can_lws_u_AXIS "-" 0x1B2A can_lws_u KL_FZ_RADIUS_LRW_can_lws_u_AXIS 100.000000 F00001 10 0.000000 1433.000000 /end AXIS_PTS
/begin RECORD_LAYOUT KL_FZ_RADIUS_LRW_can_lws_u_AXIS FIX_NO_AXIS_PTS_X 10 AXIS_PTS_X 0 UWORD INDEX_INCR DIRECT /end RECORD_LAYOUT
/begin CHARACTERISTIC KL_A_QUER_V_KORR "-" CURVE 0x1B58 VALUE_KL_A_QUER_V_KORR 100.000000 F00003 0.000000 3.000000
 /begin AXIS_DESCR COM_AXIS v F00004 4 0.000000 255.000000 AXIS_PTS_REF KL_A_QUER_V_KORR_v_AXIS /end AXIS_DESCR
 FUNCTION_LIST AQUER /end CHARACTERISTIC
/begin RECORD_LAYOUT VALUE_KL_A_QUER_V_KORR FNC_VALUES 0 UBYTE ROW_DIR DIRECT /end RECORD_LAYOUT
/begin AXIS_PTS KL_A_QUER_V_KORR_v_AXIS "-" 0x1B54 v KL_A_QUER_V_KORR_v_AXIS 100.000000 F00004 4 0.000000 255.000000 /end AXIS_PTS
/begin RECORD_LAYOUT KL_A_QUER_V_KORR_v_AXIS FIX_NO_AXIS_PTS_X 4 AXIS_PTS_X 0 UBYTE INDEX_INCR DIRECT /end RECORD_LAYOUT
/begin CHARACTERISTIC KL_DYN_TRIGGER_KR "-" CURVE 0x369C VALUE_KL_DYN_TRIGGER_KR 100.000000 F00044 -2.000000 2.000000
 /begin AXIS_DESCR COM_AXIS n F00007 10 0.000000 10000.000000 AXIS_PTS_REF KL_DYN_TRIGGER_KR_n_AXIS /end AXIS_DESCR
 FUNCTION_LIST Dynamik /end CHARACTERISTIC
/begin RECORD_LAYOUT VALUE_KL_DYN_TRIGGER_KR FNC_VALUES 0 SWORD ROW_DIR DIRECT /end RECORD_LAYOUT
/begin AXIS_PTS KL_DYN_TRIGGER_KR_n_AXIS "-" 0x3688 n KL_DYN_TRIGGER_KR_n_AXIS 100.000000 F00007 10 0.000000 10000.000000 /end AXIS_PTS
/begin RECORD_LAYOUT KL_DYN_TRIGGER_KR_n_AXIS FIX_NO_AXIS_PTS_X 10 AXIS_PTS_X 0 UWORD INDEX_INCR DIRECT /end RECORD_LAYOUT
/begin CHARACTERISTIC KL_DYN_TRIGGER_DBGR "-" CURVE 0x36BA VALUE_KL_DYN_TRIGGER_DBGR 100.000000 F00044 -2.000000 2.000000
 /begin AXIS_DESCR COM_AXIS n F00007 4 0.000000 10000.000000 AXIS_PTS_REF KL_DYN_TRIGGER_DBGR_n_AXIS /end AXIS_DESCR
 FUNCTION_LIST Dynamik /end CHARACTERISTIC
/begin RECORD_LAYOUT VALUE_KL_DYN_TRIGGER_DBGR FNC_VALUES 0 SWORD ROW_DIR DIRECT /end RECORD_LAYOUT
/begin AXIS_PTS KL_DYN_TRIGGER_DBGR_n_AXIS "-" 0x36B2 n KL_DYN_TRIGGER_DBGR_n_AXIS 100.000000 F00007 4 0.000000 10000.000000 /end AXIS_PTS
/begin RECORD_LAYOUT KL_DYN_TRIGGER_DBGR_n_AXIS FIX_NO_AXIS_PTS_X 4 AXIS_PTS_X 0 UWORD INDEX_INCR DIRECT /end RECORD_LAYOUT
/begin CHARACTERISTIC KL_DYN_TZ_KR "-" CURVE 0x36CE VALUE_KL_DYN_TZ_KR 100.000000 F00045 -50.000000 0.000000
 /begin AXIS_DESCR COM_AXIS tan F00014 5 -48.000000 207.000000 AXIS_PTS_REF KL_DYN_TZ_KR_tan_AXIS /end AXIS_DESCR
 FUNCTION_LIST Dynamik /end CHARACTERISTIC
/begin RECORD_LAYOUT VALUE_KL_DYN_TZ_KR FNC_VALUES 0 SWORD ROW_DIR DIRECT /end RECORD_LAYOUT
/begin AXIS_PTS KL_DYN_TZ_KR_tan_AXIS "-" 0x36C4 tan KL_DYN_TZ_KR_tan_AXIS 100.000000 F00014 5 -48.000000 207.000000 /end AXIS_PTS
/begin RECORD_LAYOUT KL_DYN_TZ_KR_tan_AXIS FIX_NO_AXIS_PTS_X 5 AXIS_PTS_X 0 UWORD INDEX_INCR DIRECT /end RECORD_LAYOUT
/begin CHARACTERISTIC KL_DYN_TZ_DBGR "-" CURVE 0x36EE VALUE_KL_DYN_TZ_DBGR 100.000000 F00045 -50.000000 0.000000
 /begin AXIS_DESCR COM_AXIS n F00007 10 0.000000 10000.000000 AXIS_PTS_REF KL_DYN_TZ_DBGR_n_AXIS /end AXIS_DESCR
 FUNCTION_LIST Dynamik /end CHARACTERISTIC
/begin RECORD_LAYOUT VALUE_KL_DYN_TZ_DBGR FNC_VALUES 0 SWORD ROW_DIR DIRECT /end RECORD_LAYOUT
/begin AXIS_PTS KL_DYN_TZ_DBGR_n_AXIS "-" 0x36DA n KL_DYN_TZ_DBGR_n_AXIS 100.000000 F00007 10 0.000000 10000.000000 /end AXIS_PTS
/begin RECORD_LAYOUT KL_DYN_TZ_DBGR_n_AXIS FIX_NO_AXIS_PTS_X 10 AXIS_PTS_X 0 UWORD INDEX_INCR DIRECT /end RECORD_LAYOUT
/begin CHARACTERISTIC KL_DYN_BA_DPWG_SP "-" CURVE 0x370E VALUE_KL_DYN_BA_DPWG_SP 100.000000 F00042 -12.000000 12.000000
 /begin AXIS_DESCR COM_AXIS gang F00013 8 0.000000 10.000000 AXIS_PTS_REF KL_DYN_BA_DPWG_SP_gang_AXIS /end AXIS_DESCR
 FUNCTION_LIST Dynamik /end CHARACTERISTIC
/begin RECORD_LAYOUT VALUE_KL_DYN_BA_DPWG_SP FNC_VALUES 0 SBYTE ROW_DIR DIRECT /end RECORD_LAYOUT
/begin AXIS_PTS KL_DYN_BA_DPWG_SP_gang_AXIS "-" 0x3706 gang KL_DYN_BA_DPWG_SP_gang_AXIS 100.000000 F00013 8 0.000000 10.000000 /end AXIS_PTS
/begin RECORD_LAYOUT KL_DYN_BA_DPWG_SP_gang_AXIS FIX_NO_AXIS_PTS_X 8 AXIS_PTS_X 0 UBYTE INDEX_INCR DIRECT /end RECORD_LAYOUT
/begin CHARACTERISTIC KL_DYN_BA_PWG_SP "-" CURVE 0x3720 VALUE_KL_DYN_BA_PWG_SP 100.000000 F00046 0.000000 102.000000
 /begin AXIS_DESCR COM_AXIS gang F00013 8 0.000000 10.000000 AXIS_PTS_REF KL_DYN_BA_PWG_SP_gang_AXIS /end AXIS_DESCR
 FUNCTION_LIST Dynamik /end CHARACTERISTIC
/begin RECORD_LAYOUT VALUE_KL_DYN_BA_PWG_SP FNC_VALUES 0 UBYTE ROW_DIR DIRECT /end RECORD_LAYOUT
/begin AXIS_PTS KL_DYN_BA_PWG_SP_gang_AXIS "-" 0x3718 gang KL_DYN_BA_PWG_SP_gang_AXIS 100.000000 F00013 8 0.000000 10.000000 /end AXIS_PTS
/begin RECORD_LAYOUT KL_DYN_BA_PWG_SP_gang_AXIS FIX_NO_AXIS_PTS_X 8 AXIS_PTS_X 0 UBYTE INDEX_INCR DIRECT /end RECORD_LAYOUT
/begin CHARACTERISTIC KL_DYN_BA_DPWG_KOMF "-" CURVE 0x3732 VALUE_KL_DYN_BA_DPWG_KOMF 100.000000 F00042 -12.000000 12.000000
 /begin AXIS_DESCR COM_AXIS gang F00013 8 0.000000 10.000000 AXIS_PTS_REF KL_DYN_BA_DPWG_KOMF_gang_AXIS /end AXIS_DESCR
 FUNCTION_LIST Dynamik /end CHARACTERISTIC
/begin RECORD_LAYOUT VALUE_KL_DYN_BA_DPWG_KOMF FNC_VALUES 0 SBYTE ROW_DIR DIRECT /end RECORD_LAYOUT
/begin AXIS_PTS KL_DYN_BA_DPWG_KOMF_gang_AXIS "-" 0x372A gang KL_DYN_BA_DPWG_KOMF_gang_AXIS 100.000000 F00013 8 0.000000 10.000000 /end AXIS_PTS
/begin RECORD_LAYOUT KL_DYN_BA_DPWG_KOMF_gang_AXIS FIX_NO_AXIS_PTS_X 8 AXIS_PTS_X 0 UBYTE INDEX_INCR DIRECT /end RECORD_LAYOUT
/begin CHARACTERISTIC KL_DYN_BA_PWG_KOMF "-" CURVE 0x3744 VALUE_KL_DYN_BA_PWG_KOMF 100.000000 F00046 0.000000 102.000000
 /begin AXIS_DESCR COM_AXIS gang F00013 8 0.000000 10.000000 AXIS_PTS_REF KL_DYN_BA_PWG_KOMF_gang_AXIS /end AXIS_DESCR
 FUNCTION_LIST Dynamik /end CHARACTERISTIC
/begin RECORD_LAYOUT VALUE_KL_DYN_BA_PWG_KOMF FNC_VALUES 0 UBYTE ROW_DIR DIRECT /end RECORD_LAYOUT
/begin AXIS_PTS KL_DYN_BA_PWG_KOMF_gang_AXIS "-" 0x373C gang KL_DYN_BA_PWG_KOMF_gang_AXIS 100.000000 F00013 8 0.000000 10.000000 /end AXIS_PTS
/begin RECORD_LAYOUT KL_DYN_BA_PWG_KOMF_gang_AXIS FIX_NO_AXIS_PTS_X 8 AXIS_PTS_X 0 UBYTE INDEX_INCR DIRECT /end RECORD_LAYOUT
/begin CHARACTERISTIC KL_DYN_SA_DPWG_SP "-" CURVE 0x3758 VALUE_KL_DYN_SA_DPWG_SP 100.000000 F00042 -12.000000 12.000000
 /begin AXIS_DESCR COM_AXIS gang F00013 8 0.000000 10.000000 AXIS_PTS_REF KL_DYN_SA_DPWG_SP_gang_AXIS /end AXIS_DESCR
 FUNCTION_LIST Dynamik /end CHARACTERISTIC
/begin RECORD_LAYOUT VALUE_KL_DYN_SA_DPWG_SP FNC_VALUES 0 SBYTE ROW_DIR DIRECT /end RECORD_LAYOUT
/begin AXIS_PTS KL_DYN_SA_DPWG_SP_gang_AXIS "-" 0x3750 gang KL_DYN_SA_DPWG_SP_gang_AXIS 100.000000 F00013 8 0.000000 10.000000 /end AXIS_PTS
/begin RECORD_LAYOUT KL_DYN_SA_DPWG_SP_gang_AXIS FIX_NO_AXIS_PTS_X 8 AXIS_PTS_X 0 UBYTE INDEX_INCR DIRECT /end RECORD_LAYOUT
/begin CHARACTERISTIC KL_DYN_SA_DPWG_KOMF "-" CURVE 0x376A VALUE_KL_DYN_SA_DPWG_KOMF 100.000000 F00042 -12.000000 12.000000
 /begin AXIS_DESCR COM_AXIS gang F00013 8 0.000000 10.000000 AXIS_PTS_REF KL_DYN_SA_DPWG_KOMF_gang_AXIS /end AXIS_DESCR
 FUNCTION_LIST Dynamik /end CHARACTERISTIC
/begin RECORD_LAYOUT VALUE_KL_DYN_SA_DPWG_KOMF FNC_VALUES 0 SBYTE ROW_DIR DIRECT /end RECORD_LAYOUT
/begin AXIS_PTS KL_DYN_SA_DPWG_KOMF_gang_AXIS "-" 0x3762 gang KL_DYN_SA_DPWG_KOMF_gang_AXIS 100.000000 F00013 8 0.000000 10.000000 /end AXIS_PTS
/begin RECORD_LAYOUT KL_DYN_SA_DPWG_KOMF_gang_AXIS FIX_NO_AXIS_PTS_X 8 AXIS_PTS_X 0 UBYTE INDEX_INCR DIRECT /end RECORD_LAYOUT
/begin CHARACTERISTIC KL_EDK_VORST "-" CURVE 0x92 VALUE_KL_EDK_VORST 100.000000 F00055 0.000000 100.000000
 /begin AXIS_DESCR /* edk_soll */ COM_AXIS edk_soll F00048 10 0.000000 100.000000 AXIS_PTS_REF KL_EDK_VORST_edk_soll_AXIS /end AXIS_DESCR
 FUNCTION_LIST EDK /end CHARACTERISTIC
/begin RECORD_LAYOUT VALUE_KL_EDK_VORST FNC_VALUES 0 UWORD ROW_DIR DIRECT /end RECORD_LAYOUT
/begin AXIS_PTS KL_EDK_VORST_edk_soll_AXIS "-" 0x7E edk_soll KL_EDK_VORST_edk_soll_AXIS 100.000000 F00048 10 0.000000 100.000000 /end AXIS_PTS
/begin RECORD_LAYOUT KL_EDK_VORST_edk_soll_AXIS FIX_NO_AXIS_PTS_X 10 AXIS_PTS_X 0 UWORD INDEX_INCR DIRECT /end RECORD_LAYOUT
/begin CHARACTERISTIC KL_EDK_KORR_U "-" CURVE 0xAE VALUE_KL_EDK_KORR_U 100.000000 F00056 0.000000 1.000000
 /begin AXIS_DESCR COM_AXIS ub F00018 6 0.000000 20.000000 AXIS_PTS_REF KL_EDK_KORR_U_ub_AXIS /end AXIS_DESCR
 FUNCTION_LIST EDK /end CHARACTERISTIC
/begin RECORD_LAYOUT VALUE_KL_EDK_KORR_U FNC_VALUES 0 UBYTE ROW_DIR DIRECT /end RECORD_LAYOUT
/begin AXIS_PTS KL_EDK_KORR_U_ub_AXIS "-" 0xA8 ub KL_EDK_KORR_U_ub_AXIS 100.000000 F00018 6 0.000000 20.000000 /end AXIS_PTS
/begin RECORD_LAYOUT KL_EDK_KORR_U_ub_AXIS FIX_NO_AXIS_PTS_X 6 AXIS_PTS_X 0 UBYTE INDEX_INCR DIRECT /end RECORD_LAYOUT
/begin CHARACTERISTIC KL_EDK_PPOS "-" CURVE 0xC2 VALUE_KL_EDK_PPOS 100.000000 F00055 0.000000 100.000000
 /begin AXIS_DESCR COM_AXIS edk_delta F00048 6 0.000000 100.000000 AXIS_PTS_REF KL_EDK_PPOS_edk_delta_AXIS /end AXIS_DESCR
 FUNCTION_LIST EDK /end CHARACTERISTIC
/begin RECORD_LAYOUT VALUE_KL_EDK_PPOS FNC_VALUES 0 SWORD ROW_DIR DIRECT /end RECORD_LAYOUT
/begin AXIS_PTS KL_EDK_PPOS_edk_delta_AXIS "-" 0xB6 edk_delta KL_EDK_PPOS_edk_delta_AXIS 100.000000 F00048 6 0.000000 100.000000 /end AXIS_PTS
/begin RECORD_LAYOUT KL_EDK_PPOS_edk_delta_AXIS FIX_NO_AXIS_PTS_X 6 AXIS_PTS_X 0 UWORD INDEX_INCR DIRECT /end RECORD_LAYOUT
/begin CHARACTERISTIC KL_EDK_PNEG "-" CURVE 0xDC VALUE_KL_EDK_PNEG 100.000000 F00055 -100.000000 0.000000
 /begin AXIS_DESCR COM_AXIS edk_delta F00048 6 0.000000 100.000000 AXIS_PTS_REF KL_EDK_PNEG_edk_delta_AXIS /end AXIS_DESCR
 FUNCTION_LIST EDK /end CHARACTERISTIC
/begin RECORD_LAYOUT VALUE_KL_EDK_PNEG FNC_VALUES 0 SWORD ROW_DIR DIRECT /end RECORD_LAYOUT
/begin AXIS_PTS KL_EDK_PNEG_edk_delta_AXIS "-" 0xD0 edk_delta KL_EDK_PNEG_edk_delta_AXIS 100.000000 F00048 6 0.000000 100.000000 /end AXIS_PTS
/begin RECORD_LAYOUT KL_EDK_PNEG_edk_delta_AXIS FIX_NO_AXIS_PTS_X 6 AXIS_PTS_X 0 UWORD INDEX_INCR DIRECT /end RECORD_LAYOUT
/begin CHARACTERISTIC KL_EDK_IPOS "-" CURVE 0xF6 VALUE_KL_EDK_IPOS 100.000000 F00051 0.000000 2.000000
 /begin AXIS_DESCR COM_AXIS edk_delta F00048 6 0.000000 100.000000 AXIS_PTS_REF KL_EDK_IPOS_edk_delta_AXIS /end AXIS_DESCR
 FUNCTION_LIST EDK /end CHARACTERISTIC
/begin RECORD_LAYOUT VALUE_KL_EDK_IPOS FNC_VALUES 0 SWORD ROW_DIR DIRECT /end RECORD_LAYOUT
/begin AXIS_PTS KL_EDK_IPOS_edk_delta_AXIS "-" 0xEA edk_delta KL_EDK_IPOS_edk_delta_AXIS 100.000000 F00048 6 0.000000 100.000000 /end AXIS_PTS
/begin RECORD_LAYOUT KL_EDK_IPOS_edk_delta_AXIS FIX_NO_AXIS_PTS_X 6 AXIS_PTS_X 0 UWORD INDEX_INCR DIRECT /end RECORD_LAYOUT
/begin CHARACTERISTIC KL_EDK_INEG "-" CURVE 0x110 VALUE_KL_EDK_INEG 100.000000 F00051 -2.000000 0.000000
 /begin AXIS_DESCR COM_AXIS edk_delta F00048 6 0.000000 100.000000 AXIS_PTS_REF KL_EDK_INEG_edk_delta_AXIS /end AXIS_DESCR
 FUNCTION_LIST EDK /end CHARACTERISTIC
/begin RECORD_LAYOUT VALUE_KL_EDK_INEG FNC_VALUES 0 SWORD ROW_DIR DIRECT /end RECORD_LAYOUT
/begin AXIS_PTS KL_EDK_INEG_edk_delta_AXIS "-" 0x104 edk_delta KL_EDK_INEG_edk_delta_AXIS 100.000000 F00048 6 0.000000 100.000000 /end AXIS_PTS
/begin RECORD_LAYOUT KL_EDK_INEG_edk_delta_AXIS FIX_NO_AXIS_PTS_X 6 AXIS_PTS_X 0 UWORD INDEX_INCR DIRECT /end RECORD_LAYOUT
/begin CHARACTERISTIC KL_EGAS_WDK_ENTDROSS "-" CURVE 0x273E VALUE_KL_EGAS_WDK_ENTDROSS 100.000000 F00048 0.000000 100.000000
 /begin AXIS_DESCR COM_AXIS n F00007 6 0.000000 10000.000000 AXIS_PTS_REF KL_EGAS_WDK_ENTDROSS_n_AXIS /end AXIS_DESCR
 FUNCTION_LIST EGAS /end CHARACTERISTIC
/begin RECORD_LAYOUT VALUE_KL_EGAS_WDK_ENTDROSS FNC_VALUES 0 UWORD ROW_DIR DIRECT /end RECORD_LAYOUT
/begin AXIS_PTS KL_EGAS_WDK_ENTDROSS_n_AXIS "-" 0x2732 n KL_EGAS_WDK_ENTDROSS_n_AXIS 100.000000 F00007 6 0.000000 10000.000000 /end AXIS_PTS
/begin RECORD_LAYOUT KL_EGAS_WDK_ENTDROSS_n_AXIS FIX_NO_AXIS_PTS_X 6 AXIS_PTS_X 0 UWORD INDEX_INCR DIRECT /end RECORD_LAYOUT
/begin CHARACTERISTIC KL_EGAS_WDK_KATH_ENT "-" CURVE 0x2754 VALUE_KL_EGAS_WDK_KATH_ENT 100.000000 F00048 0.000000 100.000000
 /begin AXIS_DESCR COM_AXIS n F00007 4 0.000000 10000.000000 AXIS_PTS_REF KL_EGAS_WDK_KATH_ENT_n_AXIS /end AXIS_DESCR
 FUNCTION_LIST EGAS /end CHARACTERISTIC
/begin RECORD_LAYOUT VALUE_KL_EGAS_WDK_KATH_ENT FNC_VALUES 0 UWORD ROW_DIR DIRECT /end RECORD_LAYOUT
/begin AXIS_PTS KL_EGAS_WDK_KATH_ENT_n_AXIS "-" 0x274C n KL_EGAS_WDK_KATH_ENT_n_AXIS 100.000000 F00007 4 0.000000 10000.000000 /end AXIS_PTS
/begin RECORD_LAYOUT KL_EGAS_WDK_KATH_ENT_n_AXIS FIX_NO_AXIS_PTS_X 4 AXIS_PTS_X 0 UWORD INDEX_INCR DIRECT /end RECORD_LAYOUT
/begin CHARACTERISTIC KF_EGAS_WDK "-" MAP 0x22F2 VALUE_KF_EGAS_WDK 100.000000 F00048 0.000000 300.000000
 /begin AXIS_DESCR COM_AXIS n F00007 14 0.000000 10000.000000 AXIS_PTS_REF KF_EGAS_WDK_n_AXIS /end AXIS_DESCR
 /begin AXIS_DESCR COM_AXIS rf F00060 23 0.000000 2.000000 AXIS_PTS_REF KF_EGAS_WDK_rf_AXIS /end AXIS_DESCR
 FUNCTION_LIST EGAS /end CHARACTERISTIC
/begin RECORD_LAYOUT VALUE_KF_EGAS_WDK FNC_VALUES 0 UWORD ROW_DIR DIRECT /end RECORD_LAYOUT
/begin AXIS_PTS KF_EGAS_WDK_n_AXIS "-" 0x22A8 n KF_EGAS_WDK_n_AXIS 100.000000 F00007 14 0.000000 10000.000000 /end AXIS_PTS
/begin RECORD_LAYOUT KF_EGAS_WDK_n_AXIS FIX_NO_AXIS_PTS_X 14 AXIS_PTS_X 0 UWORD INDEX_INCR DIRECT /end RECORD_LAYOUT
/begin AXIS_PTS KF_EGAS_WDK_rf_AXIS "-" 0x22C4 rf KF_EGAS_WDK_rf_AXIS 100.000000 F00060 23 0.000000 2.000000 /end AXIS_PTS
/begin RECORD_LAYOUT KF_EGAS_WDK_rf_AXIS FIX_NO_AXIS_PTS_Y 23 AXIS_PTS_Y 0 UWORD INDEX_INCR DIRECT /end RECORD_LAYOUT
/begin CHARACTERISTIC KF_EGAS_WDK_KH "-" MAP 0x25B0 VALUE_KF_EGAS_WDK_KH 100.000000 F00048 0.000000 300.000000
 /begin AXIS_DESCR COM_AXIS n F00007 12 0.000000 10000.000000 AXIS_PTS_REF KF_EGAS_WDK_KH_n_AXIS /end AXIS_DESCR
 /begin AXIS_DESCR COM_AXIS rf F00060 16 0.000000 2.000000 AXIS_PTS_REF KF_EGAS_WDK_KH_rf_AXIS /end AXIS_DESCR
 FUNCTION_LIST EGAS /end CHARACTERISTIC
/begin RECORD_LAYOUT VALUE_KF_EGAS_WDK_KH FNC_VALUES 0 UWORD ROW_DIR DIRECT /end RECORD_LAYOUT
/begin AXIS_PTS KF_EGAS_WDK_KH_n_AXIS "-" 0x2578 n KF_EGAS_WDK_KH_n_AXIS 100.000000 F00007 12 0.000000 10000.000000 /end AXIS_PTS
/begin RECORD_LAYOUT KF_EGAS_WDK_KH_n_AXIS FIX_NO_AXIS_PTS_X 12 AXIS_PTS_X 0 UWORD INDEX_INCR DIRECT /end RECORD_LAYOUT
/begin AXIS_PTS KF_EGAS_WDK_KH_rf_AXIS "-" 0x2590 rf KF_EGAS_WDK_KH_rf_AXIS 100.000000 F00060 16 0.000000 2.000000 /end AXIS_PTS
/begin RECORD_LAYOUT KF_EGAS_WDK_KH_rf_AXIS FIX_NO_AXIS_PTS_Y 16 AXIS_PTS_Y 0 UWORD INDEX_INCR DIRECT /end RECORD_LAYOUT
/begin CHARACTERISTIC KF_EGAS_MAX_WDK "-" MAP 0x276E VALUE_KF_EGAS_MAX_WDK 100.000000 F00048 0.000000 100.000000
 /begin AXIS_DESCR COM_AXIS n F00007 4 0.000000 10000.000000 AXIS_PTS_REF KF_EGAS_MAX_WDK_n_AXIS /end AXIS_DESCR
 /begin AXIS_DESCR COM_AXIS tmot F00014 4 -48.000000 207.000000 AXIS_PTS_REF KF_EGAS_MAX_WDK_tmot_AXIS /end AXIS_DESCR
 FUNCTION_LIST EGAS /end CHARACTERISTIC
/begin RECORD_LAYOUT VALUE_KF_EGAS_MAX_WDK FNC_VALUES 0 UWORD ROW_DIR DIRECT /end RECORD_LAYOUT
/begin AXIS_PTS KF_EGAS_MAX_WDK_n_AXIS "-" 0x275E n KF_EGAS_MAX_WDK_n_AXIS 100.000000 F00007 4 0.000000 10000.000000 /end AXIS_PTS
/begin RECORD_LAYOUT KF_EGAS_MAX_WDK_n_AXIS FIX_NO_AXIS_PTS_X 4 AXIS_PTS_X 0 UWORD INDEX_INCR DIRECT /end RECORD_LAYOUT
/begin AXIS_PTS KF_EGAS_MAX_WDK_tmot_AXIS "-" 0x2766 tmot KF_EGAS_MAX_WDK_tmot_AXIS 100.000000 F00014 4 -48.000000 207.000000 /end AXIS_PTS
/begin RECORD_LAYOUT KF_EGAS_MAX_WDK_tmot_AXIS FIX_NO_AXIS_PTS_Y 4 AXIS_PTS_Y 0 UWORD INDEX_INCR DIRECT /end RECORD_LAYOUT
/begin CHARACTERISTIC KL_FR_IPOS "-" CURVE 0x379A VALUE_KL_FR_IPOS 100.000000 F00070 0.000000 0.000000
 /begin AXIS_DESCR /* fr_rf_delta */ COM_AXIS fr_rf_delta F00060 8 0.000000 0.000000 AXIS_PTS_REF KL_FR_IPOS_fr_rf_delta_AXIS /end AXIS_DESCR
 FUNCTION_LIST FUELLUNGSREGLER /end CHARACTERISTIC
/begin RECORD_LAYOUT VALUE_KL_FR_IPOS FNC_VALUES 0 SWORD ROW_DIR DIRECT /end RECORD_LAYOUT
/begin AXIS_PTS KL_FR_IPOS_fr_rf_delta_AXIS "-" 0x378A fr_rf_delta KL_FR_IPOS_fr_rf_delta_AXIS 100.000000 F00060 8 0.000000 0.000000 /end AXIS_PTS
/begin RECORD_LAYOUT KL_FR_IPOS_fr_rf_delta_AXIS FIX_NO_AXIS_PTS_X 8 AXIS_PTS_X 0 UWORD INDEX_INCR DIRECT /end RECORD_LAYOUT
/begin CHARACTERISTIC KL_FR_INEG "-" CURVE 0x37BC VALUE_KL_FR_INEG 100.000000 F00070 0.000000 0.000000
 /begin AXIS_DESCR /* fr_rf_delta */ COM_AXIS fr_rf_delta F00060 8 0.000000 0.000000 AXIS_PTS_REF KL_FR_INEG_fr_rf_delta_AXIS /end AXIS_DESCR
 FUNCTION_LIST FUELLUNGSREGLER /end CHARACTERISTIC
/begin RECORD_LAYOUT VALUE_KL_FR_INEG FNC_VALUES 0 SWORD ROW_DIR DIRECT /end RECORD_LAYOUT
/begin AXIS_PTS KL_FR_INEG_fr_rf_delta_AXIS "-" 0x37AC fr_rf_delta KL_FR_INEG_fr_rf_delta_AXIS 100.000000 F00060 8 0.000000 0.000000 /end AXIS_PTS
/begin RECORD_LAYOUT KL_FR_INEG_fr_rf_delta_AXIS FIX_NO_AXIS_PTS_X 8 AXIS_PTS_X 0 UWORD INDEX_INCR DIRECT /end RECORD_LAYOUT
/begin CHARACTERISTIC KL_FGR_KIR "-" CURVE 0x2E4 VALUE_KL_FGR_KIR 100.000000 F00089 -40.000000 40.000000
 /begin AXIS_DESCR /* fgr_vdelta */ COM_AXIS fgr_vdelta F00090 16 -2048.000000 2047.000000 AXIS_PTS_REF KL_FGR_KIR_fgr_vdelta_AXIS /end AXIS_DESCR
 FUNCTION_LIST FGR /end CHARACTERISTIC
/begin RECORD_LAYOUT VALUE_KL_FGR_KIR FNC_VALUES 0 SWORD ROW_DIR DIRECT /end RECORD_LAYOUT
/begin AXIS_PTS KL_FGR_KIR_fgr_vdelta_AXIS "-" 0x2C4 fgr_vdelta KL_FGR_KIR_fgr_vdelta_AXIS 100.000000 F00090 16 -2048.000000 2047.000000 /end AXIS_PTS
/begin RECORD_LAYOUT KL_FGR_KIR_fgr_vdelta_AXIS FIX_NO_AXIS_PTS_X 16 AXIS_PTS_X 0 UWORD INDEX_INCR DIRECT /end RECORD_LAYOUT
/begin CHARACTERISTIC KL_FGR_KPR "-" CURVE 0x326 VALUE_KL_FGR_KPR 100.000000 F00071 -25.000000 25.000000
 /begin AXIS_DESCR /* fgr_vdelta */ COM_AXIS fgr_vdelta F00090 16 -2048.000000 2047.000000 AXIS_PTS_REF KL_FGR_KPR_fgr_vdelta_AXIS /end AXIS_DESCR
 FUNCTION_LIST FGR /end CHARACTERISTIC
/begin RECORD_LAYOUT VALUE_KL_FGR_KPR FNC_VALUES 0 SWORD ROW_DIR DIRECT /end RECORD_LAYOUT
/begin AXIS_PTS KL_FGR_KPR_fgr_vdelta_AXIS "-" 0x306 fgr_vdelta KL_FGR_KPR_fgr_vdelta_AXIS 100.000000 F00090 16 -2048.000000 2047.000000 /end AXIS_PTS
/begin RECORD_LAYOUT KL_FGR_KPR_fgr_vdelta_AXIS FIX_NO_AXIS_PTS_X 16 AXIS_PTS_X 0 UWORD INDEX_INCR DIRECT /end RECORD_LAYOUT
/begin CHARACTERISTIC KL_FGR_N_ABH "-" CURVE 0x358 VALUE_KL_FGR_N_ABH 100.000000 F00085 0.000000 2.000000
 /begin AXIS_DESCR COM_AXIS n F00007 8 0.000000 10000.000000 AXIS_PTS_REF KL_FGR_N_ABH_n_AXIS /end AXIS_DESCR
 FUNCTION_LIST FGR /end CHARACTERISTIC
/begin RECORD_LAYOUT VALUE_KL_FGR_N_ABH FNC_VALUES 0 UWORD ROW_DIR DIRECT /end RECORD_LAYOUT
/begin AXIS_PTS KL_FGR_N_ABH_n_AXIS "-" 0x348 n KL_FGR_N_ABH_n_AXIS 100.000000 F00007 8 0.000000 10000.000000 /end AXIS_PTS
/begin RECORD_LAYOUT KL_FGR_N_ABH_n_AXIS FIX_NO_AXIS_PTS_X 8 AXIS_PTS_X 0 UWORD INDEX_INCR DIRECT /end RECORD_LAYOUT
/begin CHARACTERISTIC KL_FGR_AQU_V "-" CURVE 0x386 VALUE_KL_FGR_AQU_V 100.000000 F00079 0.000000 15.000000
 /begin AXIS_DESCR COM_AXIS v F00004 8 0.000000 255.000000 AXIS_PTS_REF KL_FGR_AQU_V_v_AXIS /end AXIS_DESCR
 FUNCTION_LIST FGR /end CHARACTERISTIC
/begin RECORD_LAYOUT VALUE_KL_FGR_AQU_V FNC_VALUES 0 UBYTE ROW_DIR DIRECT /end RECORD_LAYOUT
/begin AXIS_PTS KL_FGR_AQU_V_v_AXIS "-" 0x37E v KL_FGR_AQU_V_v_AXIS 100.000000 F00004 8 0.000000 255.000000 /end AXIS_PTS
/begin RECORD_LAYOUT KL_FGR_AQU_V_v_AXIS FIX_NO_AXIS_PTS_X 8 AXIS_PTS_X 0 UBYTE INDEX_INCR DIRECT /end RECORD_LAYOUT
/begin CHARACTERISTIC KL_HFM_ML_U "-" CURVE 0x2090 VALUE_KL_HFM_ML_U 100.000000 F00095 -50.000000 1400.000000
 /begin AXIS_DESCR /* HFM-SPANNUNG */ COM_AXIS HFM-SPANNUNG F00103 33 0.000000 320.000000 AXIS_PTS_REF KL_HFM_ML_U_HFM-SPANNUNG_AXIS /end AXIS_DESCR
 FUNCTION_LIST Lasterfassung /end CHARACTERISTIC
/begin RECORD_LAYOUT VALUE_KL_HFM_ML_U FNC_VALUES 0 SWORD ROW_DIR DIRECT /end RECORD_LAYOUT
/begin AXIS_PTS KL_HFM_ML_U_HFM-SPANNUNG_AXIS "-" 0x204E HFM-SPANNUNG KL_HFM_ML_U_HFM-SPANNUNG_AXIS 100.000000 F00103 33 0.000000 320.000000 /end AXIS_PTS
/begin RECORD_LAYOUT KL_HFM_ML_U_HFM-SPANNUNG_AXIS FIX_NO_AXIS_PTS_X 33 AXIS_PTS_X 0 UWORD INDEX_INCR DIRECT /end RECORD_LAYOUT
/begin CHARACTERISTIC KL_HFM_RF_F_LL_VLOW "-" CURVE 0x20E4 VALUE_KL_HFM_RF_F_LL_VLOW 100.000000 F00097 0.000000 2.000000
 /begin AXIS_DESCR COM_AXIS n F00007 8 0.000000 10000.000000 AXIS_PTS_REF KL_HFM_RF_F_LL_VLOW_n_AXIS /end AXIS_DESCR
 FUNCTION_LIST Lasterfassung /end CHARACTERISTIC
/begin RECORD_LAYOUT VALUE_KL_HFM_RF_F_LL_VLOW FNC_VALUES 0 UWORD ROW_DIR DIRECT /end RECORD_LAYOUT
/begin AXIS_PTS KL_HFM_RF_F_LL_VLOW_n_AXIS "-" 0x20D4 n KL_HFM_RF_F_LL_VLOW_n_AXIS 100.000000 F00007 8 0.000000 10000.000000 /end AXIS_PTS
/begin RECORD_LAYOUT KL_HFM_RF_F_LL_VLOW_n_AXIS FIX_NO_AXIS_PTS_X 8 AXIS_PTS_X 0 UWORD INDEX_INCR DIRECT /end RECORD_LAYOUT
/begin CHARACTERISTIC KL_HFM_RF_F_LL_VHIGH "-" CURVE 0x2106 VALUE_KL_HFM_RF_F_LL_VHIGH 100.000000 F00097 0.000000 2.000000
 /begin AXIS_DESCR COM_AXIS n F00007 8 0.000000 10000.000000 AXIS_PTS_REF KL_HFM_RF_F_LL_VHIGH_n_AXIS /end AXIS_DESCR
 FUNCTION_LIST Lasterfassung /end CHARACTERISTIC
/begin RECORD_LAYOUT VALUE_KL_HFM_RF_F_LL_VHIGH FNC_VALUES 0 UWORD ROW_DIR DIRECT /end RECORD_LAYOUT
/begin AXIS_PTS KL_HFM_RF_F_LL_VHIGH_n_AXIS "-" 0x20F6 n KL_HFM_RF_F_LL_VHIGH_n_AXIS 100.000000 F00007 8 0.000000 10000.000000 /end AXIS_PTS
/begin RECORD_LAYOUT KL_HFM_RF_F_LL_VHIGH_n_AXIS FIX_NO_AXIS_PTS_X 8 AXIS_PTS_X 0 UWORD INDEX_INCR DIRECT /end RECORD_LAYOUT
/begin CHARACTERISTIC KL_RF_TAN_KORR "-" CURVE 0x2120 VALUE_KL_RF_TAN_KORR 100.000000 F00056 0.000000 1.000000
 /begin AXIS_DESCR COM_AXIS tan F00014 8 -48.000000 207.000000 AXIS_PTS_REF KL_RF_TAN_KORR_tan_AXIS /end AXIS_DESCR
 FUNCTION_LIST Lasterfassung /end CHARACTERISTIC
/begin RECORD_LAYOUT VALUE_KL_RF_TAN_KORR FNC_VALUES 0 UBYTE ROW_DIR DIRECT /end RECORD_LAYOUT
/begin AXIS_PTS KL_RF_TAN_KORR_tan_AXIS "-" 0x2118 tan KL_RF_TAN_KORR_tan_AXIS 100.000000 F00014 8 -48.000000 207.000000 /end AXIS_PTS
/begin RECORD_LAYOUT KL_RF_TAN_KORR_tan_AXIS FIX_NO_AXIS_PTS_X 8 AXIS_PTS_X 0 UBYTE INDEX_INCR DIRECT /end RECORD_LAYOUT
/begin CHARACTERISTIC KL_RF_P_UMG_KORR "-" CURVE 0x2132 VALUE_KL_RF_P_UMG_KORR 100.000000 F00056 0.000000 1.000000
 /begin AXIS_DESCR COM_AXIS p_umg F00104 8 500.000000 1150.000000 AXIS_PTS_REF KL_RF_P_UMG_KORR_p_umg_AXIS /end AXIS_DESCR
 FUNCTION_LIST Lasterfassung /end CHARACTERISTIC
/begin RECORD_LAYOUT VALUE_KL_RF_P_UMG_KORR FNC_VALUES 0 UBYTE ROW_DIR DIRECT /end RECORD_LAYOUT
/begin AXIS_PTS KL_RF_P_UMG_KORR_p_umg_AXIS "-" 0x212A p_umg KL_RF_P_UMG_KORR_p_umg_AXIS 100.000000 F00104 8 500.000000 1150.000000 /end AXIS_PTS
/begin RECORD_LAYOUT KL_RF_P_UMG_KORR_p_umg_AXIS FIX_NO_AXIS_PTS_X 8 AXIS_PTS_X 0 UBYTE INDEX_INCR DIRECT /end RECORD_LAYOUT
/begin CHARACTERISTIC KF_HFM_RF_F_UP "-" MAP 0x2154 VALUE_KF_HFM_RF_F_UP 100.000000 F00097 0.000000 2.000000
 /begin AXIS_DESCR COM_AXIS n F00007 6 0.000000 10000.000000 AXIS_PTS_REF KF_HFM_RF_F_UP_n_AXIS /end AXIS_DESCR
 /begin AXIS_DESCR COM_AXIS rf F00068 6 0.000000 2.000000 AXIS_PTS_REF KF_HFM_RF_F_UP_rf_AXIS /end AXIS_DESCR
 FUNCTION_LIST Lasterfassung /end CHARACTERISTIC
/begin RECORD_LAYOUT VALUE_KF_HFM_RF_F_UP FNC_VALUES 0 UWORD ROW_DIR DIRECT /end RECORD_LAYOUT
/begin AXIS_PTS KF_HFM_RF_F_UP_n_AXIS "-" 0x213C n KF_HFM_RF_F_UP_n_AXIS 100.000000 F00007 6 0.000000 10000.000000 /end AXIS_PTS
/begin RECORD_LAYOUT KF_HFM_RF_F_UP_n_AXIS FIX_NO_AXIS_PTS_X 6 AXIS_PTS_X 0 UWORD INDEX_INCR DIRECT /end RECORD_LAYOUT
/begin AXIS_PTS KF_HFM_RF_F_UP_rf_AXIS "-" 0x2148 rf KF_HFM_RF_F_UP_rf_AXIS 100.000000 F00068 6 0.000000 2.000000 /end AXIS_PTS
/begin RECORD_LAYOUT KF_HFM_RF_F_UP_rf_AXIS FIX_NO_AXIS_PTS_Y 6 AXIS_PTS_Y 0 UWORD INDEX_INCR DIRECT /end RECORD_LAYOUT
/begin CHARACTERISTIC KF_HFM_RF_F_DOWN "-" MAP 0x21B6 VALUE_KF_HFM_RF_F_DOWN 100.000000 F00097 0.000000 2.000000
 /begin AXIS_DESCR COM_AXIS n F00007 6 0.000000 10000.000000 AXIS_PTS_REF KF_HFM_RF_F_DOWN_n_AXIS /end AXIS_DESCR
 /begin AXIS_DESCR COM_AXIS rf F00068 6 0.000000 2.000000 AXIS_PTS_REF KF_HFM_RF_F_DOWN_rf_AXIS /end AXIS_DESCR
 FUNCTION_LIST Lasterfassung /end CHARACTERISTIC
/begin RECORD_LAYOUT VALUE_KF_HFM_RF_F_DOWN FNC_VALUES 0 UWORD ROW_DIR DIRECT /end RECORD_LAYOUT
/begin AXIS_PTS KF_HFM_RF_F_DOWN_n_AXIS "-" 0x219E n KF_HFM_RF_F_DOWN_n_AXIS 100.000000 F00007 6 0.000000 10000.000000 /end AXIS_PTS
/begin RECORD_LAYOUT KF_HFM_RF_F_DOWN_n_AXIS FIX_NO_AXIS_PTS_X 6 AXIS_PTS_X 0 UWORD INDEX_INCR DIRECT /end RECORD_LAYOUT
/begin AXIS_PTS KF_HFM_RF_F_DOWN_rf_AXIS "-" 0x21AA rf KF_HFM_RF_F_DOWN_rf_AXIS 100.000000 F00068 6 0.000000 2.000000 /end AXIS_PTS
/begin RECORD_LAYOUT KF_HFM_RF_F_DOWN_rf_AXIS FIX_NO_AXIS_PTS_Y 6 AXIS_PTS_Y 0 UWORD INDEX_INCR DIRECT /end RECORD_LAYOUT
/begin CHARACTERISTIC KF_HFM_KORR_ML_TAN "-" MAP 0x2210 VALUE_KF_HFM_KORR_ML_TAN 100.000000 F00085 0.000000 2.000000
 /begin AXIS_DESCR COM_AXIS ml F00095 4 0.000000 1400.000000 AXIS_PTS_REF KF_HFM_KORR_ML_TAN_ml_AXIS /end AXIS_DESCR
 /begin AXIS_DESCR COM_AXIS tan F00014 4 -48.000000 207.000000 AXIS_PTS_REF KF_HFM_KORR_ML_TAN_tan_AXIS /end AXIS_DESCR
 FUNCTION_LIST Lasterfassung /end CHARACTERISTIC
/begin RECORD_LAYOUT VALUE_KF_HFM_KORR_ML_TAN FNC_VALUES 0 UWORD ROW_DIR DIRECT /end RECORD_LAYOUT
/begin AXIS_PTS KF_HFM_KORR_ML_TAN_ml_AXIS "-" 0x2200 ml KF_HFM_KORR_ML_TAN_ml_AXIS 100.000000 F00095 4 0.000000 1400.000000 /end AXIS_PTS
/begin RECORD_LAYOUT KF_HFM_KORR_ML_TAN_ml_AXIS FIX_NO_AXIS_PTS_X 4 AXIS_PTS_X 0 UWORD INDEX_INCR DIRECT /end RECORD_LAYOUT
/begin AXIS_PTS KF_HFM_KORR_ML_TAN_tan_AXIS "-" 0x2208 tan KF_HFM_KORR_ML_TAN_tan_AXIS 100.000000 F00014 4 -48.000000 207.000000 /end AXIS_PTS
/begin RECORD_LAYOUT KF_HFM_KORR_ML_TAN_tan_AXIS FIX_NO_AXIS_PTS_Y 4 AXIS_PTS_Y 0 UWORD INDEX_INCR DIRECT /end RECORD_LAYOUT
/begin CHARACTERISTIC KL_KATH_T_AKTIV "-" CURVE 0x1B12 VALUE_KL_KATH_T_AKTIV 100.000000 F00017 0.000000 65535.000000
 /begin AXIS_DESCR COM_AXIS tmot F00014 8 -48.000000 207.000000 AXIS_PTS_REF KL_KATH_T_AKTIV_tmot_AXIS /end AXIS_DESCR
 FUNCTION_LIST Katheiz_Funktion /end CHARACTERISTIC
/begin RECORD_LAYOUT VALUE_KL_KATH_T_AKTIV FNC_VALUES 0 UWORD ROW_DIR DIRECT /end RECORD_LAYOUT
/begin AXIS_PTS KL_KATH_T_AKTIV_tmot_AXIS "-" 0x1B02 tmot KL_KATH_T_AKTIV_tmot_AXIS 100.000000 F00014 8 -48.000000 207.000000 /end AXIS_PTS
/begin RECORD_LAYOUT KL_KATH_T_AKTIV_tmot_AXIS FIX_NO_AXIS_PTS_X 8 AXIS_PTS_X 0 UWORD INDEX_INCR DIRECT /end RECORD_LAYOUT
/begin CHARACTERISTIC KL_KATS_ML "-" CURVE 0x1FFE VALUE_KL_KATS_ML 100.000000 F00106 255.000000 1.000000
 /begin AXIS_DESCR COM_AXIS ml F00107 4 0.000000 1400.000000 AXIS_PTS_REF KL_KATS_ML_ml_AXIS /end AXIS_DESCR
 FUNCTION_LIST Katschutz /end CHARACTERISTIC
/begin RECORD_LAYOUT VALUE_KL_KATS_ML FNC_VALUES 0 UBYTE ROW_DIR DIRECT /end RECORD_LAYOUT
/begin AXIS_PTS KL_KATS_ML_ml_AXIS "-" 0x1FFA ml KL_KATS_ML_ml_AXIS 100.000000 F00107 4 0.000000 1400.000000 /end AXIS_PTS
/begin RECORD_LAYOUT KL_KATS_ML_ml_AXIS FIX_NO_AXIS_PTS_X 4 AXIS_PTS_X 0 UBYTE INDEX_INCR DIRECT /end RECORD_LAYOUT
/begin CHARACTERISTIC KL_KATS_SA_DELAY "-" CURVE 0x2008 VALUE_KL_KATS_SA_DELAY 100.000000 F00108 50.000000 0.000000
 /begin AXIS_DESCR COM_AXIS n40 F00109 4 0.000000 10000.000000 AXIS_PTS_REF KL_KATS_SA_DELAY_n40_AXIS /end AXIS_DESCR
 FUNCTION_LIST Katschutz /end CHARACTERISTIC
/begin RECORD_LAYOUT VALUE_KL_KATS_SA_DELAY FNC_VALUES 0 UBYTE ROW_DIR DIRECT /end RECORD_LAYOUT
/begin AXIS_PTS KL_KATS_SA_DELAY_n40_AXIS "-" 0x2004 n40 KL_KATS_SA_DELAY_n40_AXIS 100.000000 F00109 4 0.000000 10000.000000 /end AXIS_PTS
/begin RECORD_LAYOUT KL_KATS_SA_DELAY_n40_AXIS FIX_NO_AXIS_PTS_X 4 AXIS_PTS_X 0 UBYTE INDEX_INCR DIRECT /end RECORD_LAYOUT
/begin CHARACTERISTIC KL_KA_P_UMG "-" CURVE 0x114A VALUE_KL_KA_P_UMG 100.000000 F00045 -12.000000 12.000000
 /begin AXIS_DESCR COM_AXIS p_umg F00104 6 500.000000 1150.000000 AXIS_PTS_REF KL_KA_P_UMG_p_umg_AXIS /end AXIS_DESCR
 FUNCTION_LIST Klopfen /end CHARACTERISTIC
/begin RECORD_LAYOUT VALUE_KL_KA_P_UMG FNC_VALUES 0 SBYTE ROW_DIR DIRECT /end RECORD_LAYOUT
/begin AXIS_PTS KL_KA_P_UMG_p_umg_AXIS "-" 0x1144 p_umg KL_KA_P_UMG_p_umg_AXIS 100.000000 F00104 6 500.000000 1150.000000 /end AXIS_PTS
/begin RECORD_LAYOUT KL_KA_P_UMG_p_umg_AXIS FIX_NO_AXIS_PTS_X 6 AXIS_PTS_X 0 UBYTE INDEX_INCR DIRECT /end RECORD_LAYOUT
/begin CHARACTERISTIC KL_KA_OFFS_VL "-" CURVE 0x1164 VALUE_KL_KA_OFFS_VL 100.000000 F00115 -10.000000 38.000000
 /begin AXIS_DESCR COM_AXIS n40 F00109 18 0.000000 10000.000000 AXIS_PTS_REF KL_KA_OFFS_VL_n40_AXIS /end AXIS_DESCR
 FUNCTION_LIST Klopfen /end CHARACTERISTIC
/begin RECORD_LAYOUT VALUE_KL_KA_OFFS_VL FNC_VALUES 0 SBYTE ROW_DIR DIRECT /end RECORD_LAYOUT
/begin AXIS_PTS KL_KA_OFFS_VL_n40_AXIS "-" 0x1152 n40 KL_KA_OFFS_VL_n40_AXIS 100.000000 F00109 18 0.000000 10000.000000 /end AXIS_PTS
/begin RECORD_LAYOUT KL_KA_OFFS_VL_n40_AXIS FIX_NO_AXIS_PTS_X 18 AXIS_PTS_X 0 UBYTE INDEX_INCR DIRECT /end RECORD_LAYOUT
/begin CHARACTERISTIC KL_KA_FAKT_VL "-" CURVE 0x118A VALUE_KL_KA_FAKT_VL 100.000000 F00003 0.000000 3.000000
 /begin AXIS_DESCR COM_AXIS n40 F00109 18 0.000000 10000.000000 AXIS_PTS_REF KL_KA_FAKT_VL_n40_AXIS /end AXIS_DESCR
 FUNCTION_LIST Klopfen /end CHARACTERISTIC
/begin RECORD_LAYOUT VALUE_KL_KA_FAKT_VL FNC_VALUES 0 UBYTE ROW_DIR DIRECT /end RECORD_LAYOUT
/begin AXIS_PTS KL_KA_FAKT_VL_n40_AXIS "-" 0x1178 n40 KL_KA_FAKT_VL_n40_AXIS 100.000000 F00109 18 0.000000 10000.000000 /end AXIS_PTS
/begin RECORD_LAYOUT KL_KA_FAKT_VL_n40_AXIS FIX_NO_AXIS_PTS_X 18 AXIS_PTS_X 0 UBYTE INDEX_INCR DIRECT /end RECORD_LAYOUT
/begin CHARACTERISTIC KL_KA_RF_MIN "-" CURVE 0x11B2 VALUE_KL_KA_RF_MIN 100.000000 F00068 0.000000 2.000000
 /begin AXIS_DESCR COM_AXIS n F00007 10 0.000000 10000.000000 AXIS_PTS_REF KL_KA_RF_MIN_n_AXIS /end AXIS_DESCR
 FUNCTION_LIST Klopfen /end CHARACTERISTIC
/begin RECORD_LAYOUT VALUE_KL_KA_RF_MIN FNC_VALUES 0 UWORD ROW_DIR DIRECT /end RECORD_LAYOUT
/begin AXIS_PTS KL_KA_RF_MIN_n_AXIS "-" 0x119E n KL_KA_RF_MIN_n_AXIS 100.000000 F00007 10 0.000000 10000.000000 /end AXIS_PTS
/begin RECORD_LAYOUT KL_KA_RF_MIN_n_AXIS FIX_NO_AXIS_PTS_X 10 AXIS_PTS_X 0 UWORD INDEX_INCR DIRECT /end RECORD_LAYOUT
/begin CHARACTERISTIC KF_KA_OFFS "-" MAP 0x11E6 VALUE_KF_KA_OFFS 100.000000 F00115 -10.000000 38.000000
 /begin AXIS_DESCR COM_AXIS n40 F00109 18 0.000000 10000.000000 AXIS_PTS_REF KF_KA_OFFS_n40_AXIS /end AXIS_DESCR
 /begin AXIS_DESCR COM_AXIS rf5 F00116 12 0.000000 1.000000 AXIS_PTS_REF KF_KA_OFFS_rf5_AXIS /end AXIS_DESCR
 FUNCTION_LIST Klopfen /end CHARACTERISTIC
/begin RECORD_LAYOUT VALUE_KF_KA_OFFS FNC_VALUES 0 SBYTE ROW_DIR DIRECT /end RECORD_LAYOUT
/begin AXIS_PTS KF_KA_OFFS_n40_AXIS "-" 0x11C8 n40 KF_KA_OFFS_n40_AXIS 100.000000 F00109 18 0.000000 10000.000000 /end AXIS_PTS
/begin RECORD_LAYOUT KF_KA_OFFS_n40_AXIS FIX_NO_AXIS_PTS_X 18 AXIS_PTS_X 0 UBYTE INDEX_INCR DIRECT /end RECORD_LAYOUT
/begin AXIS_PTS KF_KA_OFFS_rf5_AXIS "-" 0x11DA rf5 KF_KA_OFFS_rf5_AXIS 100.000000 F00116 12 0.000000 1.000000 /end AXIS_PTS
/begin RECORD_LAYOUT KF_KA_OFFS_rf5_AXIS FIX_NO_AXIS_PTS_Y 12 AXIS_PTS_Y 0 UBYTE INDEX_INCR DIRECT /end RECORD_LAYOUT
/begin CHARACTERISTIC KF_KA_FAKT "-" MAP 0x12DE VALUE_KF_KA_FAKT 100.000000 F00003 0.000000 3.000000
 /begin AXIS_DESCR COM_AXIS n40 F00109 18 0.000000 10000.000000 AXIS_PTS_REF KF_KA_FAKT_n40_AXIS /end AXIS_DESCR
 /begin AXIS_DESCR COM_AXIS rf5 F00116 12 0.000000 1.000000 AXIS_PTS_REF KF_KA_FAKT_rf5_AXIS /end AXIS_DESCR
 FUNCTION_LIST Klopfen /end CHARACTERISTIC
/begin RECORD_LAYOUT VALUE_KF_KA_FAKT FNC_VALUES 0 UBYTE ROW_DIR DIRECT /end RECORD_LAYOUT
/begin AXIS_PTS KF_KA_FAKT_n40_AXIS "-" 0x12C0 n40 KF_KA_FAKT_n40_AXIS 100.000000 F00109 18 0.000000 10000.000000 /end AXIS_PTS
/begin RECORD_LAYOUT KF_KA_FAKT_n40_AXIS FIX_NO_AXIS_PTS_X 18 AXIS_PTS_X 0 UBYTE INDEX_INCR DIRECT /end RECORD_LAYOUT
/begin AXIS_PTS KF_KA_FAKT_rf5_AXIS "-" 0x12D2 rf5 KF_KA_FAKT_rf5_AXIS 100.000000 F00116 12 0.000000 1.000000 /end AXIS_PTS
/begin RECORD_LAYOUT KF_KA_FAKT_rf5_AXIS FIX_NO_AXIS_PTS_Y 12 AXIS_PTS_Y 0 UBYTE INDEX_INCR DIRECT /end RECORD_LAYOUT
/begin CHARACTERISTIC KF_KA_T_KOMP "-" MAP 0x13C4 VALUE_KF_KA_T_KOMP 100.000000 F00117 -25.000000 25.000000
 /begin AXIS_DESCR COM_AXIS tmot F00014 6 -48.000000 207.000000 AXIS_PTS_REF KF_KA_T_KOMP_tmot_AXIS /end AXIS_DESCR
 /begin AXIS_DESCR COM_AXIS tan F00014 6 -48.000000 207.000000 AXIS_PTS_REF KF_KA_T_KOMP_tan_AXIS /end AXIS_DESCR
 FUNCTION_LIST Klopfen /end CHARACTERISTIC
/begin RECORD_LAYOUT VALUE_KF_KA_T_KOMP FNC_VALUES 0 SBYTE ROW_DIR DIRECT /end RECORD_LAYOUT
/begin AXIS_PTS KF_KA_T_KOMP_tmot_AXIS "-" 0x13B8 tmot KF_KA_T_KOMP_tmot_AXIS 100.000000 F00014 6 -48.000000 207.000000 /end AXIS_PTS
/begin RECORD_LAYOUT KF_KA_T_KOMP_tmot_AXIS FIX_NO_AXIS_PTS_X 6 AXIS_PTS_X 0 UBYTE INDEX_INCR DIRECT /end RECORD_LAYOUT
/begin AXIS_PTS KF_KA_T_KOMP_tan_AXIS "-" 0x13BE tan KF_KA_T_KOMP_tan_AXIS 100.000000 F00014 6 -48.000000 207.000000 /end AXIS_PTS
/begin RECORD_LAYOUT KF_KA_T_KOMP_tan_AXIS FIX_NO_AXIS_PTS_Y 6 AXIS_PTS_Y 0 UBYTE INDEX_INCR DIRECT /end RECORD_LAYOUT
/begin CHARACTERISTIC KL_KD_FILT_STAT "-" CURVE 0xBF9 VALUE_KL_KD_FILT_STAT 100.000000 F00013 1.000000 6.000000
 /begin AXIS_DESCR COM_AXIS n40 F00109 9 0.000000 10000.000000 AXIS_PTS_REF KL_KD_FILT_STAT_n40_AXIS /end AXIS_DESCR
 FUNCTION_LIST Klopfen /end CHARACTERISTIC
/begin RECORD_LAYOUT VALUE_KL_KD_FILT_STAT FNC_VALUES 0 UBYTE ROW_DIR DIRECT /end RECORD_LAYOUT
/begin AXIS_PTS KL_KD_FILT_STAT_n40_AXIS "-" 0xBF0 n40 KL_KD_FILT_STAT_n40_AXIS 100.000000 F00109 9 0.000000 10000.000000 /end AXIS_PTS
/begin RECORD_LAYOUT KL_KD_FILT_STAT_n40_AXIS FIX_NO_AXIS_PTS_X 9 AXIS_PTS_X 0 UBYTE INDEX_INCR DIRECT /end RECORD_LAYOUT
/begin CHARACTERISTIC KL_KD_FILT_DYN "-" CURVE 0xC0D VALUE_KL_KD_FILT_DYN 100.000000 F00013 1.000000 6.000000
 /begin AXIS_DESCR COM_AXIS n40 F00109 9 0.000000 10000.000000 AXIS_PTS_REF KL_KD_FILT_DYN_n40_AXIS /end AXIS_DESCR
 FUNCTION_LIST Klopfen /end CHARACTERISTIC
/begin RECORD_LAYOUT VALUE_KL_KD_FILT_DYN FNC_VALUES 0 UBYTE ROW_DIR DIRECT /end RECORD_LAYOUT
/begin AXIS_PTS KL_KD_FILT_DYN_n40_AXIS "-" 0xC04 n40 KL_KD_FILT_DYN_n40_AXIS 100.000000 F00109 9 0.000000 10000.000000 /end AXIS_PTS
/begin RECORD_LAYOUT KL_KD_FILT_DYN_n40_AXIS FIX_NO_AXIS_PTS_X 9 AXIS_PTS_X 0 UBYTE INDEX_INCR DIRECT /end RECORD_LAYOUT
/begin CHARACTERISTIC KL_KD_FAKT_STARK "-" CURVE 0xC21 VALUE_KL_KD_FAKT_STARK 100.000000 F00003 0.000000 3.000000
 /begin AXIS_DESCR COM_AXIS n40 F00109 9 0.000000 10000.000000 AXIS_PTS_REF KL_KD_FAKT_STARK_n40_AXIS /end AXIS_DESCR
 FUNCTION_LIST Klopfen /end CHARACTERISTIC
/begin RECORD_LAYOUT VALUE_KL_KD_FAKT_STARK FNC_VALUES 0 UBYTE ROW_DIR DIRECT /end RECORD_LAYOUT
/begin AXIS_PTS KL_KD_FAKT_STARK_n40_AXIS "-" 0xC18 n40 KL_KD_FAKT_STARK_n40_AXIS 100.000000 F00109 9 0.000000 10000.000000 /end AXIS_PTS
/begin RECORD_LAYOUT KL_KD_FAKT_STARK_n40_AXIS FIX_NO_AXIS_PTS_X 9 AXIS_PTS_X 0 UBYTE INDEX_INCR DIRECT /end RECORD_LAYOUT
/begin CHARACTERISTIC KF_KD_KFAKT_1 "-" MAP 0xC52 VALUE_KF_KD_KFAKT_1 100.000000 F00085 1.000000 4.000000
 /begin AXIS_DESCR COM_AXIS n F00007 16 0.000000 10000.000000 AXIS_PTS_REF KF_KD_KFAKT_1_n_AXIS /end AXIS_DESCR
 /begin AXIS_DESCR COM_AXIS rf F00068 3 0.000000 2.000000 AXIS_PTS_REF KF_KD_KFAKT_1_rf_AXIS /end AXIS_DESCR
 FUNCTION_LIST Klopfen /end CHARACTERISTIC
/begin RECORD_LAYOUT VALUE_KF_KD_KFAKT_1 FNC_VALUES 0 UWORD ROW_DIR DIRECT /end RECORD_LAYOUT
/begin AXIS_PTS KF_KD_KFAKT_1_n_AXIS "-" 0xC2C n KF_KD_KFAKT_1_n_AXIS 100.000000 F00007 16 0.000000 10000.000000 /end AXIS_PTS
/begin RECORD_LAYOUT KF_KD_KFAKT_1_n_AXIS FIX_NO_AXIS_PTS_X 16 AXIS_PTS_X 0 UWORD INDEX_INCR DIRECT /end RECORD_LAYOUT
/begin AXIS_PTS KF_KD_KFAKT_1_rf_AXIS "-" 0xC4C rf KF_KD_KFAKT_1_rf_AXIS 100.000000 F00068 3 0.000000 2.000000 /end AXIS_PTS
/begin RECORD_LAYOUT KF_KD_KFAKT_1_rf_AXIS FIX_NO_AXIS_PTS_Y 3 AXIS_PTS_Y 0 UWORD INDEX_INCR DIRECT /end RECORD_LAYOUT
/begin CHARACTERISTIC KF_KD_KFAKT_2 "-" MAP 0xCDA VALUE_KF_KD_KFAKT_2 100.000000 F00085 1.000000 4.000000
 /begin AXIS_DESCR COM_AXIS n F00007 16 0.000000 10000.000000 AXIS_PTS_REF KF_KD_KFAKT_2_n_AXIS /end AXIS_DESCR
 /begin AXIS_DESCR COM_AXIS rf F00068 3 0.000000 2.000000 AXIS_PTS_REF KF_KD_KFAKT_2_rf_AXIS /end AXIS_DESCR
 FUNCTION_LIST Klopfen /end CHARACTERISTIC
/begin RECORD_LAYOUT VALUE_KF_KD_KFAKT_2 FNC_VALUES 0 UWORD ROW_DIR DIRECT /end RECORD_LAYOUT
/begin AXIS_PTS KF_KD_KFAKT_2_n_AXIS "-" 0xCB4 n KF_KD_KFAKT_2_n_AXIS 100.000000 F00007 16 0.000000 10000.000000 /end AXIS_PTS
/begin RECORD_LAYOUT KF_KD_KFAKT_2_n_AXIS FIX_NO_AXIS_PTS_X 16 AXIS_PTS_X 0 UWORD INDEX_INCR DIRECT /end RECORD_LAYOUT
/begin AXIS_PTS KF_KD_KFAKT_2_rf_AXIS "-" 0xCD4 rf KF_KD_KFAKT_2_rf_AXIS 100.000000 F00068 3 0.000000 2.000000 /end AXIS_PTS
/begin RECORD_LAYOUT KF_KD_KFAKT_2_rf_AXIS FIX_NO_AXIS_PTS_Y 3 AXIS_PTS_Y 0 UWORD INDEX_INCR DIRECT /end RECORD_LAYOUT
/begin CHARACTERISTIC KF_KD_KFAKT_3 "-" MAP 0xD62 VALUE_KF_KD_KFAKT_3 100.000000 F00085 1.000000 4.000000
 /begin AXIS_DESCR COM_AXIS n F00007 16 0.000000 10000.000000 AXIS_PTS_REF KF_KD_KFAKT_3_n_AXIS /end AXIS_DESCR
 /begin AXIS_DESCR COM_AXIS rf F00068 3 0.000000 2.000000 AXIS_PTS_REF KF_KD_KFAKT_3_rf_AXIS /end AXIS_DESCR
 FUNCTION_LIST Klopfen /end CHARACTERISTIC
/begin RECORD_LAYOUT VALUE_KF_KD_KFAKT_3 FNC_VALUES 0 UWORD ROW_DIR DIRECT /end RECORD_LAYOUT
/begin AXIS_PTS KF_KD_KFAKT_3_n_AXIS "-" 0xD3C n KF_KD_KFAKT_3_n_AXIS 100.000000 F00007 16 0.000000 10000.000000 /end AXIS_PTS
/begin RECORD_LAYOUT KF_KD_KFAKT_3_n_AXIS FIX_NO_AXIS_PTS_X 16 AXIS_PTS_X 0 UWORD INDEX_INCR DIRECT /end RECORD_LAYOUT
/begin AXIS_PTS KF_KD_KFAKT_3_rf_AXIS "-" 0xD5C rf KF_KD_KFAKT_3_rf_AXIS 100.000000 F00068 3 0.000000 2.000000 /end AXIS_PTS
/begin RECORD_LAYOUT KF_KD_KFAKT_3_rf_AXIS FIX_NO_AXIS_PTS_Y 3 AXIS_PTS_Y 0 UWORD INDEX_INCR DIRECT /end RECORD_LAYOUT
/begin CHARACTERISTIC KF_KD_KFAKT_4 "-" MAP 0xDEA VALUE_KF_KD_KFAKT_4 100.000000 F00085 1.000000 4.000000
 /begin AXIS_DESCR COM_AXIS n F00007 16 0.000000 10000.000000 AXIS_PTS_REF KF_KD_KFAKT_4_n_AXIS /end AXIS_DESCR
 /begin AXIS_DESCR COM_AXIS rf F00068 3 0.000000 2.000000 AXIS_PTS_REF KF_KD_KFAKT_4_rf_AXIS /end AXIS_DESCR
 FUNCTION_LIST Klopfen /end CHARACTERISTIC
/begin RECORD_LAYOUT VALUE_KF_KD_KFAKT_4 FNC_VALUES 0 UWORD ROW_DIR DIRECT /end RECORD_LAYOUT
/begin AXIS_PTS KF_KD_KFAKT_4_n_AXIS "-" 0xDC4 n KF_KD_KFAKT_4_n_AXIS 100.000000 F00007 16 0.000000 10000.000000 /end AXIS_PTS
/begin RECORD_LAYOUT KF_KD_KFAKT_4_n_AXIS FIX_NO_AXIS_PTS_X 16 AXIS_PTS_X 0 UWORD INDEX_INCR DIRECT /end RECORD_LAYOUT
/begin AXIS_PTS KF_KD_KFAKT_4_rf_AXIS "-" 0xDE4 rf KF_KD_KFAKT_4_rf_AXIS 100.000000 F00068 3 0.000000 2.000000 /end AXIS_PTS
/begin RECORD_LAYOUT KF_KD_KFAKT_4_rf_AXIS FIX_NO_AXIS_PTS_Y 3 AXIS_PTS_Y 0 UWORD INDEX_INCR DIRECT /end RECORD_LAYOUT
/begin CHARACTERISTIC KF_KD_KFAKT_5 "-" MAP 0xE72 VALUE_KF_KD_KFAKT_5 100.000000 F00085 1.000000 4.000000
 /begin AXIS_DESCR COM_AXIS n F00007 16 0.000000 10000.000000 AXIS_PTS_REF KF_KD_KFAKT_5_n_AXIS /end AXIS_DESCR
 /begin AXIS_DESCR COM_AXIS rf F00068 3 0.000000 2.000000 AXIS_PTS_REF KF_KD_KFAKT_5_rf_AXIS /end AXIS_DESCR
 FUNCTION_LIST Klopfen /end CHARACTERISTIC
/begin RECORD_LAYOUT VALUE_KF_KD_KFAKT_5 FNC_VALUES 0 UWORD ROW_DIR DIRECT /end RECORD_LAYOUT
/begin AXIS_PTS KF_KD_KFAKT_5_n_AXIS "-" 0xE4C n KF_KD_KFAKT_5_n_AXIS 100.000000 F00007 16 0.000000 10000.000000 /end AXIS_PTS
/begin RECORD_LAYOUT KF_KD_KFAKT_5_n_AXIS FIX_NO_AXIS_PTS_X 16 AXIS_PTS_X 0 UWORD INDEX_INCR DIRECT /end RECORD_LAYOUT
/begin AXIS_PTS KF_KD_KFAKT_5_rf_AXIS "-" 0xE6C rf KF_KD_KFAKT_5_rf_AXIS 100.000000 F00068 3 0.000000 2.000000 /end AXIS_PTS
/begin RECORD_LAYOUT KF_KD_KFAKT_5_rf_AXIS FIX_NO_AXIS_PTS_Y 3 AXIS_PTS_Y 0 UWORD INDEX_INCR DIRECT /end RECORD_LAYOUT
/begin CHARACTERISTIC KF_KD_KFAKT_6 "-" MAP 0xEFA VALUE_KF_KD_KFAKT_6 100.000000 F00085 1.000000 4.000000
 /begin AXIS_DESCR COM_AXIS n F00007 16 0.000000 10000.000000 AXIS_PTS_REF KF_KD_KFAKT_6_n_AXIS /end AXIS_DESCR
 /begin AXIS_DESCR COM_AXIS rf F00068 3 0.000000 2.000000 AXIS_PTS_REF KF_KD_KFAKT_6_rf_AXIS /end AXIS_DESCR
 FUNCTION_LIST Klopfen /end CHARACTERISTIC
/begin RECORD_LAYOUT VALUE_KF_KD_KFAKT_6 FNC_VALUES 0 UWORD ROW_DIR DIRECT /end RECORD_LAYOUT
/begin AXIS_PTS KF_KD_KFAKT_6_n_AXIS "-" 0xED4 n KF_KD_KFAKT_6_n_AXIS 100.000000 F00007 16 0.000000 10000.000000 /end AXIS_PTS
/begin RECORD_LAYOUT KF_KD_KFAKT_6_n_AXIS FIX_NO_AXIS_PTS_X 16 AXIS_PTS_X 0 UWORD INDEX_INCR DIRECT /end RECORD_LAYOUT
/begin AXIS_PTS KF_KD_KFAKT_6_rf_AXIS "-" 0xEF4 rf KF_KD_KFAKT_6_rf_AXIS 100.000000 F00068 3 0.000000 2.000000 /end AXIS_PTS
/begin RECORD_LAYOUT KF_KD_KFAKT_6_rf_AXIS FIX_NO_AXIS_PTS_Y 3 AXIS_PTS_Y 0 UWORD INDEX_INCR DIRECT /end RECORD_LAYOUT
/begin CHARACTERISTIC KF_KD_KFAKT_7 "-" MAP 0xF82 VALUE_KF_KD_KFAKT_7 100.000000 F00085 1.000000 4.000000
 /begin AXIS_DESCR COM_AXIS n F00007 16 0.000000 10000.000000 AXIS_PTS_REF KF_KD_KFAKT_7_n_AXIS /end AXIS_DESCR
 /begin AXIS_DESCR COM_AXIS rf F00068 3 0.000000 2.000000 AXIS_PTS_REF KF_KD_KFAKT_7_rf_AXIS /end AXIS_DESCR
 FUNCTION_LIST Klopfen /end CHARACTERISTIC
/begin RECORD_LAYOUT VALUE_KF_KD_KFAKT_7 FNC_VALUES 0 UWORD ROW_DIR DIRECT /end RECORD_LAYOUT
/begin AXIS_PTS KF_KD_KFAKT_7_n_AXIS "-" 0xF5C n KF_KD_KFAKT_7_n_AXIS 100.000000 F00007 16 0.000000 10000.000000 /end AXIS_PTS
/begin RECORD_LAYOUT KF_KD_KFAKT_7_n_AXIS FIX_NO_AXIS_PTS_X 16 AXIS_PTS_X 0 UWORD INDEX_INCR DIRECT /end RECORD_LAYOUT
/begin AXIS_PTS KF_KD_KFAKT_7_rf_AXIS "-" 0xF7C rf KF_KD_KFAKT_7_rf_AXIS 100.000000 F00068 3 0.000000 2.000000 /end AXIS_PTS
/begin RECORD_LAYOUT KF_KD_KFAKT_7_rf_AXIS FIX_NO_AXIS_PTS_Y 3 AXIS_PTS_Y 0 UWORD INDEX_INCR DIRECT /end RECORD_LAYOUT
/begin CHARACTERISTIC KF_KD_KFAKT_8 "-" MAP 0x100A VALUE_KF_KD_KFAKT_8 100.000000 F00085 1.000000 4.000000
 /begin AXIS_DESCR COM_AXIS n F00007 16 0.000000 10000.000000 AXIS_PTS_REF KF_KD_KFAKT_8_n_AXIS /end AXIS_DESCR
 /begin AXIS_DESCR COM_AXIS rf F00068 3 0.000000 2.000000 AXIS_PTS_REF KF_KD_KFAKT_8_rf_AXIS /end AXIS_DESCR
 FUNCTION_LIST Klopfen /end CHARACTERISTIC
/begin RECORD_LAYOUT VALUE_KF_KD_KFAKT_8 FNC_VALUES 0 UWORD ROW_DIR DIRECT /end RECORD_LAYOUT
/begin AXIS_PTS KF_KD_KFAKT_8_n_AXIS "-" 0xFE4 n KF_KD_KFAKT_8_n_AXIS 100.000000 F00007 16 0.000000 10000.000000 /end AXIS_PTS
/begin RECORD_LAYOUT KF_KD_KFAKT_8_n_AXIS FIX_NO_AXIS_PTS_X 16 AXIS_PTS_X 0 UWORD INDEX_INCR DIRECT /end RECORD_LAYOUT
/begin AXIS_PTS KF_KD_KFAKT_8_rf_AXIS "-" 0x1004 rf KF_KD_KFAKT_8_rf_AXIS 100.000000 F00068 3 0.000000 2.000000 /end AXIS_PTS
/begin RECORD_LAYOUT KF_KD_KFAKT_8_rf_AXIS FIX_NO_AXIS_PTS_Y 3 AXIS_PTS_Y 0 UWORD INDEX_INCR DIRECT /end RECORD_LAYOUT
/begin CHARACTERISTIC KL_KKOS_ON_DELAY "-" CURVE 0x34DA VALUE_KL_KKOS_ON_DELAY 100.000000 F00120 0.000000 63999.000000
 /begin AXIS_DESCR COM_AXIS n F00007 3 0.000000 65535.000000 AXIS_PTS_REF KL_KKOS_ON_DELAY_n_AXIS /end AXIS_DESCR
 FUNCTION_LIST Klimaanlage /end CHARACTERISTIC
/begin RECORD_LAYOUT VALUE_KL_KKOS_ON_DELAY FNC_VALUES 0 UWORD ROW_DIR DIRECT /end RECORD_LAYOUT
/begin AXIS_PTS KL_KKOS_ON_DELAY_n_AXIS "-" 0x34D4 n KL_KKOS_ON_DELAY_n_AXIS 100.000000 F00007 3 0.000000 65535.000000 /end AXIS_PTS
/begin RECORD_LAYOUT KL_KKOS_ON_DELAY_n_AXIS FIX_NO_AXIS_PTS_X 3 AXIS_PTS_X 0 UWORD INDEX_INCR DIRECT /end RECORD_LAYOUT
/begin CHARACTERISTIC KL_KKOS_OFF_DELAY "-" CURVE 0x34E8 VALUE_KL_KKOS_OFF_DELAY 100.000000 F00120 0.000000 63999.000000
 /begin AXIS_DESCR COM_AXIS n F00007 3 0.000000 65535.000000 AXIS_PTS_REF KL_KKOS_OFF_DELAY_n_AXIS /end AXIS_DESCR
 FUNCTION_LIST Klimaanlage /end CHARACTERISTIC
/begin RECORD_LAYOUT VALUE_KL_KKOS_OFF_DELAY FNC_VALUES 0 UWORD ROW_DIR DIRECT /end RECORD_LAYOUT
/begin AXIS_PTS KL_KKOS_OFF_DELAY_n_AXIS "-" 0x34E2 n KL_KKOS_OFF_DELAY_n_AXIS 100.000000 F00007 3 0.000000 65535.000000 /end AXIS_PTS
/begin RECORD_LAYOUT KL_KKOS_OFF_DELAY_n_AXIS FIX_NO_AXIS_PTS_X 3 AXIS_PTS_X 0 UWORD INDEX_INCR DIRECT /end RECORD_LAYOUT
/begin CHARACTERISTIC KL_KM_AVAN_OFFSET "-" CURVE 0xAA0 VALUE_KL_KM_AVAN_OFFSET 100.000000 F00006 0.000000 25.000000
 /begin AXIS_DESCR COM_AXIS n40 F00109 6 0.000000 10000.000000 AXIS_PTS_REF KL_KM_AVAN_OFFSET_n40_AXIS /end AXIS_DESCR
 FUNCTION_LIST Klopfen /end CHARACTERISTIC
/begin RECORD_LAYOUT VALUE_KL_KM_AVAN_OFFSET FNC_VALUES 0 UBYTE ROW_DIR DIRECT /end RECORD_LAYOUT
/begin AXIS_PTS KL_KM_AVAN_OFFSET_n40_AXIS "-" 0xA9A n40 KL_KM_AVAN_OFFSET_n40_AXIS 100.000000 F00109 6 0.000000 10000.000000 /end AXIS_PTS
/begin RECORD_LAYOUT KL_KM_AVAN_OFFSET_n40_AXIS FIX_NO_AXIS_PTS_X 6 AXIS_PTS_X 0 UBYTE INDEX_INCR DIRECT /end RECORD_LAYOUT
/begin CHARACTERISTIC KL_KM_FHIP "-" CURVE 0xAB1 VALUE_KL_KM_FHIP 100.000000 F00125 1.000000 18.000000
 /begin AXIS_DESCR COM_AXIS n40 F00109 9 0.000000 10000.000000 AXIS_PTS_REF KL_KM_FHIP_n40_AXIS /end AXIS_DESCR
 FUNCTION_LIST Klopfen /end CHARACTERISTIC
/begin RECORD_LAYOUT VALUE_KL_KM_FHIP FNC_VALUES 0 UBYTE ROW_DIR DIRECT /end RECORD_LAYOUT
/begin AXIS_PTS KL_KM_FHIP_n40_AXIS "-" 0xAA8 n40 KL_KM_FHIP_n40_AXIS 100.000000 F00109 9 0.000000 10000.000000 /end AXIS_PTS
/begin RECORD_LAYOUT KL_KM_FHIP_n40_AXIS FIX_NO_AXIS_PTS_X 9 AXIS_PTS_X 0 UBYTE INDEX_INCR DIRECT /end RECORD_LAYOUT
/begin CHARACTERISTIC KL_KM_AD_FILT "-" CURVE 0xAC2 VALUE_KL_KM_AD_FILT 100.000000 F00013 1.000000 6.000000
 /begin AXIS_DESCR COM_AXIS n40 F00109 6 0.000000 10000.000000 AXIS_PTS_REF KL_KM_AD_FILT_n40_AXIS /end AXIS_DESCR
 FUNCTION_LIST Klopfen /end CHARACTERISTIC
/begin RECORD_LAYOUT VALUE_KL_KM_AD_FILT FNC_VALUES 0 UBYTE ROW_DIR DIRECT /end RECORD_LAYOUT
/begin AXIS_PTS KL_KM_AD_FILT_n40_AXIS "-" 0xABC n40 KL_KM_AD_FILT_n40_AXIS 100.000000 F00109 6 0.000000 10000.000000 /end AXIS_PTS
/begin RECORD_LAYOUT KL_KM_AD_FILT_n40_AXIS FIX_NO_AXIS_PTS_X 6 AXIS_PTS_X 0 UBYTE INDEX_INCR DIRECT /end RECORD_LAYOUT
/begin CHARACTERISTIC KL_KM_FENSTER_L "-" CURVE 0xADE VALUE_KL_KM_FENSTER_L 100.000000 F00006 15.000000 70.000000
 /begin AXIS_DESCR COM_AXIS n F00007 10 0.000000 10000.000000 AXIS_PTS_REF KL_KM_FENSTER_L_n_AXIS /end AXIS_DESCR
 FUNCTION_LIST Klopfen /end CHARACTERISTIC
/begin RECORD_LAYOUT VALUE_KL_KM_FENSTER_L FNC_VALUES 0 UWORD ROW_DIR DIRECT /end RECORD_LAYOUT
/begin AXIS_PTS KL_KM_FENSTER_L_n_AXIS "-" 0xACA n KL_KM_FENSTER_L_n_AXIS 100.000000 F00007 10 0.000000 10000.000000 /end AXIS_PTS
/begin RECORD_LAYOUT KL_KM_FENSTER_L_n_AXIS FIX_NO_AXIS_PTS_X 10 AXIS_PTS_X 0 UWORD INDEX_INCR DIRECT /end RECORD_LAYOUT
/begin CHARACTERISTIC KL_KM_DYN_VERZ "-" CURVE 0xAFD VALUE_KL_KM_DYN_VERZ 100.000000 F00013 0.000000 255.000000
 /begin AXIS_DESCR COM_AXIS n40 F00109 9 0.000000 10000.000000 AXIS_PTS_REF KL_KM_DYN_VERZ_n40_AXIS /end AXIS_DESCR
 FUNCTION_LIST Klopfen /end CHARACTERISTIC
/begin RECORD_LAYOUT VALUE_KL_KM_DYN_VERZ FNC_VALUES 0 UBYTE ROW_DIR DIRECT /end RECORD_LAYOUT
/begin AXIS_PTS KL_KM_DYN_VERZ_n40_AXIS "-" 0xAF4 n40 KL_KM_DYN_VERZ_n40_AXIS 100.000000 F00109 9 0.000000 10000.000000 /end AXIS_PTS
/begin RECORD_LAYOUT KL_KM_DYN_VERZ_n40_AXIS FIX_NO_AXIS_PTS_X 9 AXIS_PTS_X 0 UBYTE INDEX_INCR DIRECT /end RECORD_LAYOUT
/begin CHARACTERISTIC KL_KM_IHIP_DIAG_S "-" CURVE 0xB11 VALUE_KL_KM_IHIP_DIAG_S 100.000000 F00126 41.000000 561.000000
 /begin AXIS_DESCR COM_AXIS n40 F00109 9 0.000000 10000.000000 AXIS_PTS_REF KL_KM_IHIP_DIAG_S_n40_AXIS /end AXIS_DESCR
 FUNCTION_LIST Klopfen /end CHARACTERISTIC
/begin RECORD_LAYOUT VALUE_KL_KM_IHIP_DIAG_S FNC_VALUES 0 UBYTE ROW_DIR DIRECT /end RECORD_LAYOUT
/begin AXIS_PTS KL_KM_IHIP_DIAG_S_n40_AXIS "-" 0xB08 n40 KL_KM_IHIP_DIAG_S_n40_AXIS 100.000000 F00109 9 0.000000 10000.000000 /end AXIS_PTS
/begin RECORD_LAYOUT KL_KM_IHIP_DIAG_S_n40_AXIS FIX_NO_AXIS_PTS_X 9 AXIS_PTS_X 0 UBYTE INDEX_INCR DIRECT /end RECORD_LAYOUT
/begin CHARACTERISTIC KL_KM_IHIP_DIAG_M "-" CURVE 0xB25 VALUE_KL_KM_IHIP_DIAG_M 100.000000 F00126 41.000000 561.000000
 /begin AXIS_DESCR COM_AXIS n40 F00109 9 0.000000 10000.000000 AXIS_PTS_REF KL_KM_IHIP_DIAG_M_n40_AXIS /end AXIS_DESCR
 FUNCTION_LIST Klopfen /end CHARACTERISTIC
/begin RECORD_LAYOUT VALUE_KL_KM_IHIP_DIAG_M FNC_VALUES 0 UBYTE ROW_DIR DIRECT /end RECORD_LAYOUT
/begin AXIS_PTS KL_KM_IHIP_DIAG_M_n40_AXIS "-" 0xB1C n40 KL_KM_IHIP_DIAG_M_n40_AXIS 100.000000 F00109 9 0.000000 10000.000000 /end AXIS_PTS
/begin RECORD_LAYOUT KL_KM_IHIP_DIAG_M_n40_AXIS FIX_NO_AXIS_PTS_X 9 AXIS_PTS_X 0 UBYTE INDEX_INCR DIRECT /end RECORD_LAYOUT
/begin CHARACTERISTIC KF_KM_DYN_KOMP "-" MAP 0xB40 VALUE_KF_KM_DYN_KOMP 100.000000 F00131 0.000000 7.000000
 /begin AXIS_DESCR COM_AXIS n40 F00109 10 0.000000 10000.000000 AXIS_PTS_REF KF_KM_DYN_KOMP_n40_AXIS /end AXIS_DESCR
 /begin AXIS_DESCR COM_AXIS rf5 F00116 6 0.000000 1.000000 AXIS_PTS_REF KF_KM_DYN_KOMP_rf5_AXIS /end AXIS_DESCR
 FUNCTION_LIST Klopfen /end CHARACTERISTIC
/begin RECORD_LAYOUT VALUE_KF_KM_DYN_KOMP FNC_VALUES 0 UBYTE ROW_DIR DIRECT /end RECORD_LAYOUT
/begin AXIS_PTS KF_KM_DYN_KOMP_n40_AXIS "-" 0xB30 n40 KF_KM_DYN_KOMP_n40_AXIS 100.000000 F00109 10 0.000000 10000.000000 /end AXIS_PTS
/begin RECORD_LAYOUT KF_KM_DYN_KOMP_n40_AXIS FIX_NO_AXIS_PTS_X 10 AXIS_PTS_X 0 UBYTE INDEX_INCR DIRECT /end RECORD_LAYOUT
/begin AXIS_PTS KF_KM_DYN_KOMP_rf5_AXIS "-" 0xB3A rf5 KF_KM_DYN_KOMP_rf5_AXIS 100.000000 F00116 6 0.000000 1.000000 /end AXIS_PTS
/begin RECORD_LAYOUT KF_KM_DYN_KOMP_rf5_AXIS FIX_NO_AXIS_PTS_Y 6 AXIS_PTS_Y 0 UBYTE INDEX_INCR DIRECT /end RECORD_LAYOUT
/begin CHARACTERISTIC KF_KM_FENSTER_A "-" MAP 0xB9A VALUE_KF_KM_FENSTER_A 100.000000 F00132 -30.000000 40.000000
 /begin AXIS_DESCR COM_AXIS n F00007 10 0.000000 10000.000000 AXIS_PTS_REF KF_KM_FENSTER_A_n_AXIS /end AXIS_DESCR
 /begin AXIS_DESCR COM_AXIS rf F00068 4 0.000000 2.000000 AXIS_PTS_REF KF_KM_FENSTER_A_rf_AXIS /end AXIS_DESCR
 FUNCTION_LIST Klopfen /end CHARACTERISTIC
/begin RECORD_LAYOUT VALUE_KF_KM_FENSTER_A FNC_VALUES 0 UWORD ROW_DIR DIRECT /end RECORD_LAYOUT
/begin AXIS_PTS KF_KM_FENSTER_A_n_AXIS "-" 0xB7E n KF_KM_FENSTER_A_n_AXIS 100.000000 F00007 10 0.000000 10000.000000 /end AXIS_PTS
/begin RECORD_LAYOUT KF_KM_FENSTER_A_n_AXIS FIX_NO_AXIS_PTS_X 10 AXIS_PTS_X 0 UWORD INDEX_INCR DIRECT /end RECORD_LAYOUT
/begin AXIS_PTS KF_KM_FENSTER_A_rf_AXIS "-" 0xB92 rf KF_KM_FENSTER_A_rf_AXIS 100.000000 F00068 4 0.000000 2.000000 /end AXIS_PTS
/begin RECORD_LAYOUT KF_KM_FENSTER_A_rf_AXIS FIX_NO_AXIS_PTS_Y 4 AXIS_PTS_Y 0 UWORD INDEX_INCR DIRECT /end RECORD_LAYOUT
/begin CHARACTERISTIC KL_KR_RF_MIN "-" CURVE 0x1098 VALUE_KL_KR_RF_MIN 100.000000 F00068 0.000000 2.000000
 /begin AXIS_DESCR COM_AXIS n F00007 10 0.000000 10000.000000 AXIS_PTS_REF KL_KR_RF_MIN_n_AXIS /end AXIS_DESCR
 FUNCTION_LIST Klopfen /end CHARACTERISTIC
/begin RECORD_LAYOUT VALUE_KL_KR_RF_MIN FNC_VALUES 0 UWORD ROW_DIR DIRECT /end RECORD_LAYOUT
/begin AXIS_PTS KL_KR_RF_MIN_n_AXIS "-" 0x1084 n KL_KR_RF_MIN_n_AXIS 100.000000 F00007 10 0.000000 10000.000000 /end AXIS_PTS
/begin RECORD_LAYOUT KL_KR_RF_MIN_n_AXIS FIX_NO_AXIS_PTS_X 10 AXIS_PTS_X 0 UWORD INDEX_INCR DIRECT /end RECORD_LAYOUT
/begin CHARACTERISTIC KL_KR_DTZ_AUF "-" CURVE 0x10B8 VALUE_KL_KR_DTZ_AUF 100.000000 F00045 0.000000 25.000000
 /begin AXIS_DESCR COM_AXIS n40 F00109 10 0.000000 10000.000000 AXIS_PTS_REF KL_KR_DTZ_AUF_n40_AXIS /end AXIS_DESCR
 FUNCTION_LIST Klopfen /end CHARACTERISTIC
/begin RECORD_LAYOUT VALUE_KL_KR_DTZ_AUF FNC_VALUES 0 UBYTE ROW_DIR DIRECT /end RECORD_LAYOUT
/begin AXIS_PTS KL_KR_DTZ_AUF_n40_AXIS "-" 0x10AE n40 KL_KR_DTZ_AUF_n40_AXIS 100.000000 F00109 10 0.000000 10000.000000 /end AXIS_PTS
/begin RECORD_LAYOUT KL_KR_DTZ_AUF_n40_AXIS FIX_NO_AXIS_PTS_X 10 AXIS_PTS_X 0 UBYTE INDEX_INCR DIRECT /end RECORD_LAYOUT
/begin CHARACTERISTIC KL_KR_DTZ_AUF_DYN "-" CURVE 0x10CE VALUE_KL_KR_DTZ_AUF_DYN 100.000000 F00045 0.000000 25.000000
 /begin AXIS_DESCR COM_AXIS n40 F00109 10 0.000000 10000.000000 AXIS_PTS_REF KL_KR_DTZ_AUF_DYN_n40_AXIS /end AXIS_DESCR
 FUNCTION_LIST Klopfen /end CHARACTERISTIC
/begin RECORD_LAYOUT VALUE_KL_KR_DTZ_AUF_DYN FNC_VALUES 0 UBYTE ROW_DIR DIRECT /end RECORD_LAYOUT
/begin AXIS_PTS KL_KR_DTZ_AUF_DYN_n40_AXIS "-" 0x10C4 n40 KL_KR_DTZ_AUF_DYN_n40_AXIS 100.000000 F00109 10 0.000000 10000.000000 /end AXIS_PTS
/begin RECORD_LAYOUT KL_KR_DTZ_AUF_DYN_n40_AXIS FIX_NO_AXIS_PTS_X 10 AXIS_PTS_X 0 UBYTE INDEX_INCR DIRECT /end RECORD_LAYOUT
/begin CHARACTERISTIC KL_KR_DTZ_AB "-" CURVE 0x10E4 VALUE_KL_KR_DTZ_AB 100.000000 F00045 0.000000 25.000000
 /begin AXIS_DESCR COM_AXIS n40 F00109 10 0.000000 10000.000000 AXIS_PTS_REF KL_KR_DTZ_AB_n40_AXIS /end AXIS_DESCR
 FUNCTION_LIST Klopfen /end CHARACTERISTIC
/begin RECORD_LAYOUT VALUE_KL_KR_DTZ_AB FNC_VALUES 0 UBYTE ROW_DIR DIRECT /end RECORD_LAYOUT
/begin AXIS_PTS KL_KR_DTZ_AB_n40_AXIS "-" 0x10DA n40 KL_KR_DTZ_AB_n40_AXIS 100.000000 F00109 10 0.000000 10000.000000 /end AXIS_PTS
/begin RECORD_LAYOUT KL_KR_DTZ_AB_n40_AXIS FIX_NO_AXIS_PTS_X 10 AXIS_PTS_X 0 UBYTE INDEX_INCR DIRECT /end RECORD_LAYOUT
/begin CHARACTERISTIC KL_KR_DTZ_AB_STARK "-" CURVE 0x10FA VALUE_KL_KR_DTZ_AB_STARK 100.000000 F00045 0.000000 25.000000
 /begin AXIS_DESCR COM_AXIS n40 F00109 10 0.000000 10000.000000 AXIS_PTS_REF KL_KR_DTZ_AB_STARK_n40_AXIS /end AXIS_DESCR
 FUNCTION_LIST Klopfen /end CHARACTERISTIC
/begin RECORD_LAYOUT VALUE_KL_KR_DTZ_AB_STARK FNC_VALUES 0 UBYTE ROW_DIR DIRECT /end RECORD_LAYOUT
/begin AXIS_PTS KL_KR_DTZ_AB_STARK_n40_AXIS "-" 0x10F0 n40 KL_KR_DTZ_AB_STARK_n40_AXIS 100.000000 F00109 10 0.000000 10000.000000 /end AXIS_PTS
/begin RECORD_LAYOUT KL_KR_DTZ_AB_STARK_n40_AXIS FIX_NO_AXIS_PTS_X 10 AXIS_PTS_X 0 UBYTE INDEX_INCR DIRECT /end RECORD_LAYOUT
/begin CHARACTERISTIC KL_KR_ANZ_AUF "-" CURVE 0x1110 VALUE_KL_KR_ANZ_AUF 100.000000 F00013 1.000000 255.000000
 /begin AXIS_DESCR COM_AXIS n40 F00109 10 0.000000 10000.000000 AXIS_PTS_REF KL_KR_ANZ_AUF_n40_AXIS /end AXIS_DESCR
 FUNCTION_LIST Klopfen /end CHARACTERISTIC
/begin RECORD_LAYOUT VALUE_KL_KR_ANZ_AUF FNC_VALUES 0 UBYTE ROW_DIR DIRECT /end RECORD_LAYOUT
/begin AXIS_PTS KL_KR_ANZ_AUF_n40_AXIS "-" 0x1106 n40 KL_KR_ANZ_AUF_n40_AXIS 100.000000 F00109 10 0.000000 10000.000000 /end AXIS_PTS
/begin RECORD_LAYOUT KL_KR_ANZ_AUF_n40_AXIS FIX_NO_AXIS_PTS_X 10 AXIS_PTS_X 0 UBYTE INDEX_INCR DIRECT /end RECORD_LAYOUT
/begin CHARACTERISTIC KL_KR_ANZ_AB "-" CURVE 0x1126 VALUE_KL_KR_ANZ_AB 100.000000 F00134 0.000000 1275.000000
 /begin AXIS_DESCR COM_AXIS n40 F00109 10 0.000000 10000.000000 AXIS_PTS_REF KL_KR_ANZ_AB_n40_AXIS /end AXIS_DESCR
 FUNCTION_LIST Klopfen /end CHARACTERISTIC
/begin RECORD_LAYOUT VALUE_KL_KR_ANZ_AB FNC_VALUES 0 UBYTE ROW_DIR DIRECT /end RECORD_LAYOUT
/begin AXIS_PTS KL_KR_ANZ_AB_n40_AXIS "-" 0x111C n40 KL_KR_ANZ_AB_n40_AXIS 100.000000 F00109 10 0.000000 10000.000000 /end AXIS_PTS
/begin RECORD_LAYOUT KL_KR_ANZ_AB_n40_AXIS FIX_NO_AXIS_PTS_X 10 AXIS_PTS_X 0 UBYTE INDEX_INCR DIRECT /end RECORD_LAYOUT
/begin CHARACTERISTIC KL_LFR_SOLL_MAX_LLS_ "-" CURVE 0x3A0 VALUE_KL_LFR_SOLL_MAX_LLS_ 100.000000 F00146 0.000000 100.000000
 /begin AXIS_DESCR COM_AXIS n F00007 6 0.000000 10000.000000 AXIS_PTS_REF KL_LFR_SOLL_MAX_LLS__n_AXIS /end AXIS_DESCR
 FUNCTION_LIST LEERLAUFREGLER /end CHARACTERISTIC
/begin RECORD_LAYOUT VALUE_KL_LFR_SOLL_MAX_LLS_ FNC_VALUES 0 UWORD ROW_DIR DIRECT /end RECORD_LAYOUT
/begin AXIS_PTS KL_LFR_SOLL_MAX_LLS__n_AXIS "-" 0x394 n KL_LFR_SOLL_MAX_LLS__n_AXIS 100.000000 F00007 6 0.000000 10000.000000 /end AXIS_PTS
/begin RECORD_LAYOUT KL_LFR_SOLL_MAX_LLS__n_AXIS FIX_NO_AXIS_PTS_X 6 AXIS_PTS_X 0 UWORD INDEX_INCR DIRECT /end RECORD_LAYOUT
/begin CHARACTERISTIC KL_LFR_SOLL_MAX_LLS "-" CURVE 0x3BA VALUE_KL_LFR_SOLL_MAX_LLS 100.000000 F00146 0.000000 100.000000
 /begin AXIS_DESCR COM_AXIS n F00007 6 0.000000 10000.000000 AXIS_PTS_REF KL_LFR_SOLL_MAX_LLS_n_AXIS /end AXIS_DESCR
 FUNCTION_LIST LEERLAUFREGLER /end CHARACTERISTIC
/begin RECORD_LAYOUT VALUE_KL_LFR_SOLL_MAX_LLS FNC_VALUES 0 UWORD ROW_DIR DIRECT /end RECORD_LAYOUT
/begin AXIS_PTS KL_LFR_SOLL_MAX_LLS_n_AXIS "-" 0x3AE n KL_LFR_SOLL_MAX_LLS_n_AXIS 100.000000 F00007 6 0.000000 10000.000000 /end AXIS_PTS
/begin RECORD_LAYOUT KL_LFR_SOLL_MAX_LLS_n_AXIS FIX_NO_AXIS_PTS_X 6 AXIS_PTS_X 0 UWORD INDEX_INCR DIRECT /end RECORD_LAYOUT
/begin CHARACTERISTIC KL_LFR_NSOLL_START "-" CURVE 0x3D8 VALUE_KL_LFR_NSOLL_START 100.000000 F00007 0.000000 10000.000000
 /begin AXIS_DESCR COM_AXIS tmot F00014 3 -48.000000 207.000000 AXIS_PTS_REF KL_LFR_NSOLL_START_tmot_AXIS /end AXIS_DESCR
 FUNCTION_LIST LEERLAUFREGLER /end CHARACTERISTIC
/begin RECORD_LAYOUT VALUE_KL_LFR_NSOLL_START FNC_VALUES 0 UWORD ROW_DIR DIRECT /end RECORD_LAYOUT
/begin AXIS_PTS KL_LFR_NSOLL_START_tmot_AXIS "-" 0x3D2 tmot KL_LFR_NSOLL_START_tmot_AXIS 100.000000 F00014 3 -48.000000 207.000000 /end AXIS_PTS
/begin RECORD_LAYOUT KL_LFR_NSOLL_START_tmot_AXIS FIX_NO_AXIS_PTS_X 3 AXIS_PTS_X 0 UWORD INDEX_INCR DIRECT /end RECORD_LAYOUT
/begin CHARACTERISTIC KL_LFR_NSOLL_GRUND "-" CURVE 0x3E8 VALUE_KL_LFR_NSOLL_GRUND 100.000000 F00007 0.000000 10000.000000
 /begin AXIS_DESCR COM_AXIS tmot F00014 4 -48.000000 207.000000 AXIS_PTS_REF KL_LFR_NSOLL_GRUND_tmot_AXIS /end AXIS_DESCR
 FUNCTION_LIST LEERLAUFREGLER /end CHARACTERISTIC
/begin RECORD_LAYOUT VALUE_KL_LFR_NSOLL_GRUND FNC_VALUES 0 UWORD ROW_DIR DIRECT /end RECORD_LAYOUT
/begin AXIS_PTS KL_LFR_NSOLL_GRUND_tmot_AXIS "-" 0x3E0 tmot KL_LFR_NSOLL_GRUND_tmot_AXIS 100.000000 F00014 4 -48.000000 207.000000 /end AXIS_PTS
/begin RECORD_LAYOUT KL_LFR_NSOLL_GRUND_tmot_AXIS FIX_NO_AXIS_PTS_X 4 AXIS_PTS_X 0 UWORD INDEX_INCR DIRECT /end RECORD_LAYOUT
/begin CHARACTERISTIC KL_LFR_NSOLL_OFFSET "-" CURVE 0x3FA VALUE_KL_LFR_NSOLL_OFFSET 100.000000 F00007 0.000000 10000.000000
 /begin AXIS_DESCR COM_AXIS tmot F00014 4 -48.000000 207.000000 AXIS_PTS_REF KL_LFR_NSOLL_OFFSET_tmot_AXIS /end AXIS_DESCR
 FUNCTION_LIST LEERLAUFREGLER /end CHARACTERISTIC
/begin RECORD_LAYOUT VALUE_KL_LFR_NSOLL_OFFSET FNC_VALUES 0 UWORD ROW_DIR DIRECT /end RECORD_LAYOUT
/begin AXIS_PTS KL_LFR_NSOLL_OFFSET_tmot_AXIS "-" 0x3F2 tmot KL_LFR_NSOLL_OFFSET_tmot_AXIS 100.000000 F00014 4 -48.000000 207.000000 /end AXIS_PTS
/begin RECORD_LAYOUT KL_LFR_NSOLL_OFFSET_tmot_AXIS FIX_NO_AXIS_PTS_X 4 AXIS_PTS_X 0 UWORD INDEX_INCR DIRECT /end RECORD_LAYOUT
/begin CHARACTERISTIC KL_LFR_TAU_NSOLL "-" CURVE 0x40C VALUE_KL_LFR_TAU_NSOLL 100.000000 F00147 5.000000 0.000000
 /begin AXIS_DESCR COM_AXIS tmot F00014 4 -48.000000 207.000000 AXIS_PTS_REF KL_LFR_TAU_NSOLL_tmot_AXIS /end AXIS_DESCR
 FUNCTION_LIST LEERLAUFREGLER /end CHARACTERISTIC
/begin RECORD_LAYOUT VALUE_KL_LFR_TAU_NSOLL FNC_VALUES 0 UWORD ROW_DIR DIRECT /end RECORD_LAYOUT
/begin AXIS_PTS KL_LFR_TAU_NSOLL_tmot_AXIS "-" 0x404 tmot KL_LFR_TAU_NSOLL_tmot_AXIS 100.000000 F00014 4 -48.000000 207.000000 /end AXIS_PTS
/begin RECORD_LAYOUT KL_LFR_TAU_NSOLL_tmot_AXIS FIX_NO_AXIS_PTS_X 4 AXIS_PTS_X 0 UWORD INDEX_INCR DIRECT /end RECORD_LAYOUT
/begin CHARACTERISTIC KL_LFR_RF_MIN "-" CURVE 0x42A VALUE_KL_LFR_RF_MIN 100.000000 F00068 0.000000 2.000000
 /begin AXIS_DESCR COM_AXIS tmot F00014 4 -48.000000 207.000000 AXIS_PTS_REF KL_LFR_RF_MIN_tmot_AXIS /end AXIS_DESCR
 FUNCTION_LIST LEERLAUFREGLER /end CHARACTERISTIC
/begin RECORD_LAYOUT VALUE_KL_LFR_RF_MIN FNC_VALUES 0 UWORD ROW_DIR DIRECT /end RECORD_LAYOUT
/begin AXIS_PTS KL_LFR_RF_MIN_tmot_AXIS "-" 0x422 tmot KL_LFR_RF_MIN_tmot_AXIS 100.000000 F00014 4 -48.000000 207.000000 /end AXIS_PTS
/begin RECORD_LAYOUT KL_LFR_RF_MIN_tmot_AXIS FIX_NO_AXIS_PTS_X 4 AXIS_PTS_X 0 UWORD INDEX_INCR DIRECT /end RECORD_LAYOUT
/begin CHARACTERISTIC KL_LFR_DQP_POS "-" CURVE 0x45A VALUE_KL_LFR_DQP_POS 100.000000 F00148 0.000000 50.000000
 /begin AXIS_DESCR COM_AXIS lfr.dn F00007 16 0.000000 10000.000000 AXIS_PTS_REF KL_LFR_DQP_POS_lfr.dn_AXIS /end AXIS_DESCR
 FUNCTION_LIST LEERLAUFREGLER /end CHARACTERISTIC
/begin RECORD_LAYOUT VALUE_KL_LFR_DQP_POS FNC_VALUES 0 UWORD ROW_DIR DIRECT /end RECORD_LAYOUT
/begin AXIS_PTS KL_LFR_DQP_POS_lfr.dn_AXIS "-" 0x43A lfr.dn KL_LFR_DQP_POS_lfr.dn_AXIS 100.000000 F00007 16 0.000000 10000.000000 /end AXIS_PTS
/begin RECORD_LAYOUT KL_LFR_DQP_POS_lfr.dn_AXIS FIX_NO_AXIS_PTS_X 16 AXIS_PTS_X 0 UWORD INDEX_INCR DIRECT /end RECORD_LAYOUT
/begin CHARACTERISTIC KL_LFR_DI_AFR "-" CURVE 0x49C VALUE_KL_LFR_DI_AFR 100.000000 F00149 -50.000000 50.000000
 /begin AXIS_DESCR COM_AXIS lfr.dn F00150 16 -10000.000000 10000.000000 AXIS_PTS_REF KL_LFR_DI_AFR_lfr.dn_AXIS /end AXIS_DESCR
 FUNCTION_LIST LEERLAUFREGLER /end CHARACTERISTIC
/begin RECORD_LAYOUT VALUE_KL_LFR_DI_AFR FNC_VALUES 0 SWORD ROW_DIR DIRECT /end RECORD_LAYOUT
/begin AXIS_PTS KL_LFR_DI_AFR_lfr.dn_AXIS "-" 0x47C lfr.dn KL_LFR_DI_AFR_lfr.dn_AXIS 100.000000 F00150 16 -10000.000000 10000.000000 /end AXIS_PTS
/begin RECORD_LAYOUT KL_LFR_DI_AFR_lfr.dn_AXIS FIX_NO_AXIS_PTS_X 16 AXIS_PTS_X 0 UWORD INDEX_INCR DIRECT /end RECORD_LAYOUT
/begin CHARACTERISTIC KL_LFR_DABR_AFR "-" CURVE 0x4DE VALUE_KL_LFR_DABR_AFR 100.000000 F00149 -50.000000 50.000000
 /begin AXIS_DESCR COM_AXIS lfr.dn F00150 16 -10000.000000 10000.000000 AXIS_PTS_REF KL_LFR_DABR_AFR_lfr.dn_AXIS /end AXIS_DESCR
 FUNCTION_LIST LEERLAUFREGLER /end CHARACTERISTIC
/begin RECORD_LAYOUT VALUE_KL_LFR_DABR_AFR FNC_VALUES 0 SWORD ROW_DIR DIRECT /end RECORD_LAYOUT
/begin AXIS_PTS KL_LFR_DABR_AFR_lfr.dn_AXIS "-" 0x4BE lfr.dn KL_LFR_DABR_AFR_lfr.dn_AXIS 100.000000 F00150 16 -10000.000000 10000.000000 /end AXIS_PTS
/begin RECORD_LAYOUT KL_LFR_DABR_AFR_lfr.dn_AXIS FIX_NO_AXIS_PTS_X 16 AXIS_PTS_X 0 UWORD INDEX_INCR DIRECT /end RECORD_LAYOUT
/begin CHARACTERISTIC KL_LFR_TZ_POS "-" CURVE 0x640 VALUE_KL_LFR_TZ_POS 100.000000 F00148 0.000000 50.000000
 /begin AXIS_DESCR COM_AXIS lfr.dn F00007 16 0.000000 10000.000000 AXIS_PTS_REF KL_LFR_TZ_POS_lfr.dn_AXIS /end AXIS_DESCR
 FUNCTION_LIST LEERLAUFREGLER /end CHARACTERISTIC
/begin RECORD_LAYOUT VALUE_KL_LFR_TZ_POS FNC_VALUES 0 UWORD ROW_DIR DIRECT /end RECORD_LAYOUT
/begin AXIS_PTS KL_LFR_TZ_POS_lfr.dn_AXIS "-" 0x620 lfr.dn KL_LFR_TZ_POS_lfr.dn_AXIS 100.000000 F00007 16 0.000000 10000.000000 /end AXIS_PTS
/begin RECORD_LAYOUT KL_LFR_TZ_POS_lfr.dn_AXIS FIX_NO_AXIS_PTS_X 16 AXIS_PTS_X 0 UWORD INDEX_INCR DIRECT /end RECORD_LAYOUT
/begin CHARACTERISTIC KL_LFR_TZ_NEG "-" CURVE 0x682 VALUE_KL_LFR_TZ_NEG 100.000000 F00148 0.000000 50.000000
 /begin AXIS_DESCR COM_AXIS lfr.dn F00151 16 0.000000 -10000.000000 AXIS_PTS_REF KL_LFR_TZ_NEG_lfr.dn_AXIS /end AXIS_DESCR
 FUNCTION_LIST LEERLAUFREGLER /end CHARACTERISTIC
/begin RECORD_LAYOUT VALUE_KL_LFR_TZ_NEG FNC_VALUES 0 UWORD ROW_DIR DIRECT /end RECORD_LAYOUT
/begin AXIS_PTS KL_LFR_TZ_NEG_lfr.dn_AXIS "-" 0x662 lfr.dn KL_LFR_TZ_NEG_lfr.dn_AXIS 100.000000 F00151 16 0.000000 -10000.000000 /end AXIS_PTS
/begin RECORD_LAYOUT KL_LFR_TZ_NEG_lfr.dn_AXIS FIX_NO_AXIS_PTS_X 16 AXIS_PTS_X 0 UWORD INDEX_INCR DIRECT /end RECORD_LAYOUT
/begin CHARACTERISTIC KL_LFR_I_AUF "-" CURVE 0x6AC VALUE_KL_LFR_I_AUF 100.000000 F00139 0.000000 100.000000
 /begin AXIS_DESCR COM_AXIS d_n F00152 4 -32768.000000 32767.000000 AXIS_PTS_REF KL_LFR_I_AUF_d_n_AXIS /end AXIS_DESCR
 FUNCTION_LIST LEERLAUFREGLER /end CHARACTERISTIC
/begin RECORD_LAYOUT VALUE_KL_LFR_I_AUF FNC_VALUES 0 UWORD ROW_DIR DIRECT /end RECORD_LAYOUT
/begin AXIS_PTS KL_LFR_I_AUF_d_n_AXIS "-" 0x6A4 d_n KL_LFR_I_AUF_d_n_AXIS 100.000000 F00152 4 -32768.000000 32767.000000 /end AXIS_PTS
/begin RECORD_LAYOUT KL_LFR_I_AUF_d_n_AXIS FIX_NO_AXIS_PTS_X 4 AXIS_PTS_X 0 UWORD INDEX_INCR DIRECT /end RECORD_LAYOUT
/begin CHARACTERISTIC KL_LFR_NSOLL_LB "-" CURVE 0x6DA VALUE_KL_LFR_NSOLL_LB 100.000000 F00007 0.000000 10000.000000
 /begin AXIS_DESCR /* dpr_lb_llr */ COM_AXIS dpr_lb_llr F00153 3 0.000000 100.000000 AXIS_PTS_REF KL_LFR_NSOLL_LB_dpr_lb_llr_AXIS /end AXIS_DESCR
 FUNCTION_LIST LEERLAUFREGLER /end CHARACTERISTIC
/begin RECORD_LAYOUT VALUE_KL_LFR_NSOLL_LB FNC_VALUES 0 UWORD ROW_DIR DIRECT /end RECORD_LAYOUT
/begin AXIS_PTS KL_LFR_NSOLL_LB_dpr_lb_llr_AXIS "-" 0x6D4 dpr_lb_llr KL_LFR_NSOLL_LB_dpr_lb_llr_AXIS 100.000000 F00153 3 0.000000 100.000000 /end AXIS_PTS
/begin RECORD_LAYOUT KL_LFR_NSOLL_LB_dpr_lb_llr_AXIS FIX_NO_AXIS_PTS_X 3 AXIS_PTS_X 0 UWORD INDEX_INCR DIRECT /end RECORD_LAYOUT
/begin CHARACTERISTIC KL_LFR_N_TOG "-" CURVE 0x708 VALUE_KL_LFR_N_TOG 100.000000 F00007 0.000000 10000.000000
 /begin AXIS_DESCR /* toel_wanne */ COM_AXIS toel_wanne F00154 5 -48.000000 130.000000 AXIS_PTS_REF KL_LFR_N_TOG_toel_wanne_AXIS /end AXIS_DESCR
 FUNCTION_LIST LEERLAUFREGLER /end CHARACTERISTIC
/begin RECORD_LAYOUT VALUE_KL_LFR_N_TOG FNC_VALUES 0 UWORD ROW_DIR DIRECT /end RECORD_LAYOUT
/begin AXIS_PTS KL_LFR_N_TOG_toel_wanne_AXIS "-" 0x6FE toel_wanne KL_LFR_N_TOG_toel_wanne_AXIS 100.000000 F00154 5 -48.000000 130.000000 /end AXIS_PTS
/begin RECORD_LAYOUT KL_LFR_N_TOG_toel_wanne_AXIS FIX_NO_AXIS_PTS_X 5 AXIS_PTS_X 0 UWORD INDEX_INCR DIRECT /end RECORD_LAYOUT
/begin CHARACTERISTIC KF_LFR_DQI "-" MAP 0x52E VALUE_KF_LFR_DQI 100.000000 F00155 -79.000000 79.000000
 /begin AXIS_DESCR COM_AXIS lfr.dn F00156 15 1000.000000 -64535.000000 AXIS_PTS_REF KF_LFR_DQI_lfr.dn_AXIS /end AXIS_DESCR
 /begin AXIS_DESCR COM_AXIS d_n F00152 8 -32768.000000 32767.000000 AXIS_PTS_REF KF_LFR_DQI_d_n_AXIS /end AXIS_DESCR
 FUNCTION_LIST LEERLAUFREGLER /end CHARACTERISTIC
/begin RECORD_LAYOUT VALUE_KF_LFR_DQI FNC_VALUES 0 SWORD ROW_DIR DIRECT /end RECORD_LAYOUT
/begin AXIS_PTS KF_LFR_DQI_lfr.dn_AXIS "-" 0x500 lfr.dn KF_LFR_DQI_lfr.dn_AXIS 100.000000 F00156 15 1000.000000 -64535.000000 /end AXIS_PTS
/begin RECORD_LAYOUT KF_LFR_DQI_lfr.dn_AXIS FIX_NO_AXIS_PTS_X 15 AXIS_PTS_X 0 UWORD INDEX_INCR DIRECT /end RECORD_LAYOUT
/begin AXIS_PTS KF_LFR_DQI_d_n_AXIS "-" 0x51E d_n KF_LFR_DQI_d_n_AXIS 100.000000 F00152 8 -32768.000000 32767.000000 /end AXIS_PTS
/begin RECORD_LAYOUT KF_LFR_DQI_d_n_AXIS FIX_NO_AXIS_PTS_Y 8 AXIS_PTS_Y 0 UWORD INDEX_INCR DIRECT /end RECORD_LAYOUT
/begin CHARACTERISTIC KL_LLR_QVS_START_TMO "-" CURVE 0xA24 VALUE_KL_LLR_QVS_START_TMO 100.000000 F00157 0.000000 127.000000
 /begin AXIS_DESCR COM_AXIS tmot F00014 6 -48.000000 207.000000 AXIS_PTS_REF KL_LLR_QVS_START_TMO_tmot_AXIS /end AXIS_DESCR
 FUNCTION_LIST Leerlaufregelung /end CHARACTERISTIC
/begin RECORD_LAYOUT VALUE_KL_LLR_QVS_START_TMO FNC_VALUES 0 UBYTE ROW_DIR DIRECT /end RECORD_LAYOUT
/begin AXIS_PTS KL_LLR_QVS_START_TMO_tmot_AXIS "-" 0xA1E tmot KL_LLR_QVS_START_TMO_tmot_AXIS 100.000000 F00014 6 -48.000000 207.000000 /end AXIS_PTS
/begin RECORD_LAYOUT KL_LLR_QVS_START_TMO_tmot_AXIS FIX_NO_AXIS_PTS_X 6 AXIS_PTS_X 0 UBYTE INDEX_INCR DIRECT /end RECORD_LAYOUT
/begin CHARACTERISTIC KL_LLR_QVS_START_N "-" CURVE 0xA2F VALUE_KL_LLR_QVS_START_N 100.000000 F00157 0.000000 127.000000
 /begin AXIS_DESCR COM_AXIS n40 F00109 3 0.000000 10000.000000 AXIS_PTS_REF KL_LLR_QVS_START_N_n40_AXIS /end AXIS_DESCR
 FUNCTION_LIST Leerlaufregelung /end CHARACTERISTIC
/begin RECORD_LAYOUT VALUE_KL_LLR_QVS_START_N FNC_VALUES 0 UBYTE ROW_DIR DIRECT /end RECORD_LAYOUT
/begin AXIS_PTS KL_LLR_QVS_START_N_n40_AXIS "-" 0xA2C n40 KL_LLR_QVS_START_N_n40_AXIS 100.000000 F00109 3 0.000000 10000.000000 /end AXIS_PTS
/begin RECORD_LAYOUT KL_LLR_QVS_START_N_n40_AXIS FIX_NO_AXIS_PTS_X 3 AXIS_PTS_X 0 UBYTE INDEX_INCR DIRECT /end RECORD_LAYOUT
/begin CHARACTERISTIC KL_LLR_TAU_VS_ABREG "-" CURVE 0xA39 VALUE_KL_LLR_TAU_VS_ABREG 100.000000 F00024 5.000000 0.000000
 /begin AXIS_DESCR COM_AXIS tmot F00014 3 -48.000000 207.000000 AXIS_PTS_REF KL_LLR_TAU_VS_ABREG_tmot_AXIS /end AXIS_DESCR
 FUNCTION_LIST Leerlaufregelung /end CHARACTERISTIC
/begin RECORD_LAYOUT VALUE_KL_LLR_TAU_VS_ABREG FNC_VALUES 0 UBYTE ROW_DIR DIRECT /end RECORD_LAYOUT
/begin AXIS_PTS KL_LLR_TAU_VS_ABREG_tmot_AXIS "-" 0xA36 tmot KL_LLR_TAU_VS_ABREG_tmot_AXIS 100.000000 F00014 3 -48.000000 207.000000 /end AXIS_PTS
/begin RECORD_LAYOUT KL_LLR_TAU_VS_ABREG_tmot_AXIS FIX_NO_AXIS_PTS_X 3 AXIS_PTS_X 0 UBYTE INDEX_INCR DIRECT /end RECORD_LAYOUT
/begin CHARACTERISTIC KL_LLR_TAU_VS_NST "-" CURVE 0xA43 VALUE_KL_LLR_TAU_VS_NST 100.000000 F00024 5.000000 0.000000
 /begin AXIS_DESCR COM_AXIS tmot F00014 5 -48.000000 207.000000 AXIS_PTS_REF KL_LLR_TAU_VS_NST_tmot_AXIS /end AXIS_DESCR
 FUNCTION_LIST Leerlaufregelung /end CHARACTERISTIC
/begin RECORD_LAYOUT VALUE_KL_LLR_TAU_VS_NST FNC_VALUES 0 UBYTE ROW_DIR DIRECT /end RECORD_LAYOUT
/begin AXIS_PTS KL_LLR_TAU_VS_NST_tmot_AXIS "-" 0xA3E tmot KL_LLR_TAU_VS_NST_tmot_AXIS 100.000000 F00014 5 -48.000000 207.000000 /end AXIS_PTS
/begin RECORD_LAYOUT KL_LLR_TAU_VS_NST_tmot_AXIS FIX_NO_AXIS_PTS_X 5 AXIS_PTS_X 0 UBYTE INDEX_INCR DIRECT /end RECORD_LAYOUT
/begin CHARACTERISTIC KF_LLR_QVS_GRUND "-" MAP 0x9FE VALUE_KF_LLR_QVS_GRUND 100.000000 F00157 0.000000 127.000000
 /begin AXIS_DESCR COM_AXIS n F00007 6 0.000000 10000.000000 AXIS_PTS_REF KF_LLR_QVS_GRUND_n_AXIS /end AXIS_DESCR
 /begin AXIS_DESCR COM_AXIS tmot F00014 5 -48.000000 207.000000 AXIS_PTS_REF KF_LLR_QVS_GRUND_tmot_AXIS /end AXIS_DESCR
 FUNCTION_LIST Leerlaufregelung /end CHARACTERISTIC
/begin RECORD_LAYOUT VALUE_KF_LLR_QVS_GRUND FNC_VALUES 0 UBYTE ROW_DIR DIRECT /end RECORD_LAYOUT
/begin AXIS_PTS KF_LLR_QVS_GRUND_n_AXIS "-" 0x9E8 n KF_LLR_QVS_GRUND_n_AXIS 100.000000 F00007 6 0.000000 10000.000000 /end AXIS_PTS
/begin RECORD_LAYOUT KF_LLR_QVS_GRUND_n_AXIS FIX_NO_AXIS_PTS_X 6 AXIS_PTS_X 0 UWORD INDEX_INCR DIRECT /end RECORD_LAYOUT
/begin AXIS_PTS KF_LLR_QVS_GRUND_tmot_AXIS "-" 0x9F4 tmot KF_LLR_QVS_GRUND_tmot_AXIS 100.000000 F00014 5 -48.000000 207.000000 /end AXIS_PTS
/begin RECORD_LAYOUT KF_LLR_QVS_GRUND_tmot_AXIS FIX_NO_AXIS_PTS_Y 5 AXIS_PTS_Y 0 UWORD INDEX_INCR DIRECT /end RECORD_LAYOUT
/begin CHARACTERISTIC KL_LLS_TV "-" CURVE 0x74A VALUE_KL_LLS_TV 100.000000 F00159 0.000000 100.000000
 /begin AXIS_DESCR /* ml_soll */ COM_AXIS ml_soll F00158 18 0.000000 120.000000 AXIS_PTS_REF KL_LLS_TV_ml_soll_AXIS /end AXIS_DESCR
 FUNCTION_LIST Leerlaufsteller /end CHARACTERISTIC
/begin RECORD_LAYOUT VALUE_KL_LLS_TV FNC_VALUES 0 UWORD ROW_DIR DIRECT /end RECORD_LAYOUT
/begin AXIS_PTS KL_LLS_TV_ml_soll_AXIS "-" 0x726 ml_soll KL_LLS_TV_ml_soll_AXIS 100.000000 F00158 18 0.000000 120.000000 /end AXIS_PTS
/begin RECORD_LAYOUT KL_LLS_TV_ml_soll_AXIS FIX_NO_AXIS_PTS_X 18 AXIS_PTS_X 0 UWORD INDEX_INCR DIRECT /end RECORD_LAYOUT
/begin CHARACTERISTIC KL_LLS_UB_KORR "-" CURVE 0x775 VALUE_KL_LLS_UB_KORR 100.000000 F00099 0.000000 1.000000
 /begin AXIS_DESCR COM_AXIS ub F00018 5 0.000000 20.000000 AXIS_PTS_REF KL_LLS_UB_KORR_ub_AXIS /end AXIS_DESCR
 FUNCTION_LIST Leerlaufsteller /end CHARACTERISTIC
/begin RECORD_LAYOUT VALUE_KL_LLS_UB_KORR FNC_VALUES 0 UBYTE ROW_DIR DIRECT /end RECORD_LAYOUT
/begin AXIS_PTS KL_LLS_UB_KORR_ub_AXIS "-" 0x770 ub KL_LLS_UB_KORR_ub_AXIS 100.000000 F00018 5 0.000000 20.000000 /end AXIS_PTS
/begin RECORD_LAYOUT KL_LLS_UB_KORR_ub_AXIS FIX_NO_AXIS_PTS_X 5 AXIS_PTS_X 0 UBYTE INDEX_INCR DIRECT /end RECORD_LAYOUT
/begin CHARACTERISTIC KF_LLS_TV "-" MAP 0x7AA VALUE_KF_LLS_TV 100.000000 F00159 0.000000 100.000000
 /begin AXIS_DESCR COM_AXIS n F00007 10 0.000000 10000.000000 AXIS_PTS_REF KF_LLS_TV_n_AXIS /end AXIS_DESCR
 /begin AXIS_DESCR /* ml_lls */ COM_AXIS ml_lls F00146 13 0.000000 1400.000000 AXIS_PTS_REF KF_LLS_TV_ml_lls_AXIS /end AXIS_DESCR
 FUNCTION_LIST Leerlaufsteller /end CHARACTERISTIC
/begin RECORD_LAYOUT VALUE_KF_LLS_TV FNC_VALUES 0 UWORD ROW_DIR DIRECT /end RECORD_LAYOUT
/begin AXIS_PTS KF_LLS_TV_n_AXIS "-" 0x77C n KF_LLS_TV_n_AXIS 100.000000 F00007 10 0.000000 10000.000000 /end AXIS_PTS
/begin RECORD_LAYOUT KF_LLS_TV_n_AXIS FIX_NO_AXIS_PTS_X 10 AXIS_PTS_X 0 UWORD INDEX_INCR DIRECT /end RECORD_LAYOUT
/begin AXIS_PTS KF_LLS_TV_ml_lls_AXIS "-" 0x790 ml_lls KF_LLS_TV_ml_lls_AXIS 100.000000 F00146 13 0.000000 1400.000000 /end AXIS_PTS
/begin RECORD_LAYOUT KF_LLS_TV_ml_lls_AXIS FIX_NO_AXIS_PTS_Y 13 AXIS_PTS_Y 0 UWORD INDEX_INCR DIRECT /end RECORD_LAYOUT
/begin CHARACTERISTIC KF_LLS_TV_KATH "-" MAP 0x8DE VALUE_KF_LLS_TV_KATH 100.000000 F00159 0.000000 100.000000
 /begin AXIS_DESCR COM_AXIS n F00007 10 0.000000 10000.000000 AXIS_PTS_REF KF_LLS_TV_KATH_n_AXIS /end AXIS_DESCR
 /begin AXIS_DESCR /* ml_lls */ COM_AXIS ml_lls F00146 13 0.000000 1400.000000 AXIS_PTS_REF KF_LLS_TV_KATH_ml_lls_AXIS /end AXIS_DESCR
 FUNCTION_LIST Leerlaufsteller /end CHARACTERISTIC
/begin RECORD_LAYOUT VALUE_KF_LLS_TV_KATH FNC_VALUES 0 UWORD ROW_DIR DIRECT /end RECORD_LAYOUT
/begin AXIS_PTS KF_LLS_TV_KATH_n_AXIS "-" 0x8B0 n KF_LLS_TV_KATH_n_AXIS 100.000000 F00007 10 0.000000 10000.000000 /end AXIS_PTS
/begin RECORD_LAYOUT KF_LLS_TV_KATH_n_AXIS FIX_NO_AXIS_PTS_X 10 AXIS_PTS_X 0 UWORD INDEX_INCR DIRECT /end RECORD_LAYOUT
/begin AXIS_PTS KF_LLS_TV_KATH_ml_lls_AXIS "-" 0x8C4 ml_lls KF_LLS_TV_KATH_ml_lls_AXIS 100.000000 F00146 13 0.000000 1400.000000 /end AXIS_PTS
/begin RECORD_LAYOUT KF_LLS_TV_KATH_ml_lls_AXIS FIX_NO_AXIS_PTS_Y 13 AXIS_PTS_Y 0 UWORD INDEX_INCR DIRECT /end RECORD_LAYOUT
/begin CHARACTERISTIC KL_MD_MAX_MD_LA "-" CURVE 0x2838 VALUE_KL_MD_MAX_MD_LA 100.000000 F00056 0.000000 1.000000
 /begin AXIS_DESCR /* faktor */ COM_AXIS faktor F00056 8 0.000000 1.000000 AXIS_PTS_REF KL_MD_MAX_MD_LA_faktor_AXIS /end AXIS_DESCR
 FUNCTION_LIST Momentenmanager /end CHARACTERISTIC
/begin RECORD_LAYOUT VALUE_KL_MD_MAX_MD_LA FNC_VALUES 0 UBYTE ROW_DIR DIRECT /end RECORD_LAYOUT
/begin AXIS_PTS KL_MD_MAX_MD_LA_faktor_AXIS "-" 0x2830 faktor KL_MD_MAX_MD_LA_faktor_AXIS 100.000000 F00056 8 0.000000 1.000000 /end AXIS_PTS
/begin RECORD_LAYOUT KL_MD_MAX_MD_LA_faktor_AXIS FIX_NO_AXIS_PTS_X 8 AXIS_PTS_X 0 UBYTE INDEX_INCR DIRECT /end RECORD_LAYOUT
/begin CHARACTERISTIC KL_MD_MAX_VL_RF_SU1 "-" CURVE 0x2866 VALUE_KL_MD_MAX_VL_RF_SU1 100.000000 F00068 0.000000 2.000000
 /begin AXIS_DESCR COM_AXIS n F00007 18 0.000000 10000.000000 AXIS_PTS_REF KL_MD_MAX_VL_RF_SU1_n_AXIS /end AXIS_DESCR
 FUNCTION_LIST Momentenmanager /end CHARACTERISTIC
/begin RECORD_LAYOUT VALUE_KL_MD_MAX_VL_RF_SU1 FNC_VALUES 0 UWORD ROW_DIR DIRECT /end RECORD_LAYOUT
/begin AXIS_PTS KL_MD_MAX_VL_RF_SU1_n_AXIS "-" 0x2842 n KL_MD_MAX_VL_RF_SU1_n_AXIS 100.000000 F00007 18 0.000000 10000.000000 /end AXIS_PTS
/begin RECORD_LAYOUT KL_MD_MAX_VL_RF_SU1_n_AXIS FIX_NO_AXIS_PTS_X 18 AXIS_PTS_X 0 UWORD INDEX_INCR DIRECT /end RECORD_LAYOUT
/begin CHARACTERISTIC KL_MD_MIN_DN_HYP "-" CURVE 0x2DAA VALUE_KL_MD_MIN_DN_HYP 100.000000 F00007 0.000000 10000.000000
 /begin AXIS_DESCR COM_AXIS tmot F00014 3 -48.000000 207.000000 AXIS_PTS_REF KL_MD_MIN_DN_HYP_tmot_AXIS /end AXIS_DESCR
 FUNCTION_LIST Momentenmanager /end CHARACTERISTIC
/begin RECORD_LAYOUT VALUE_KL_MD_MIN_DN_HYP FNC_VALUES 0 UWORD ROW_DIR DIRECT /end RECORD_LAYOUT
/begin AXIS_PTS KL_MD_MIN_DN_HYP_tmot_AXIS "-" 0x2DA4 tmot KL_MD_MIN_DN_HYP_tmot_AXIS 100.000000 F00014 3 -48.000000 207.000000 /end AXIS_PTS
/begin RECORD_LAYOUT KL_MD_MIN_DN_HYP_tmot_AXIS FIX_NO_AXIS_PTS_X 3 AXIS_PTS_X 0 UWORD INDEX_INCR DIRECT /end RECORD_LAYOUT
/begin CHARACTERISTIC KL_MD_MIN_REIB_OFFSE "-" CURVE 0x2DBA VALUE_KL_MD_MIN_REIB_OFFSE 100.000000 F00184 0.000000 100.000000
 /begin AXIS_DESCR COM_AXIS tmot F00014 4 -48.000000 207.000000 AXIS_PTS_REF KL_MD_MIN_REIB_OFFSE_tmot_AXIS /end AXIS_DESCR
 FUNCTION_LIST Momentenmanager /end CHARACTERISTIC
/begin RECORD_LAYOUT VALUE_KL_MD_MIN_REIB_OFFSE FNC_VALUES 0 UWORD ROW_DIR DIRECT /end RECORD_LAYOUT
/begin AXIS_PTS KL_MD_MIN_REIB_OFFSE_tmot_AXIS "-" 0x2DB2 tmot KL_MD_MIN_REIB_OFFSE_tmot_AXIS 100.000000 F00014 4 -48.000000 207.000000 /end AXIS_PTS
/begin RECORD_LAYOUT KL_MD_MIN_REIB_OFFSE_tmot_AXIS FIX_NO_AXIS_PTS_X 4 AXIS_PTS_X 0 UWORD INDEX_INCR DIRECT /end RECORD_LAYOUT
/begin CHARACTERISTIC KL_MD_MIN_REIB_ABREG "-" CURVE 0x2DCC VALUE_KL_MD_MIN_REIB_ABREG 100.000000 F00185 0.000000 100.000000
 /begin AXIS_DESCR COM_AXIS tmot F00014 4 -48.000000 207.000000 AXIS_PTS_REF KL_MD_MIN_REIB_ABREG_tmot_AXIS /end AXIS_DESCR
 FUNCTION_LIST Momentenmanager /end CHARACTERISTIC
/begin RECORD_LAYOUT VALUE_KL_MD_MIN_REIB_ABREG FNC_VALUES 0 UWORD ROW_DIR DIRECT /end RECORD_LAYOUT
/begin AXIS_PTS KL_MD_MIN_REIB_ABREG_tmot_AXIS "-" 0x2DC4 tmot KL_MD_MIN_REIB_ABREG_tmot_AXIS 100.000000 F00014 4 -48.000000 207.000000 /end AXIS_PTS
/begin RECORD_LAYOUT KL_MD_MIN_REIB_ABREG_tmot_AXIS FIX_NO_AXIS_PTS_X 4 AXIS_PTS_X 0 UWORD INDEX_INCR DIRECT /end RECORD_LAYOUT
/begin CHARACTERISTIC KL_MD_LS_W_GANG "-" CURVE 0x2E78 VALUE_KL_MD_LS_W_GANG 100.000000 F00085 0.000000 30.000000
 /begin AXIS_DESCR COM_AXIS gang F00013 8 0.000000 10.000000 AXIS_PTS_REF KL_MD_LS_W_GANG_gang_AXIS /end AXIS_DESCR
 FUNCTION_LIST Momentenmanager /end CHARACTERISTIC
/begin RECORD_LAYOUT VALUE_KL_MD_LS_W_GANG FNC_VALUES 0 UWORD ROW_DIR DIRECT /end RECORD_LAYOUT
/begin AXIS_PTS KL_MD_LS_W_GANG_gang_AXIS "-" 0x2E68 gang KL_MD_LS_W_GANG_gang_AXIS 100.000000 F00013 8 0.000000 10.000000 /end AXIS_PTS
/begin RECORD_LAYOUT KL_MD_LS_W_GANG_gang_AXIS FIX_NO_AXIS_PTS_X 8 AXIS_PTS_X 0 UWORD INDEX_INCR DIRECT /end RECORD_LAYOUT
/begin CHARACTERISTIC KL_MD_W_GANG_DASHPOT "-" CURVE 0x2E9A VALUE_KL_MD_W_GANG_DASHPOT 100.000000 F00085 0.000000 30.000000
 /begin AXIS_DESCR COM_AXIS gang F00013 8 0.000000 10.000000 AXIS_PTS_REF KL_MD_W_GANG_DASHPOT_gang_AXIS /end AXIS_DESCR
 FUNCTION_LIST Momentenmanager /end CHARACTERISTIC
/begin RECORD_LAYOUT VALUE_KL_MD_W_GANG_DASHPOT FNC_VALUES 0 UWORD ROW_DIR DIRECT /end RECORD_LAYOUT
/begin AXIS_PTS KL_MD_W_GANG_DASHPOT_gang_AXIS "-" 0x2E8A gang KL_MD_W_GANG_DASHPOT_gang_AXIS 100.000000 F00013 8 0.000000 10.000000 /end AXIS_PTS
/begin RECORD_LAYOUT KL_MD_W_GANG_DASHPOT_gang_AXIS FIX_NO_AXIS_PTS_X 8 AXIS_PTS_X 0 UWORD INDEX_INCR DIRECT /end RECORD_LAYOUT
/begin CHARACTERISTIC KL_V_MAX_GANG "-" CURVE 0x2EBC VALUE_KL_V_MAX_GANG 100.000000 F00079 0.000000 360.000000
 /begin AXIS_DESCR COM_AXIS gang F00013 8 0.000000 10.000000 AXIS_PTS_REF KL_V_MAX_GANG_gang_AXIS /end AXIS_DESCR
 FUNCTION_LIST Momentenmanager /end CHARACTERISTIC
/begin RECORD_LAYOUT VALUE_KL_V_MAX_GANG FNC_VALUES 0 UWORD ROW_DIR DIRECT /end RECORD_LAYOUT
/begin AXIS_PTS KL_V_MAX_GANG_gang_AXIS "-" 0x2EAC gang KL_V_MAX_GANG_gang_AXIS 100.000000 F00013 8 0.000000 10.000000 /end AXIS_PTS
/begin RECORD_LAYOUT KL_V_MAX_GANG_gang_AXIS FIX_NO_AXIS_PTS_X 8 AXIS_PTS_X 0 UWORD INDEX_INCR DIRECT /end RECORD_LAYOUT
/begin CHARACTERISTIC KL_MD_DASHPOT_DMD "-" CURVE 0x2FFE VALUE_KL_MD_DASHPOT_DMD 100.000000 F00085 0.000000 30.000000
 /begin AXIS_DESCR COM_AXIS d_mdrel F00040 5 0.000000 327675.000000 AXIS_PTS_REF KL_MD_DASHPOT_DMD_d_mdrel_AXIS /end AXIS_DESCR
 FUNCTION_LIST Momentenmanager /end CHARACTERISTIC
/begin RECORD_LAYOUT VALUE_KL_MD_DASHPOT_DMD FNC_VALUES 0 UWORD ROW_DIR DIRECT /end RECORD_LAYOUT
/begin AXIS_PTS KL_MD_DASHPOT_DMD_d_mdrel_AXIS "-" 0x2FF4 d_mdrel KL_MD_DASHPOT_DMD_d_mdrel_AXIS 100.000000 F00040 5 0.000000 327675.000000 /end AXIS_PTS
/begin RECORD_LAYOUT KL_MD_DASHPOT_DMD_d_mdrel_AXIS FIX_NO_AXIS_PTS_X 5 AXIS_PTS_X 0 UWORD INDEX_INCR DIRECT /end RECORD_LAYOUT
/begin CHARACTERISTIC KL_MD_LS_DMD "-" CURVE 0x3014 VALUE_KL_MD_LS_DMD 100.000000 F00085 0.000000 30.000000
 /begin AXIS_DESCR COM_AXIS d_mdrel F00040 5 0.000000 327675.000000 AXIS_PTS_REF KL_MD_LS_DMD_d_mdrel_AXIS /end AXIS_DESCR
 FUNCTION_LIST Momentenmanager /end CHARACTERISTIC
/begin RECORD_LAYOUT VALUE_KL_MD_LS_DMD FNC_VALUES 0 UWORD ROW_DIR DIRECT /end RECORD_LAYOUT
/begin AXIS_PTS KL_MD_LS_DMD_d_mdrel_AXIS "-" 0x300A d_mdrel KL_MD_LS_DMD_d_mdrel_AXIS 100.000000 F00040 5 0.000000 327675.000000 /end AXIS_PTS
/begin RECORD_LAYOUT KL_MD_LS_DMD_d_mdrel_AXIS FIX_NO_AXIS_PTS_X 5 AXIS_PTS_X 0 UWORD INDEX_INCR DIRECT /end RECORD_LAYOUT
/begin CHARACTERISTIC KL_MD_BEGR_GANG "-" CURVE 0x3132 VALUE_KL_MD_BEGR_GANG 100.000000 F00145 0.000000 1000.000000
 /begin AXIS_DESCR COM_AXIS gang F00013 8 0.000000 10.000000 AXIS_PTS_REF KL_MD_BEGR_GANG_gang_AXIS /end AXIS_DESCR
 FUNCTION_LIST Momentenmanager /end CHARACTERISTIC
/begin RECORD_LAYOUT VALUE_KL_MD_BEGR_GANG FNC_VALUES 0 UWORD ROW_DIR DIRECT /end RECORD_LAYOUT
/begin AXIS_PTS KL_MD_BEGR_GANG_gang_AXIS "-" 0x3122 gang KL_MD_BEGR_GANG_gang_AXIS 100.000000 F00013 8 0.000000 10.000000 /end AXIS_PTS
/begin RECORD_LAYOUT KL_MD_BEGR_GANG_gang_AXIS FIX_NO_AXIS_PTS_X 8 AXIS_PTS_X 0 UWORD INDEX_INCR DIRECT /end RECORD_LAYOUT
/begin CHARACTERISTIC KL_MD_BEGR_NOISE "-" CURVE 0x314A VALUE_KL_MD_BEGR_NOISE 100.000000 F00145 0.000000 1000.000000
 /begin AXIS_DESCR /* v_asc */ COM_AXIS v_asc F00079 3 0.000000 360.000000 AXIS_PTS_REF KL_MD_BEGR_NOISE_v_asc_AXIS /end AXIS_DESCR
 FUNCTION_LIST Momentenmanager /end CHARACTERISTIC
/begin RECORD_LAYOUT VALUE_KL_MD_BEGR_NOISE FNC_VALUES 0 UWORD ROW_DIR DIRECT /end RECORD_LAYOUT
/begin AXIS_PTS KL_MD_BEGR_NOISE_v_asc_AXIS "-" 0x3144 v_asc KL_MD_BEGR_NOISE_v_asc_AXIS 100.000000 F00079 3 0.000000 360.000000 /end AXIS_PTS
/begin RECORD_LAYOUT KL_MD_BEGR_NOISE_v_asc_AXIS FIX_NO_AXIS_PTS_X 3 AXIS_PTS_X 0 UWORD INDEX_INCR DIRECT /end RECORD_LAYOUT
/begin CHARACTERISTIC KL_MD_JFZ_GANG "-" CURVE 0x316A VALUE_KL_MD_JFZ_GANG 100.000000 F00169 0.000000 244.000000
 /begin AXIS_DESCR COM_AXIS gang F00013 8 0.000000 10.000000 AXIS_PTS_REF KL_MD_JFZ_GANG_gang_AXIS /end AXIS_DESCR
 FUNCTION_LIST Momentenmanager /end CHARACTERISTIC
/begin RECORD_LAYOUT VALUE_KL_MD_JFZ_GANG FNC_VALUES 0 UWORD ROW_DIR DIRECT /end RECORD_LAYOUT
/begin AXIS_PTS KL_MD_JFZ_GANG_gang_AXIS "-" 0x315A gang KL_MD_JFZ_GANG_gang_AXIS 100.000000 F00013 8 0.000000 10.000000 /end AXIS_PTS
/begin RECORD_LAYOUT KL_MD_JFZ_GANG_gang_AXIS FIX_NO_AXIS_PTS_X 8 AXIS_PTS_X 0 UWORD INDEX_INCR DIRECT /end RECORD_LAYOUT
/begin CHARACTERISTIC KL_MD_NBEGR_I "-" CURVE 0x3184 VALUE_KL_MD_NBEGR_I 100.000000 F00186 0.000000 9.000000
 /begin AXIS_DESCR COM_AXIS gang F00013 8 0.000000 10.000000 AXIS_PTS_REF KL_MD_NBEGR_I_gang_AXIS /end AXIS_DESCR
 FUNCTION_LIST Momentenmanager /end CHARACTERISTIC
/begin RECORD_LAYOUT VALUE_KL_MD_NBEGR_I FNC_VALUES 0 UBYTE ROW_DIR DIRECT /end RECORD_LAYOUT
/begin AXIS_PTS KL_MD_NBEGR_I_gang_AXIS "-" 0x317C gang KL_MD_NBEGR_I_gang_AXIS 100.000000 F00013 8 0.000000 10.000000 /end AXIS_PTS
/begin RECORD_LAYOUT KL_MD_NBEGR_I_gang_AXIS FIX_NO_AXIS_PTS_X 8 AXIS_PTS_X 0 UBYTE INDEX_INCR DIRECT /end RECORD_LAYOUT
/begin CHARACTERISTIC KL_MD_NBEGR_P "-" CURVE 0x3196 VALUE_KL_MD_NBEGR_P 100.000000 F00187 0.000000 25.000000
 /begin AXIS_DESCR COM_AXIS gang F00013 8 0.000000 10.000000 AXIS_PTS_REF KL_MD_NBEGR_P_gang_AXIS /end AXIS_DESCR
 FUNCTION_LIST Momentenmanager /end CHARACTERISTIC
/begin RECORD_LAYOUT VALUE_KL_MD_NBEGR_P FNC_VALUES 0 UBYTE ROW_DIR DIRECT /end RECORD_LAYOUT
/begin AXIS_PTS KL_MD_NBEGR_P_gang_AXIS "-" 0x318E gang KL_MD_NBEGR_P_gang_AXIS 100.000000 F00013 8 0.000000 10.000000 /end AXIS_PTS
/begin RECORD_LAYOUT KL_MD_NBEGR_P_gang_AXIS FIX_NO_AXIS_PTS_X 8 AXIS_PTS_X 0 UBYTE INDEX_INCR DIRECT /end RECORD_LAYOUT
/begin CHARACTERISTIC KL_MD_NBEGR_RAMPE "-" CURVE 0x31AC VALUE_KL_MD_NBEGR_RAMPE 100.000000 F00181 0.000000 10000.000000
 /begin AXIS_DESCR COM_AXIS dn F00142 3 0.000000 10000.000000 AXIS_PTS_REF KL_MD_NBEGR_RAMPE_dn_AXIS /end AXIS_DESCR
 FUNCTION_LIST Momentenmanager /end CHARACTERISTIC
/begin RECORD_LAYOUT VALUE_KL_MD_NBEGR_RAMPE FNC_VALUES 0 UWORD ROW_DIR DIRECT /end RECORD_LAYOUT
/begin AXIS_PTS KL_MD_NBEGR_RAMPE_dn_AXIS "-" 0x31A6 dn KL_MD_NBEGR_RAMPE_dn_AXIS 100.000000 F00142 3 0.000000 10000.000000 /end AXIS_PTS
/begin RECORD_LAYOUT KL_MD_NBEGR_RAMPE_dn_AXIS FIX_NO_AXIS_PTS_X 3 AXIS_PTS_X 0 UWORD INDEX_INCR DIRECT /end RECORD_LAYOUT
/begin CHARACTERISTIC KL_MD_BEGR_AUSS "-" CURVE 0x31BE VALUE_KL_MD_BEGR_AUSS 100.000000 F00145 0.000000 1000.000000
 /begin AXIS_DESCR COM_AXIS n F00007 5 0.000000 10000.000000 AXIS_PTS_REF KL_MD_BEGR_AUSS_n_AXIS /end AXIS_DESCR
 FUNCTION_LIST Momentenmanager /end CHARACTERISTIC
/begin RECORD_LAYOUT VALUE_KL_MD_BEGR_AUSS FNC_VALUES 0 UWORD ROW_DIR DIRECT /end RECORD_LAYOUT
/begin AXIS_PTS KL_MD_BEGR_AUSS_n_AXIS "-" 0x31B4 n KL_MD_BEGR_AUSS_n_AXIS 100.000000 F00007 5 0.000000 10000.000000 /end AXIS_PTS
/begin RECORD_LAYOUT KL_MD_BEGR_AUSS_n_AXIS FIX_NO_AXIS_PTS_X 5 AXIS_PTS_X 0 UWORD INDEX_INCR DIRECT /end RECORD_LAYOUT
/begin CHARACTERISTIC KL_MD_BEGR_FST "-" CURVE 0x31D4 VALUE_KL_MD_BEGR_FST 100.000000 F00145 0.000000 1000.000000
 /begin AXIS_DESCR COM_AXIS n F00007 5 0.000000 10000.000000 AXIS_PTS_REF KL_MD_BEGR_FST_n_AXIS /end AXIS_DESCR
 FUNCTION_LIST Momentenmanager /end CHARACTERISTIC
/begin RECORD_LAYOUT VALUE_KL_MD_BEGR_FST FNC_VALUES 0 UWORD ROW_DIR DIRECT /end RECORD_LAYOUT
/begin AXIS_PTS KL_MD_BEGR_FST_n_AXIS "-" 0x31CA n KL_MD_BEGR_FST_n_AXIS 100.000000 F00007 5 0.000000 10000.000000 /end AXIS_PTS
/begin RECORD_LAYOUT KL_MD_BEGR_FST_n_AXIS FIX_NO_AXIS_PTS_X 5 AXIS_PTS_X 0 UWORD INDEX_INCR DIRECT /end RECORD_LAYOUT
/begin CHARACTERISTIC KL_MD_DETA_KR_UP "-" CURVE 0x3206 VALUE_KL_MD_DETA_KR_UP 100.000000 F00188 0.000000 100.000000
 /begin AXIS_DESCR COM_AXIS n F00007 5 0.000000 10000.000000 AXIS_PTS_REF KL_MD_DETA_KR_UP_n_AXIS /end AXIS_DESCR
 FUNCTION_LIST Momentenmanager /end CHARACTERISTIC
/begin RECORD_LAYOUT VALUE_KL_MD_DETA_KR_UP FNC_VALUES 0 UWORD ROW_DIR DIRECT /end RECORD_LAYOUT
/begin AXIS_PTS KL_MD_DETA_KR_UP_n_AXIS "-" 0x31FC n KL_MD_DETA_KR_UP_n_AXIS 100.000000 F00007 5 0.000000 10000.000000 /end AXIS_PTS
/begin RECORD_LAYOUT KL_MD_DETA_KR_UP_n_AXIS FIX_NO_AXIS_PTS_X 5 AXIS_PTS_X 0 UWORD INDEX_INCR DIRECT /end RECORD_LAYOUT
/begin CHARACTERISTIC KL_MD_DETA_KR_DOWN "-" CURVE 0x321C VALUE_KL_MD_DETA_KR_DOWN 100.000000 F00188 0.000000 100.000000
 /begin AXIS_DESCR COM_AXIS n F00007 5 0.000000 10000.000000 AXIS_PTS_REF KL_MD_DETA_KR_DOWN_n_AXIS /end AXIS_DESCR
 FUNCTION_LIST Momentenmanager /end CHARACTERISTIC
/begin RECORD_LAYOUT VALUE_KL_MD_DETA_KR_DOWN FNC_VALUES 0 UWORD ROW_DIR DIRECT /end RECORD_LAYOUT
/begin AXIS_PTS KL_MD_DETA_KR_DOWN_n_AXIS "-" 0x3212 n KL_MD_DETA_KR_DOWN_n_AXIS 100.000000 F00007 5 0.000000 10000.000000 /end AXIS_PTS
/begin RECORD_LAYOUT KL_MD_DETA_KR_DOWN_n_AXIS FIX_NO_AXIS_PTS_X 5 AXIS_PTS_X 0 UWORD INDEX_INCR DIRECT /end RECORD_LAYOUT
/begin CHARACTERISTIC KL_MD_RES_LRW "-" CURVE 0x33B0 VALUE_KL_MD_RES_LRW 100.000000 F00145 0.000000 1000.000000
 /begin AXIS_DESCR /* can_lw */ COM_AXIS can_lw F00001 4 0.000000 1433.000000 AXIS_PTS_REF KL_MD_RES_LRW_can_lw_AXIS /end AXIS_DESCR
 FUNCTION_LIST Momentenmanager /end CHARACTERISTIC
/begin RECORD_LAYOUT VALUE_KL_MD_RES_LRW FNC_VALUES 0 UWORD ROW_DIR DIRECT /end RECORD_LAYOUT
/begin AXIS_PTS KL_MD_RES_LRW_can_lw_AXIS "-" 0x33A8 can_lw KL_MD_RES_LRW_can_lw_AXIS 100.000000 F00001 4 0.000000 1433.000000 /end AXIS_PTS
/begin RECORD_LAYOUT KL_MD_RES_LRW_can_lw_AXIS FIX_NO_AXIS_PTS_X 4 AXIS_PTS_X 0 UWORD INDEX_INCR DIRECT /end RECORD_LAYOUT
/begin CHARACTERISTIC KL_NMAX_PROFIL_DI "-" CURVE 0x33C4 VALUE_KL_NMAX_PROFIL_DI 100.000000 F00189 -327680.000000 327670.000000
 /begin AXIS_DESCR COM_AXIS n F00007 5 0.000000 10000.000000 AXIS_PTS_REF KL_NMAX_PROFIL_DI_n_AXIS /end AXIS_DESCR
 FUNCTION_LIST Momentenmanager /end CHARACTERISTIC
/begin RECORD_LAYOUT VALUE_KL_NMAX_PROFIL_DI FNC_VALUES 0 SWORD ROW_DIR DIRECT /end RECORD_LAYOUT
/begin AXIS_PTS KL_NMAX_PROFIL_DI_n_AXIS "-" 0x33BA n KL_NMAX_PROFIL_DI_n_AXIS 100.000000 F00007 5 0.000000 10000.000000 /end AXIS_PTS
/begin RECORD_LAYOUT KL_NMAX_PROFIL_DI_n_AXIS FIX_NO_AXIS_PTS_X 5 AXIS_PTS_X 0 UWORD INDEX_INCR DIRECT /end RECORD_LAYOUT
/begin CHARACTERISTIC KF_MD_KKOS_E36 "-" MAP 0x27D8 VALUE_KF_MD_KKOS_E36 100.000000 F00145 0.000000 1000.000000
 /begin AXIS_DESCR COM_AXIS n F00007 4 0.000000 10000.000000 AXIS_PTS_REF KF_MD_KKOS_E36_n_AXIS /end AXIS_DESCR
 /begin AXIS_DESCR COM_AXIS tan F00014 4 -48.000000 207.000000 AXIS_PTS_REF KF_MD_KKOS_E36_tan_AXIS /end AXIS_DESCR
 FUNCTION_LIST Momentenmanager /end CHARACTERISTIC
/begin RECORD_LAYOUT VALUE_KF_MD_KKOS_E36 FNC_VALUES 0 UWORD ROW_DIR DIRECT /end RECORD_LAYOUT
/begin AXIS_PTS KF_MD_KKOS_E36_n_AXIS "-" 0x27C8 n KF_MD_KKOS_E36_n_AXIS 100.000000 F00007 4 0.000000 10000.000000 /end AXIS_PTS
/begin RECORD_LAYOUT KF_MD_KKOS_E36_n_AXIS FIX_NO_AXIS_PTS_X 4 AXIS_PTS_X 0 UWORD INDEX_INCR DIRECT /end RECORD_LAYOUT
/begin AXIS_PTS KF_MD_KKOS_E36_tan_AXIS "-" 0x27D0 tan KF_MD_KKOS_E36_tan_AXIS 100.000000 F00014 4 -48.000000 207.000000 /end AXIS_PTS
/begin RECORD_LAYOUT KF_MD_KKOS_E36_tan_AXIS FIX_NO_AXIS_PTS_Y 4 AXIS_PTS_Y 0 UWORD INDEX_INCR DIRECT /end RECORD_LAYOUT
/begin CHARACTERISTIC KF_MD_MAX_LA_VL "-" MAP 0x2809 VALUE_KF_MD_MAX_LA_VL 100.000000 F00056 0.000000 1.000000
 /begin AXIS_DESCR COM_AXIS n40 F00109 12 0.000000 10000.000000 AXIS_PTS_REF KF_MD_MAX_LA_VL_n40_AXIS /end AXIS_DESCR
 /begin AXIS_DESCR COM_AXIS rf5 F00116 3 0.000000 1.000000 AXIS_PTS_REF KF_MD_MAX_LA_VL_rf5_AXIS /end AXIS_DESCR
 FUNCTION_LIST Momentenmanager /end CHARACTERISTIC
/begin RECORD_LAYOUT VALUE_KF_MD_MAX_LA_VL FNC_VALUES 0 UBYTE ROW_DIR DIRECT /end RECORD_LAYOUT
/begin AXIS_PTS KF_MD_MAX_LA_VL_n40_AXIS "-" 0x27FA n40 KF_MD_MAX_LA_VL_n40_AXIS 100.000000 F00109 12 0.000000 10000.000000 /end AXIS_PTS
/begin RECORD_LAYOUT KF_MD_MAX_LA_VL_n40_AXIS FIX_NO_AXIS_PTS_X 12 AXIS_PTS_X 0 UBYTE INDEX_INCR DIRECT /end RECORD_LAYOUT
/begin AXIS_PTS KF_MD_MAX_LA_VL_rf5_AXIS "-" 0x2806 rf5 KF_MD_MAX_LA_VL_rf5_AXIS 100.000000 F00116 3 0.000000 1.000000 /end AXIS_PTS
/begin RECORD_LAYOUT KF_MD_MAX_LA_VL_rf5_AXIS FIX_NO_AXIS_PTS_Y 3 AXIS_PTS_Y 0 UBYTE INDEX_INCR DIRECT /end RECORD_LAYOUT
/begin CHARACTERISTIC KF_MD_MAX_MD_IND_OPT "-" MAP 0x28C8 VALUE_KF_MD_MAX_MD_IND_OPT 100.000000 F00145 0.000000 1000.000000
 /begin AXIS_DESCR COM_AXIS rf F00060 12 0.000000 2.000000 AXIS_PTS_REF KF_MD_MAX_MD_IND_OPT_rf_AXIS /end AXIS_DESCR
 /begin AXIS_DESCR COM_AXIS n F00007 18 0.000000 10000.000000 AXIS_PTS_REF KF_MD_MAX_MD_IND_OPT_n_AXIS /end AXIS_DESCR
 FUNCTION_LIST Momentenmanager /end CHARACTERISTIC
/begin RECORD_LAYOUT VALUE_KF_MD_MAX_MD_IND_OPT FNC_VALUES 0 UWORD ROW_DIR DIRECT /end RECORD_LAYOUT
/begin AXIS_PTS KF_MD_MAX_MD_IND_OPT_rf_AXIS "-" 0x288C rf KF_MD_MAX_MD_IND_OPT_rf_AXIS 100.000000 F00060 12 0.000000 2.000000 /end AXIS_PTS
/begin RECORD_LAYOUT KF_MD_MAX_MD_IND_OPT_rf_AXIS FIX_NO_AXIS_PTS_X 12 AXIS_PTS_X 0 UWORD INDEX_INCR DIRECT /end RECORD_LAYOUT
/begin AXIS_PTS KF_MD_MAX_MD_IND_OPT_n_AXIS "-" 0x28A4 n KF_MD_MAX_MD_IND_OPT_n_AXIS 100.000000 F00007 18 0.000000 10000.000000 /end AXIS_PTS
/begin RECORD_LAYOUT KF_MD_MAX_MD_IND_OPT_n_AXIS FIX_NO_AXIS_PTS_Y 18 AXIS_PTS_Y 0 UWORD INDEX_INCR DIRECT /end RECORD_LAYOUT
/begin CHARACTERISTIC KF_MD_MIN_MD_REIB "-" MAP 0x2A9A VALUE_KF_MD_MIN_MD_REIB 100.000000 F00145 0.000000 1000.000000
 /begin AXIS_DESCR COM_AXIS tmot F00014 8 -48.000000 207.000000 AXIS_PTS_REF KF_MD_MIN_MD_REIB_tmot_AXIS /end AXIS_DESCR
 /begin AXIS_DESCR COM_AXIS toel F00014 8 -48.000000 207.000000 AXIS_PTS_REF KF_MD_MIN_MD_REIB_toel_AXIS /end AXIS_DESCR
 FUNCTION_LIST Momentenmanager /end CHARACTERISTIC
/begin RECORD_LAYOUT VALUE_KF_MD_MIN_MD_REIB FNC_VALUES 0 UWORD ROW_DIR DIRECT /end RECORD_LAYOUT
/begin AXIS_PTS KF_MD_MIN_MD_REIB_tmot_AXIS "-" 0x2A7A tmot KF_MD_MIN_MD_REIB_tmot_AXIS 100.000000 F00014 8 -48.000000 207.000000 /end AXIS_PTS
/begin RECORD_LAYOUT KF_MD_MIN_MD_REIB_tmot_AXIS FIX_NO_AXIS_PTS_X 8 AXIS_PTS_X 0 UWORD INDEX_INCR DIRECT /end RECORD_LAYOUT
/begin AXIS_PTS KF_MD_MIN_MD_REIB_toel_AXIS "-" 0x2A8A toel KF_MD_MIN_MD_REIB_toel_AXIS 100.000000 F00014 8 -48.000000 207.000000 /end AXIS_PTS
/begin RECORD_LAYOUT KF_MD_MIN_MD_REIB_toel_AXIS FIX_NO_AXIS_PTS_Y 8 AXIS_PTS_Y 0 UWORD INDEX_INCR DIRECT /end RECORD_LAYOUT
/begin CHARACTERISTIC KF_MD_MIN_LW_N_RF "-" MAP 0x2B40 VALUE_KF_MD_MIN_LW_N_RF 100.000000 F00145 0.000000 1000.000000
 /begin AXIS_DESCR COM_AXIS n F00007 10 0.000000 10000.000000 AXIS_PTS_REF KF_MD_MIN_LW_N_RF_n_AXIS /end AXIS_DESCR
 /begin AXIS_DESCR COM_AXIS rf F00068 8 0.000000 2.000000 AXIS_PTS_REF KF_MD_MIN_LW_N_RF_rf_AXIS /end AXIS_DESCR
 FUNCTION_LIST Momentenmanager /end CHARACTERISTIC
/begin RECORD_LAYOUT VALUE_KF_MD_MIN_LW_N_RF FNC_VALUES 0 UWORD ROW_DIR DIRECT /end RECORD_LAYOUT
/begin AXIS_PTS KF_MD_MIN_LW_N_RF_n_AXIS "-" 0x2B1C n KF_MD_MIN_LW_N_RF_n_AXIS 100.000000 F00007 10 0.000000 10000.000000 /end AXIS_PTS
/begin RECORD_LAYOUT KF_MD_MIN_LW_N_RF_n_AXIS FIX_NO_AXIS_PTS_X 10 AXIS_PTS_X 0 UWORD INDEX_INCR DIRECT /end RECORD_LAYOUT
/begin AXIS_PTS KF_MD_MIN_LW_N_RF_rf_AXIS "-" 0x2B30 rf KF_MD_MIN_LW_N_RF_rf_AXIS 100.000000 F00068 8 0.000000 2.000000 /end AXIS_PTS
/begin RECORD_LAYOUT KF_MD_MIN_LW_N_RF_rf_AXIS FIX_NO_AXIS_PTS_Y 8 AXIS_PTS_Y 0 UWORD INDEX_INCR DIRECT /end RECORD_LAYOUT
/begin CHARACTERISTIC KF_MD_MIN_LW_KH_N_RF "-" MAP 0x2C06 VALUE_KF_MD_MIN_LW_KH_N_RF 100.000000 F00145 0.000000 1000.000000
 /begin AXIS_DESCR COM_AXIS n F00007 10 0.000000 10000.000000 AXIS_PTS_REF KF_MD_MIN_LW_KH_N_RF_n_AXIS /end AXIS_DESCR
 /begin AXIS_DESCR COM_AXIS rf F00068 8 0.000000 2.000000 AXIS_PTS_REF KF_MD_MIN_LW_KH_N_RF_rf_AXIS /end AXIS_DESCR
 FUNCTION_LIST Momentenmanager /end CHARACTERISTIC
/begin RECORD_LAYOUT VALUE_KF_MD_MIN_LW_KH_N_RF FNC_VALUES 0 UWORD ROW_DIR DIRECT /end RECORD_LAYOUT
/begin AXIS_PTS KF_MD_MIN_LW_KH_N_RF_n_AXIS "-" 0x2BE2 n KF_MD_MIN_LW_KH_N_RF_n_AXIS 100.000000 F00007 10 0.000000 10000.000000 /end AXIS_PTS
/begin RECORD_LAYOUT KF_MD_MIN_LW_KH_N_RF_n_AXIS FIX_NO_AXIS_PTS_X 10 AXIS_PTS_X 0 UWORD INDEX_INCR DIRECT /end RECORD_LAYOUT
/begin AXIS_PTS KF_MD_MIN_LW_KH_N_RF_rf_AXIS "-" 0x2BF6 rf KF_MD_MIN_LW_KH_N_RF_rf_AXIS 100.000000 F00068 8 0.000000 2.000000 /end AXIS_PTS
/begin RECORD_LAYOUT KF_MD_MIN_LW_KH_N_RF_rf_AXIS FIX_NO_AXIS_PTS_Y 8 AXIS_PTS_Y 0 UWORD INDEX_INCR DIRECT /end RECORD_LAYOUT
/begin CHARACTERISTIC KF_MD_MIN_START "-" MAP 0x2CC4 VALUE_KF_MD_MIN_START 100.000000 F00145 0.000000 1000.000000
 /begin AXIS_DESCR COM_AXIS n F00007 8 0.000000 10000.000000 AXIS_PTS_REF KF_MD_MIN_START_n_AXIS /end AXIS_DESCR
 /begin AXIS_DESCR COM_AXIS tmot F00014 6 -48.000000 207.000000 AXIS_PTS_REF KF_MD_MIN_START_tmot_AXIS /end AXIS_DESCR
 FUNCTION_LIST Momentenmanager /end CHARACTERISTIC
/begin RECORD_LAYOUT VALUE_KF_MD_MIN_START FNC_VALUES 0 UWORD ROW_DIR DIRECT /end RECORD_LAYOUT
/begin AXIS_PTS KF_MD_MIN_START_n_AXIS "-" 0x2CA8 n KF_MD_MIN_START_n_AXIS 100.000000 F00007 8 0.000000 10000.000000 /end AXIS_PTS
/begin RECORD_LAYOUT KF_MD_MIN_START_n_AXIS FIX_NO_AXIS_PTS_X 8 AXIS_PTS_X 0 UWORD INDEX_INCR DIRECT /end RECORD_LAYOUT
/begin AXIS_PTS KF_MD_MIN_START_tmot_AXIS "-" 0x2CB8 tmot KF_MD_MIN_START_tmot_AXIS 100.000000 F00014 6 -48.000000 207.000000 /end AXIS_PTS
/begin RECORD_LAYOUT KF_MD_MIN_START_tmot_AXIS FIX_NO_AXIS_PTS_Y 6 AXIS_PTS_Y 0 UWORD INDEX_INCR DIRECT /end RECORD_LAYOUT
/begin CHARACTERISTIC KF_MD_MIN_BRENN "-" MAP 0x2D42 VALUE_KF_MD_MIN_BRENN 100.000000 F00145 0.000000 1000.000000
 /begin AXIS_DESCR COM_AXIS n F00007 8 0.000000 10000.000000 AXIS_PTS_REF KF_MD_MIN_BRENN_n_AXIS /end AXIS_DESCR
 /begin AXIS_DESCR COM_AXIS tmot F00014 6 -48.000000 207.000000 AXIS_PTS_REF KF_MD_MIN_BRENN_tmot_AXIS /end AXIS_DESCR
 FUNCTION_LIST Momentenmanager /end CHARACTERISTIC
/begin RECORD_LAYOUT VALUE_KF_MD_MIN_BRENN FNC_VALUES 0 UWORD ROW_DIR DIRECT /end RECORD_LAYOUT
/begin AXIS_PTS KF_MD_MIN_BRENN_n_AXIS "-" 0x2D26 n KF_MD_MIN_BRENN_n_AXIS 100.000000 F00007 8 0.000000 10000.000000 /end AXIS_PTS
/begin RECORD_LAYOUT KF_MD_MIN_BRENN_n_AXIS FIX_NO_AXIS_PTS_X 8 AXIS_PTS_X 0 UWORD INDEX_INCR DIRECT /end RECORD_LAYOUT
/begin AXIS_PTS KF_MD_MIN_BRENN_tmot_AXIS "-" 0x2D36 tmot KF_MD_MIN_BRENN_tmot_AXIS 100.000000 F00014 6 -48.000000 207.000000 /end AXIS_PTS
/begin RECORD_LAYOUT KF_MD_MIN_BRENN_tmot_AXIS FIX_NO_AXIS_PTS_Y 6 AXIS_PTS_Y 0 UWORD INDEX_INCR DIRECT /end RECORD_LAYOUT
/begin CHARACTERISTIC KF_MD_RF_MIN "-" MAP 0x2E06 VALUE_KF_MD_RF_MIN 100.000000 F00060 0.000000 2.000000
 /begin AXIS_DESCR COM_AXIS n F00007 8 0.000000 10000.000000 AXIS_PTS_REF KF_MD_RF_MIN_n_AXIS /end AXIS_DESCR
 /begin AXIS_DESCR COM_AXIS tmot F00014 6 -48.000000 207.000000 AXIS_PTS_REF KF_MD_RF_MIN_tmot_AXIS /end AXIS_DESCR
 FUNCTION_LIST Momentenmanager /end CHARACTERISTIC
/begin RECORD_LAYOUT VALUE_KF_MD_RF_MIN FNC_VALUES 0 UWORD ROW_DIR DIRECT /end RECORD_LAYOUT
/begin AXIS_PTS KF_MD_RF_MIN_n_AXIS "-" 0x2DEA n KF_MD_RF_MIN_n_AXIS 100.000000 F00007 8 0.000000 10000.000000 /end AXIS_PTS
/begin RECORD_LAYOUT KF_MD_RF_MIN_n_AXIS FIX_NO_AXIS_PTS_X 8 AXIS_PTS_X 0 UWORD INDEX_INCR DIRECT /end RECORD_LAYOUT
/begin AXIS_PTS KF_MD_RF_MIN_tmot_AXIS "-" 0x2DFA tmot KF_MD_RF_MIN_tmot_AXIS 100.000000 F00014 6 -48.000000 207.000000 /end AXIS_PTS
/begin RECORD_LAYOUT KF_MD_RF_MIN_tmot_AXIS FIX_NO_AXIS_PTS_Y 6 AXIS_PTS_Y 0 UWORD INDEX_INCR DIRECT /end RECORD_LAYOUT
/begin CHARACTERISTIC KF_MD_DASHPOT "-" MAP 0x2EE6 VALUE_KF_MD_DASHPOT 100.000000 F00168 0.000000 1000.000000
 /begin AXIS_DESCR /* md_fw_filter */ COM_AXIS md_fw_filter F00145 6 0.000000 1000.000000 AXIS_PTS_REF KF_MD_DASHPOT_md_fw_filter_AXIS /end AXIS_DESCR
 /begin AXIS_DESCR COM_AXIS n F00007 6 0.000000 10000.000000 AXIS_PTS_REF KF_MD_DASHPOT_n_AXIS /end AXIS_DESCR
 FUNCTION_LIST Momentenmanager /end CHARACTERISTIC
/begin RECORD_LAYOUT VALUE_KF_MD_DASHPOT FNC_VALUES 0 UWORD ROW_DIR DIRECT /end RECORD_LAYOUT
/begin AXIS_PTS KF_MD_DASHPOT_md_fw_filter_AXIS "-" 0x2ECE md_fw_filter KF_MD_DASHPOT_md_fw_filter_AXIS 100.000000 F00145 6 0.000000 1000.000000 /end AXIS_PTS
/begin RECORD_LAYOUT KF_MD_DASHPOT_md_fw_filter_AXIS FIX_NO_AXIS_PTS_X 6 AXIS_PTS_X 0 UWORD INDEX_INCR DIRECT /end RECORD_LAYOUT
/begin AXIS_PTS KF_MD_DASHPOT_n_AXIS "-" 0x2EDA n KF_MD_DASHPOT_n_AXIS 100.000000 F00007 6 0.000000 10000.000000 /end AXIS_PTS
/begin RECORD_LAYOUT KF_MD_DASHPOT_n_AXIS FIX_NO_AXIS_PTS_Y 6 AXIS_PTS_Y 0 UWORD INDEX_INCR DIRECT /end RECORD_LAYOUT
/begin CHARACTERISTIC KF_MD_LS_SPORT "-" MAP 0x2F48 VALUE_KF_MD_LS_SPORT 100.000000 F00168 0.000000 1000.000000
 /begin AXIS_DESCR COM_AXIS md F00190 6 0.000000 1000.000000 AXIS_PTS_REF KF_MD_LS_SPORT_md_AXIS /end AXIS_DESCR
 /begin AXIS_DESCR COM_AXIS n F00007 6 0.000000 10000.000000 AXIS_PTS_REF KF_MD_LS_SPORT_n_AXIS /end AXIS_DESCR
 FUNCTION_LIST Momentenmanager /end CHARACTERISTIC
/begin RECORD_LAYOUT VALUE_KF_MD_LS_SPORT FNC_VALUES 0 UWORD ROW_DIR DIRECT /end RECORD_LAYOUT
/begin AXIS_PTS KF_MD_LS_SPORT_md_AXIS "-" 0x2F30 md KF_MD_LS_SPORT_md_AXIS 100.000000 F00190 6 0.000000 1000.000000 /end AXIS_PTS
/begin RECORD_LAYOUT KF_MD_LS_SPORT_md_AXIS FIX_NO_AXIS_PTS_X 6 AXIS_PTS_X 0 UWORD INDEX_INCR DIRECT /end RECORD_LAYOUT
/begin AXIS_PTS KF_MD_LS_SPORT_n_AXIS "-" 0x2F3C n KF_MD_LS_SPORT_n_AXIS 100.000000 F00007 6 0.000000 10000.000000 /end AXIS_PTS
/begin RECORD_LAYOUT KF_MD_LS_SPORT_n_AXIS FIX_NO_AXIS_PTS_Y 6 AXIS_PTS_Y 0 UWORD INDEX_INCR DIRECT /end RECORD_LAYOUT
/begin CHARACTERISTIC KF_MD_LS_KOMF "-" MAP 0x2FAA VALUE_KF_MD_LS_KOMF 100.000000 F00168 0.000000 1000.000000
 /begin AXIS_DESCR COM_AXIS md F00190 6 0.000000 1000.000000 AXIS_PTS_REF KF_MD_LS_KOMF_md_AXIS /end AXIS_DESCR
 /begin AXIS_DESCR COM_AXIS n F00007 6 0.000000 10000.000000 AXIS_PTS_REF KF_MD_LS_KOMF_n_AXIS /end AXIS_DESCR
 FUNCTION_LIST Momentenmanager /end CHARACTERISTIC
/begin RECORD_LAYOUT VALUE_KF_MD_LS_KOMF FNC_VALUES 0 UWORD ROW_DIR DIRECT /end RECORD_LAYOUT
/begin AXIS_PTS KF_MD_LS_KOMF_md_AXIS "-" 0x2F92 md KF_MD_LS_KOMF_md_AXIS 100.000000 F00190 6 0.000000 1000.000000 /end AXIS_PTS
/begin RECORD_LAYOUT KF_MD_LS_KOMF_md_AXIS FIX_NO_AXIS_PTS_X 6 AXIS_PTS_X 0 UWORD INDEX_INCR DIRECT /end RECORD_LAYOUT
/begin AXIS_PTS KF_MD_LS_KOMF_n_AXIS "-" 0x2F9E n KF_MD_LS_KOMF_n_AXIS 100.000000 F00007 6 0.000000 10000.000000 /end AXIS_PTS
/begin RECORD_LAYOUT KF_MD_LS_KOMF_n_AXIS FIX_NO_AXIS_PTS_Y 6 AXIS_PTS_Y 0 UWORD INDEX_INCR DIRECT /end RECORD_LAYOUT
/begin CHARACTERISTIC KF_MD_LS_DELTA_VER "-" MAP 0x3034 VALUE_KF_MD_LS_DELTA_VER 100.000000 F00085 0.000000 8.000000
 /begin AXIS_DESCR /* d_md_fw */ COM_AXIS d_md_fw F00145 6 0.000000 1000.000000 AXIS_PTS_REF KF_MD_LS_DELTA_VER_d_md_fw_AXIS /end AXIS_DESCR
 /begin AXIS_DESCR COM_AXIS d_mdrel F00040 4 0.000000 327675.000000 AXIS_PTS_REF KF_MD_LS_DELTA_VER_d_mdrel_AXIS /end AXIS_DESCR
 FUNCTION_LIST Momentenmanager /end CHARACTERISTIC
/begin RECORD_LAYOUT VALUE_KF_MD_LS_DELTA_VER FNC_VALUES 0 UWORD ROW_DIR DIRECT /end RECORD_LAYOUT
/begin AXIS_PTS KF_MD_LS_DELTA_VER_d_md_fw_AXIS "-" 0x3020 d_md_fw KF_MD_LS_DELTA_VER_d_md_fw_AXIS 100.000000 F00145 6 0.000000 1000.000000 /end AXIS_PTS
/begin RECORD_LAYOUT KF_MD_LS_DELTA_VER_d_md_fw_AXIS FIX_NO_AXIS_PTS_X 6 AXIS_PTS_X 0 UWORD INDEX_INCR DIRECT /end RECORD_LAYOUT
/begin AXIS_PTS KF_MD_LS_DELTA_VER_d_mdrel_AXIS "-" 0x302C d_mdrel KF_MD_LS_DELTA_VER_d_mdrel_AXIS 100.000000 F00040 4 0.000000 327675.000000 /end AXIS_PTS
/begin RECORD_LAYOUT KF_MD_LS_DELTA_VER_d_mdrel_AXIS FIX_NO_AXIS_PTS_Y 4 AXIS_PTS_Y 0 UWORD INDEX_INCR DIRECT /end RECORD_LAYOUT
/begin CHARACTERISTIC KF_MD_DASHPOT_FAKTOR "-" MAP 0x3074 VALUE_KF_MD_DASHPOT_FAKTOR 100.000000 F00085 0.000000 8.000000
 /begin AXIS_DESCR COM_AXIS n F00007 3 0.000000 10000.000000 AXIS_PTS_REF KF_MD_DASHPOT_FAKTOR_n_AXIS /end AXIS_DESCR
 /begin AXIS_DESCR COM_AXIS md_fw F00145 4 0.000000 1000.000000 AXIS_PTS_REF KF_MD_DASHPOT_FAKTOR_md_fw_AXIS /end AXIS_DESCR
 FUNCTION_LIST Momentenmanager /end CHARACTERISTIC
/begin RECORD_LAYOUT VALUE_KF_MD_DASHPOT_FAKTOR FNC_VALUES 0 UWORD ROW_DIR DIRECT /end RECORD_LAYOUT
/begin AXIS_PTS KF_MD_DASHPOT_FAKTOR_n_AXIS "-" 0x3066 n KF_MD_DASHPOT_FAKTOR_n_AXIS 100.000000 F00007 3 0.000000 10000.000000 /end AXIS_PTS
/begin RECORD_LAYOUT KF_MD_DASHPOT_FAKTOR_n_AXIS FIX_NO_AXIS_PTS_X 3 AXIS_PTS_X 0 UWORD INDEX_INCR DIRECT /end RECORD_LAYOUT
/begin AXIS_PTS KF_MD_DASHPOT_FAKTOR_md_fw_AXIS "-" 0x306C md_fw KF_MD_DASHPOT_FAKTOR_md_fw_AXIS 100.000000 F00145 4 0.000000 1000.000000 /end AXIS_PTS
/begin RECORD_LAYOUT KF_MD_DASHPOT_FAKTOR_md_fw_AXIS FIX_NO_AXIS_PTS_Y 4 AXIS_PTS_Y 0 UWORD INDEX_INCR DIRECT /end RECORD_LAYOUT
/begin CHARACTERISTIC KF_MD_WE "-" MAP 0x30A6 VALUE_KF_MD_WE 100.000000 F00168 0.000000 1000.000000
 /begin AXIS_DESCR /* md_rel */ COM_AXIS md_rel F00048 6 0.000000 100.000000 AXIS_PTS_REF KF_MD_WE_md_rel_AXIS /end AXIS_DESCR
 /begin AXIS_DESCR COM_AXIS n F00007 6 0.000000 10000.000000 AXIS_PTS_REF KF_MD_WE_n_AXIS /end AXIS_DESCR
 FUNCTION_LIST Momentenmanager /end CHARACTERISTIC
/begin RECORD_LAYOUT VALUE_KF_MD_WE FNC_VALUES 0 UWORD ROW_DIR DIRECT /end RECORD_LAYOUT
/begin AXIS_PTS KF_MD_WE_md_rel_AXIS "-" 0x308E md_rel KF_MD_WE_md_rel_AXIS 100.000000 F00048 6 0.000000 100.000000 /end AXIS_PTS
/begin RECORD_LAYOUT KF_MD_WE_md_rel_AXIS FIX_NO_AXIS_PTS_X 6 AXIS_PTS_X 0 UWORD INDEX_INCR DIRECT /end RECORD_LAYOUT
/begin AXIS_PTS KF_MD_WE_n_AXIS "-" 0x309A n KF_MD_WE_n_AXIS 100.000000 F00007 6 0.000000 10000.000000 /end AXIS_PTS
/begin RECORD_LAYOUT KF_MD_WE_n_AXIS FIX_NO_AXIS_PTS_Y 6 AXIS_PTS_Y 0 UWORD INDEX_INCR DIRECT /end RECORD_LAYOUT
/begin CHARACTERISTIC KF_MD_LS_WE "-" MAP 0x3100 VALUE_KF_MD_LS_WE 100.000000 F00191 0.000000 6399.000000
 /begin AXIS_DESCR /* md_rel */ COM_AXIS md_rel F00048 4 0.000000 100.000000 AXIS_PTS_REF KF_MD_LS_WE_md_rel_AXIS /end AXIS_DESCR
 /begin AXIS_DESCR COM_AXIS n F00007 4 0.000000 10000.000000 AXIS_PTS_REF KF_MD_LS_WE_n_AXIS /end AXIS_DESCR
 FUNCTION_LIST Momentenmanager /end CHARACTERISTIC
/begin RECORD_LAYOUT VALUE_KF_MD_LS_WE FNC_VALUES 0 UWORD ROW_DIR DIRECT /end RECORD_LAYOUT
/begin AXIS_PTS KF_MD_LS_WE_md_rel_AXIS "-" 0x30F0 md_rel KF_MD_LS_WE_md_rel_AXIS 100.000000 F00048 4 0.000000 100.000000 /end AXIS_PTS
/begin RECORD_LAYOUT KF_MD_LS_WE_md_rel_AXIS FIX_NO_AXIS_PTS_X 4 AXIS_PTS_X 0 UWORD INDEX_INCR DIRECT /end RECORD_LAYOUT
/begin AXIS_PTS KF_MD_LS_WE_n_AXIS "-" 0x30F8 n KF_MD_LS_WE_n_AXIS 100.000000 F00007 4 0.000000 10000.000000 /end AXIS_PTS
/begin RECORD_LAYOUT KF_MD_LS_WE_n_AXIS FIX_NO_AXIS_PTS_Y 4 AXIS_PTS_Y 0 UWORD INDEX_INCR DIRECT /end RECORD_LAYOUT
/begin CHARACTERISTIC KF_MD_RES_KATH_GEW "-" MAP 0x324E VALUE_KF_MD_RES_KATH_GEW 100.000000 F00100 0.000000 2.000000
 /begin AXIS_DESCR /* sectimer */ COM_AXIS sectimer F00017 6 0.000000 65535.000000 AXIS_PTS_REF KF_MD_RES_KATH_GEW_sectimer_AXIS /end AXIS_DESCR
 /begin AXIS_DESCR COM_AXIS tmot F00014 8 -48.000000 207.000000 AXIS_PTS_REF KF_MD_RES_KATH_GEW_tmot_AXIS /end AXIS_DESCR
 FUNCTION_LIST Momentenmanager /end CHARACTERISTIC
/begin RECORD_LAYOUT VALUE_KF_MD_RES_KATH_GEW FNC_VALUES 0 UWORD ROW_DIR DIRECT /end RECORD_LAYOUT
/begin AXIS_PTS KF_MD_RES_KATH_GEW_sectimer_AXIS "-" 0x3232 sectimer KF_MD_RES_KATH_GEW_sectimer_AXIS 100.000000 F00017 6 0.000000 65535.000000 /end AXIS_PTS
/begin RECORD_LAYOUT KF_MD_RES_KATH_GEW_sectimer_AXIS FIX_NO_AXIS_PTS_X 6 AXIS_PTS_X 0 UWORD INDEX_INCR DIRECT /end RECORD_LAYOUT
/begin AXIS_PTS KF_MD_RES_KATH_GEW_tmot_AXIS "-" 0x323E tmot KF_MD_RES_KATH_GEW_tmot_AXIS 100.000000 F00014 8 -48.000000 207.000000 /end AXIS_PTS
/begin RECORD_LAYOUT KF_MD_RES_KATH_GEW_tmot_AXIS FIX_NO_AXIS_PTS_Y 8 AXIS_PTS_Y 0 UWORD INDEX_INCR DIRECT /end RECORD_LAYOUT
/begin CHARACTERISTIC KF_MD_RES_KATH "-" MAP 0x32D8 VALUE_KF_MD_RES_KATH 100.000000 F00145 0.000000 1000.000000
 /begin AXIS_DESCR COM_AXIS n F00007 10 0.000000 10000.000000 AXIS_PTS_REF KF_MD_RES_KATH_n_AXIS /end AXIS_DESCR
 /begin AXIS_DESCR COM_AXIS rf F00068 10 0.000000 2.000000 AXIS_PTS_REF KF_MD_RES_KATH_rf_AXIS /end AXIS_DESCR
 FUNCTION_LIST Momentenmanager /end CHARACTERISTIC
/begin RECORD_LAYOUT VALUE_KF_MD_RES_KATH FNC_VALUES 0 UWORD ROW_DIR DIRECT /end RECORD_LAYOUT
/begin AXIS_PTS KF_MD_RES_KATH_n_AXIS "-" 0x32B0 n KF_MD_RES_KATH_n_AXIS 100.000000 F00007 10 0.000000 10000.000000 /end AXIS_PTS
/begin RECORD_LAYOUT KF_MD_RES_KATH_n_AXIS FIX_NO_AXIS_PTS_X 10 AXIS_PTS_X 0 UWORD INDEX_INCR DIRECT /end RECORD_LAYOUT
/begin AXIS_PTS KF_MD_RES_KATH_rf_AXIS "-" 0x32C4 rf KF_MD_RES_KATH_rf_AXIS 100.000000 F00068 10 0.000000 2.000000 /end AXIS_PTS
/begin RECORD_LAYOUT KF_MD_RES_KATH_rf_AXIS FIX_NO_AXIS_PTS_Y 10 AXIS_PTS_Y 0 UWORD INDEX_INCR DIRECT /end RECORD_LAYOUT
/begin CHARACTERISTIC KL_MD_SK_MAX "-" CURVE 0x3402 VALUE_KL_MD_SK_MAX 100.000000 F00145 0.000000 1000.000000
 /begin AXIS_DESCR COM_AXIS stufe F00031 6 0.000000 5.000000 AXIS_PTS_REF KL_MD_SK_MAX_stufe_AXIS /end AXIS_DESCR
 FUNCTION_LIST SK-Momentenmanager /end CHARACTERISTIC
/begin RECORD_LAYOUT VALUE_KL_MD_SK_MAX FNC_VALUES 0 UWORD ROW_DIR DIRECT /end RECORD_LAYOUT
/begin AXIS_PTS KL_MD_SK_MAX_stufe_AXIS "-" 0x33F6 stufe KL_MD_SK_MAX_stufe_AXIS 100.000000 F00031 6 0.000000 5.000000 /end AXIS_PTS
/begin RECORD_LAYOUT KL_MD_SK_MAX_stufe_AXIS FIX_NO_AXIS_PTS_X 6 AXIS_PTS_X 0 UWORD INDEX_INCR DIRECT /end RECORD_LAYOUT
/begin CHARACTERISTIC KL_MD_SK_GRAD "-" CURVE 0x341C VALUE_KL_MD_SK_GRAD 100.000000 F00170 0.000000 1000.000000
 /begin AXIS_DESCR COM_AXIS stufe F00031 6 0.000000 5.000000 AXIS_PTS_REF KL_MD_SK_GRAD_stufe_AXIS /end AXIS_DESCR
 FUNCTION_LIST SK-Momentenmanager /end CHARACTERISTIC
/begin RECORD_LAYOUT VALUE_KL_MD_SK_GRAD FNC_VALUES 0 UWORD ROW_DIR DIRECT /end RECORD_LAYOUT
/begin AXIS_PTS KL_MD_SK_GRAD_stufe_AXIS "-" 0x3410 stufe KL_MD_SK_GRAD_stufe_AXIS 100.000000 F00031 6 0.000000 5.000000 /end AXIS_PTS
/begin RECORD_LAYOUT KL_MD_SK_GRAD_stufe_AXIS FIX_NO_AXIS_PTS_X 6 AXIS_PTS_X 0 UWORD INDEX_INCR DIRECT /end RECORD_LAYOUT
/begin CHARACTERISTIC KL_MD_SK_AX "-" CURVE 0x3430 VALUE_KL_MD_SK_AX 100.000000 F00193 -12.000000 12.000000
 /begin AXIS_DESCR COM_AXIS stufe F00031 6 0.000000 5.000000 AXIS_PTS_REF KL_MD_SK_AX_stufe_AXIS /end AXIS_DESCR
 FUNCTION_LIST SK-Momentenmanager /end CHARACTERISTIC
/begin RECORD_LAYOUT VALUE_KL_MD_SK_AX FNC_VALUES 0 SBYTE ROW_DIR DIRECT /end RECORD_LAYOUT
/begin AXIS_PTS KL_MD_SK_AX_stufe_AXIS "-" 0x342A stufe KL_MD_SK_AX_stufe_AXIS 100.000000 F00031 6 0.000000 5.000000 /end AXIS_PTS
/begin RECORD_LAYOUT KL_MD_SK_AX_stufe_AXIS FIX_NO_AXIS_PTS_X 6 AXIS_PTS_X 0 UBYTE INDEX_INCR DIRECT /end RECORD_LAYOUT
/begin CHARACTERISTIC KL_MD_SK_AX_P "-" CURVE 0x3440 VALUE_KL_MD_SK_AX_P 100.000000 F00145 -200.000000 0.000000
 /begin AXIS_DESCR COM_AXIS d_ax F00193 4 0.000000 12.000000 AXIS_PTS_REF KL_MD_SK_AX_P_d_ax_AXIS /end AXIS_DESCR
 FUNCTION_LIST SK-Momentenmanager /end CHARACTERISTIC
/begin RECORD_LAYOUT VALUE_KL_MD_SK_AX_P FNC_VALUES 0 SWORD ROW_DIR DIRECT /end RECORD_LAYOUT
/begin AXIS_PTS KL_MD_SK_AX_P_d_ax_AXIS "-" 0x3438 d_ax KL_MD_SK_AX_P_d_ax_AXIS 100.000000 F00193 4 0.000000 12.000000 /end AXIS_PTS
/begin RECORD_LAYOUT KL_MD_SK_AX_P_d_ax_AXIS FIX_NO_AXIS_PTS_X 4 AXIS_PTS_X 0 UWORD INDEX_INCR DIRECT /end RECORD_LAYOUT
/begin CHARACTERISTIC KL_MD_SK_AX_IPOS "-" CURVE 0x3452 VALUE_KL_MD_SK_AX_IPOS 100.000000 F00194 -5.000000 0.000000
 /begin AXIS_DESCR COM_AXIS d_ax F00193 4 0.000000 12.000000 AXIS_PTS_REF KL_MD_SK_AX_IPOS_d_ax_AXIS /end AXIS_DESCR
 FUNCTION_LIST SK-Momentenmanager /end CHARACTERISTIC
/begin RECORD_LAYOUT VALUE_KL_MD_SK_AX_IPOS FNC_VALUES 0 SWORD ROW_DIR DIRECT /end RECORD_LAYOUT
/begin AXIS_PTS KL_MD_SK_AX_IPOS_d_ax_AXIS "-" 0x344A d_ax KL_MD_SK_AX_IPOS_d_ax_AXIS 100.000000 F00193 4 0.000000 12.000000 /end AXIS_PTS
/begin RECORD_LAYOUT KL_MD_SK_AX_IPOS_d_ax_AXIS FIX_NO_AXIS_PTS_X 4 AXIS_PTS_X 0 UWORD INDEX_INCR DIRECT /end RECORD_LAYOUT
/begin CHARACTERISTIC KL_MD_SK_AX_INEG "-" CURVE 0x3464 VALUE_KL_MD_SK_AX_INEG 100.000000 F00194 0.000000 5.000000
 /begin AXIS_DESCR COM_AXIS d_ax F00193 4 0.000000 12.000000 AXIS_PTS_REF KL_MD_SK_AX_INEG_d_ax_AXIS /end AXIS_DESCR
 FUNCTION_LIST SK-Momentenmanager /end CHARACTERISTIC
/begin RECORD_LAYOUT VALUE_KL_MD_SK_AX_INEG FNC_VALUES 0 SWORD ROW_DIR DIRECT /end RECORD_LAYOUT
/begin AXIS_PTS KL_MD_SK_AX_INEG_d_ax_AXIS "-" 0x345C d_ax KL_MD_SK_AX_INEG_d_ax_AXIS 100.000000 F00193 4 0.000000 12.000000 /end AXIS_PTS
/begin RECORD_LAYOUT KL_MD_SK_AX_INEG_d_ax_AXIS FIX_NO_AXIS_PTS_X 4 AXIS_PTS_X 0 UWORD INDEX_INCR DIRECT /end RECORD_LAYOUT
/begin CHARACTERISTIC KL_MD_SK_AX_GANG "-" CURVE 0x3476 VALUE_KL_MD_SK_AX_GANG 100.000000 F00003 0.000000 3.000000
 /begin AXIS_DESCR COM_AXIS gang F00013 8 0.000000 10.000000 AXIS_PTS_REF KL_MD_SK_AX_GANG_gang_AXIS /end AXIS_DESCR
 FUNCTION_LIST SK-Momentenmanager /end CHARACTERISTIC
/begin RECORD_LAYOUT VALUE_KL_MD_SK_AX_GANG FNC_VALUES 0 UBYTE ROW_DIR DIRECT /end RECORD_LAYOUT
/begin AXIS_PTS KL_MD_SK_AX_GANG_gang_AXIS "-" 0x346E gang KL_MD_SK_AX_GANG_gang_AXIS 100.000000 F00013 8 0.000000 10.000000 /end AXIS_PTS
/begin RECORD_LAYOUT KL_MD_SK_AX_GANG_gang_AXIS FIX_NO_AXIS_PTS_X 8 AXIS_PTS_X 0 UBYTE INDEX_INCR DIRECT /end RECORD_LAYOUT
/begin CHARACTERISTIC KL_V_MAX_SK "-" CURVE 0x348A VALUE_KL_V_MAX_SK 100.000000 F00079 0.000000 360.000000
 /begin AXIS_DESCR COM_AXIS stufe F00031 5 0.000000 5.000000 AXIS_PTS_REF KL_V_MAX_SK_stufe_AXIS /end AXIS_DESCR
 FUNCTION_LIST SK-Momentenmanager /end CHARACTERISTIC
/begin RECORD_LAYOUT VALUE_KL_V_MAX_SK FNC_VALUES 0 UWORD ROW_DIR DIRECT /end RECORD_LAYOUT
/begin AXIS_PTS KL_V_MAX_SK_stufe_AXIS "-" 0x3480 stufe KL_V_MAX_SK_stufe_AXIS 100.000000 F00031 5 0.000000 5.000000 /end AXIS_PTS
/begin RECORD_LAYOUT KL_V_MAX_SK_stufe_AXIS FIX_NO_AXIS_PTS_X 5 AXIS_PTS_X 0 UWORD INDEX_INCR DIRECT /end RECORD_LAYOUT
/begin CHARACTERISTIC KL_MD_SK_WDK "-" CURVE 0x349C VALUE_KL_MD_SK_WDK 100.000000 F00048 0.000000 100.000000
 /begin AXIS_DESCR COM_AXIS n F00007 3 0.000000 10000.000000 AXIS_PTS_REF KL_MD_SK_WDK_n_AXIS /end AXIS_DESCR
 FUNCTION_LIST SK-Momentenmanager /end CHARACTERISTIC
/begin RECORD_LAYOUT VALUE_KL_MD_SK_WDK FNC_VALUES 0 UWORD ROW_DIR DIRECT /end RECORD_LAYOUT
/begin AXIS_PTS KL_MD_SK_WDK_n_AXIS "-" 0x3496 n KL_MD_SK_WDK_n_AXIS 100.000000 F00007 3 0.000000 10000.000000 /end AXIS_PTS
/begin RECORD_LAYOUT KL_MD_SK_WDK_n_AXIS FIX_NO_AXIS_PTS_X 3 AXIS_PTS_X 0 UWORD INDEX_INCR DIRECT /end RECORD_LAYOUT
/begin CHARACTERISTIC KL_P_UMG_HOEHE "-" CURVE 0x1D5A VALUE_KL_P_UMG_HOEHE 100.000000 F00205 -200.000000 6000.000000
 /begin AXIS_DESCR /* p_umg_ver */ COM_AXIS p_umg_ver F00100 18 0.000000 2.000000 AXIS_PTS_REF KL_P_UMG_HOEHE_p_umg_ver_AXIS /end AXIS_DESCR
 FUNCTION_LIST Messwerte /end CHARACTERISTIC
/begin RECORD_LAYOUT VALUE_KL_P_UMG_HOEHE FNC_VALUES 0 SWORD ROW_DIR DIRECT /end RECORD_LAYOUT
/begin AXIS_PTS KL_P_UMG_HOEHE_p_umg_ver_AXIS "-" 0x1D36 p_umg_ver KL_P_UMG_HOEHE_p_umg_ver_AXIS 100.000000 F00100 18 0.000000 2.000000 /end AXIS_PTS
/begin RECORD_LAYOUT KL_P_UMG_HOEHE_p_umg_ver_AXIS FIX_NO_AXIS_PTS_X 18 AXIS_PTS_X 0 UWORD INDEX_INCR DIRECT /end RECORD_LAYOUT
/begin CHARACTERISTIC KL_PWG_MAX_DIFF "-" CURVE 0x142 VALUE_KL_PWG_MAX_DIFF 100.000000 F00048 0.000000 100.000000
 /begin AXIS_DESCR /* pwg1_2 */ COM_AXIS pwg1_2 F00048 3 0.000000 120.000000 AXIS_PTS_REF KL_PWG_MAX_DIFF_pwg1_2_AXIS /end AXIS_DESCR
 FUNCTION_LIST Messwerte /end CHARACTERISTIC
/begin RECORD_LAYOUT VALUE_KL_PWG_MAX_DIFF FNC_VALUES 0 UWORD ROW_DIR DIRECT /end RECORD_LAYOUT
/begin AXIS_PTS KL_PWG_MAX_DIFF_pwg1_2_AXIS "-" 0x13C pwg1_2 KL_PWG_MAX_DIFF_pwg1_2_AXIS 100.000000 F00048 3 0.000000 120.000000 /end AXIS_PTS
/begin RECORD_LAYOUT KL_PWG_MAX_DIFF_pwg1_2_AXIS FIX_NO_AXIS_PTS_X 3 AXIS_PTS_X 0 UWORD INDEX_INCR DIRECT /end RECORD_LAYOUT
/begin CHARACTERISTIC KL_PWG_SOLL_NOTLAUF "-" CURVE 0x15E VALUE_KL_PWG_SOLL_NOTLAUF 100.000000 F00048 0.000000 100.000000
 /begin AXIS_DESCR COM_AXIS pwg F00048 10 0.000000 100.000000 AXIS_PTS_REF KL_PWG_SOLL_NOTLAUF_pwg_AXIS /end AXIS_DESCR
 FUNCTION_LIST Messwerte /end CHARACTERISTIC
/begin RECORD_LAYOUT VALUE_KL_PWG_SOLL_NOTLAUF FNC_VALUES 0 UWORD ROW_DIR DIRECT /end RECORD_LAYOUT
/begin AXIS_PTS KL_PWG_SOLL_NOTLAUF_pwg_AXIS "-" 0x14A pwg KL_PWG_SOLL_NOTLAUF_pwg_AXIS 100.000000 F00048 10 0.000000 100.000000 /end AXIS_PTS
/begin RECORD_LAYOUT KL_PWG_SOLL_NOTLAUF_pwg_AXIS FIX_NO_AXIS_PTS_X 10 AXIS_PTS_X 0 UWORD INDEX_INCR DIRECT /end RECORD_LAYOUT
/begin CHARACTERISTIC KL_PWG_SOLL_SPORT "-" CURVE 0x188 VALUE_KL_PWG_SOLL_SPORT 100.000000 F00048 0.000000 100.000000
 /begin AXIS_DESCR COM_AXIS pwg F00048 10 0.000000 100.000000 AXIS_PTS_REF KL_PWG_SOLL_SPORT_pwg_AXIS /end AXIS_DESCR
 FUNCTION_LIST Messwerte /end CHARACTERISTIC
/begin RECORD_LAYOUT VALUE_KL_PWG_SOLL_SPORT FNC_VALUES 0 UWORD ROW_DIR DIRECT /end RECORD_LAYOUT
/begin AXIS_PTS KL_PWG_SOLL_SPORT_pwg_AXIS "-" 0x174 pwg KL_PWG_SOLL_SPORT_pwg_AXIS 100.000000 F00048 10 0.000000 100.000000 /end AXIS_PTS
/begin RECORD_LAYOUT KL_PWG_SOLL_SPORT_pwg_AXIS FIX_NO_AXIS_PTS_X 10 AXIS_PTS_X 0 UWORD INDEX_INCR DIRECT /end RECORD_LAYOUT
/begin CHARACTERISTIC KL_PWG_SOLL_KOMFORT "-" CURVE 0x1B2 VALUE_KL_PWG_SOLL_KOMFORT 100.000000 F00048 0.000000 100.000000
 /begin AXIS_DESCR COM_AXIS pwg F00048 10 0.000000 100.000000 AXIS_PTS_REF KL_PWG_SOLL_KOMFORT_pwg_AXIS /end AXIS_DESCR
 FUNCTION_LIST Messwerte /end CHARACTERISTIC
/begin RECORD_LAYOUT VALUE_KL_PWG_SOLL_KOMFORT FNC_VALUES 0 UWORD ROW_DIR DIRECT /end RECORD_LAYOUT
/begin AXIS_PTS KL_PWG_SOLL_KOMFORT_pwg_AXIS "-" 0x19E pwg KL_PWG_SOLL_KOMFORT_pwg_AXIS 100.000000 F00048 10 0.000000 100.000000 /end AXIS_PTS
/begin RECORD_LAYOUT KL_PWG_SOLL_KOMFORT_pwg_AXIS FIX_NO_AXIS_PTS_X 10 AXIS_PTS_X 0 UWORD INDEX_INCR DIRECT /end RECORD_LAYOUT
/begin CHARACTERISTIC KF_PWG_TAU_NORM_DOWN "-" MAP 0x1D0 VALUE_KF_PWG_TAU_NORM_DOWN 100.000000 F00196 2.000000 0.000000
 /begin AXIS_DESCR COM_AXIS n40 F00109 4 0.000000 10000.000000 AXIS_PTS_REF KF_PWG_TAU_NORM_DOWN_n40_AXIS /end AXIS_DESCR
 /begin AXIS_DESCR /* pwgroh */ COM_AXIS pwgroh F00046 4 0.000000 100.000000 AXIS_PTS_REF KF_PWG_TAU_NORM_DOWN_pwgroh_AXIS /end AXIS_DESCR
 FUNCTION_LIST Messwerte /end CHARACTERISTIC
/begin RECORD_LAYOUT VALUE_KF_PWG_TAU_NORM_DOWN FNC_VALUES 0 UBYTE ROW_DIR DIRECT /end RECORD_LAYOUT
/begin AXIS_PTS KF_PWG_TAU_NORM_DOWN_n40_AXIS "-" 0x1C8 n40 KF_PWG_TAU_NORM_DOWN_n40_AXIS 100.000000 F00109 4 0.000000 10000.000000 /end AXIS_PTS
/begin RECORD_LAYOUT KF_PWG_TAU_NORM_DOWN_n40_AXIS FIX_NO_AXIS_PTS_X 4 AXIS_PTS_X 0 UBYTE INDEX_INCR DIRECT /end RECORD_LAYOUT
/begin AXIS_PTS KF_PWG_TAU_NORM_DOWN_pwgroh_AXIS "-" 0x1CC pwgroh KF_PWG_TAU_NORM_DOWN_pwgroh_AXIS 100.000000 F00046 4 0.000000 100.000000 /end AXIS_PTS
/begin RECORD_LAYOUT KF_PWG_TAU_NORM_DOWN_pwgroh_AXIS FIX_NO_AXIS_PTS_Y 4 AXIS_PTS_Y 0 UBYTE INDEX_INCR DIRECT /end RECORD_LAYOUT
/begin CHARACTERISTIC KF_MD_FAHRER "-" MAP 0x1FE VALUE_KF_MD_FAHRER 100.000000 F00048 0.000000 100.000000
 /begin AXIS_DESCR COM_AXIS n F00007 8 0.000000 10000.000000 AXIS_PTS_REF KF_MD_FAHRER_n_AXIS /end AXIS_DESCR
 /begin AXIS_DESCR COM_AXIS pwg F00048 6 0.000000 100.000000 AXIS_PTS_REF KF_MD_FAHRER_pwg_AXIS /end AXIS_DESCR
 FUNCTION_LIST Messwerte /end CHARACTERISTIC
/begin RECORD_LAYOUT VALUE_KF_MD_FAHRER FNC_VALUES 0 UWORD ROW_DIR DIRECT /end RECORD_LAYOUT
/begin AXIS_PTS KF_MD_FAHRER_n_AXIS "-" 0x1E2 n KF_MD_FAHRER_n_AXIS 100.000000 F00007 8 0.000000 10000.000000 /end AXIS_PTS
/begin RECORD_LAYOUT KF_MD_FAHRER_n_AXIS FIX_NO_AXIS_PTS_X 8 AXIS_PTS_X 0 UWORD INDEX_INCR DIRECT /end RECORD_LAYOUT
/begin AXIS_PTS KF_MD_FAHRER_pwg_AXIS "-" 0x1F2 pwg KF_MD_FAHRER_pwg_AXIS 100.000000 F00048 6 0.000000 100.000000 /end AXIS_PTS
/begin RECORD_LAYOUT KF_MD_FAHRER_pwg_AXIS FIX_NO_AXIS_PTS_Y 6 AXIS_PTS_Y 0 UWORD INDEX_INCR DIRECT /end RECORD_LAYOUT
/begin CHARACTERISTIC KL_SERVO_KOMFORT "-" CURVE 0x3F3E VALUE_KL_SERVO_KOMFORT 100.000000 F00212 0.000000 801.000000
 /begin AXIS_DESCR COM_AXIS v F00004 10 0.000000 360.000000 AXIS_PTS_REF KL_SERVO_KOMFORT_v_AXIS /end AXIS_DESCR
 FUNCTION_LIST Servotronic /end CHARACTERISTIC
/begin RECORD_LAYOUT VALUE_KL_SERVO_KOMFORT FNC_VALUES 0 UWORD ROW_DIR DIRECT /end RECORD_LAYOUT
/begin AXIS_PTS KL_SERVO_KOMFORT_v_AXIS "-" 0x3F2A v KL_SERVO_KOMFORT_v_AXIS 100.000000 F00004 10 0.000000 360.000000 /end AXIS_PTS
/begin RECORD_LAYOUT KL_SERVO_KOMFORT_v_AXIS FIX_NO_AXIS_PTS_X 10 AXIS_PTS_X 0 UWORD INDEX_INCR DIRECT /end RECORD_LAYOUT
/begin CHARACTERISTIC KL_SERVO_SPORT "-" CURVE 0x3F68 VALUE_KL_SERVO_SPORT 100.000000 F00212 0.000000 801.000000
 /begin AXIS_DESCR COM_AXIS v F00004 10 0.000000 360.000000 AXIS_PTS_REF KL_SERVO_SPORT_v_AXIS /end AXIS_DESCR
 FUNCTION_LIST Servotronic /end CHARACTERISTIC
/begin RECORD_LAYOUT VALUE_KL_SERVO_SPORT FNC_VALUES 0 UWORD ROW_DIR DIRECT /end RECORD_LAYOUT
/begin AXIS_PTS KL_SERVO_SPORT_v_AXIS "-" 0x3F54 v KL_SERVO_SPORT_v_AXIS 100.000000 F00004 10 0.000000 360.000000 /end AXIS_PTS
/begin RECORD_LAYOUT KL_SERVO_SPORT_v_AXIS FIX_NO_AXIS_PTS_X 10 AXIS_PTS_X 0 UWORD INDEX_INCR DIRECT /end RECORD_LAYOUT
/begin CHARACTERISTIC KL_SK_TR_SW_M "-" CURVE 0x228E VALUE_KL_SK_TR_SW_M 100.000000 F00031 -32768.000000 32767.000000
 /begin AXIS_DESCR COM_AXIS x F00031 4 0.000000 65535.000000 AXIS_PTS_REF KL_SK_TR_SW_M_x_AXIS /end AXIS_DESCR
 FUNCTION_LIST Sicherheitskonzept /end CHARACTERISTIC
/begin RECORD_LAYOUT VALUE_KL_SK_TR_SW_M FNC_VALUES 0 SWORD ROW_DIR DIRECT /end RECORD_LAYOUT
/begin AXIS_PTS KL_SK_TR_SW_M_x_AXIS "-" 0x2286 x KL_SK_TR_SW_M_x_AXIS 100.000000 F00031 4 0.000000 65535.000000 /end AXIS_PTS
/begin RECORD_LAYOUT KL_SK_TR_SW_M_x_AXIS FIX_NO_AXIS_PTS_X 4 AXIS_PTS_X 0 UWORD INDEX_INCR DIRECT /end RECORD_LAYOUT
/begin CHARACTERISTIC KL_SK_TR_UB_M "-" CURVE 0x229C VALUE_KL_SK_TR_UB_M 100.000000 F00031 0.000000 255.000000
 /begin AXIS_DESCR COM_AXIS x F00031 4 0.000000 255.000000 AXIS_PTS_REF KL_SK_TR_UB_M_x_AXIS /end AXIS_DESCR
 FUNCTION_LIST Sicherheitskonzept /end CHARACTERISTIC
/begin RECORD_LAYOUT VALUE_KL_SK_TR_UB_M FNC_VALUES 0 UBYTE ROW_DIR DIRECT /end RECORD_LAYOUT
/begin AXIS_PTS KL_SK_TR_UB_M_x_AXIS "-" 0x2298 x KL_SK_TR_UB_M_x_AXIS 100.000000 F00031 4 0.000000 255.000000 /end AXIS_PTS
/begin RECORD_LAYOUT KL_SK_TR_UB_M_x_AXIS FIX_NO_AXIS_PTS_X 4 AXIS_PTS_X 0 UBYTE INDEX_INCR DIRECT /end RECORD_LAYOUT
/begin CHARACTERISTIC KF_SK_TR_UW_M "-" MAP 0x224A VALUE_KF_SK_TR_UW_M 100.000000 F00031 0.000000 65535.000000
 /begin AXIS_DESCR COM_AXIS x F00031 4 0.000000 65535.000000 AXIS_PTS_REF KF_SK_TR_UW_M_x_AXIS /end AXIS_DESCR
 /begin AXIS_DESCR COM_AXIS y F00031 4 0.000000 65535.000000 AXIS_PTS_REF KF_SK_TR_UW_M_y_AXIS /end AXIS_DESCR
 FUNCTION_LIST Sicherheitskonzept /end CHARACTERISTIC
/begin RECORD_LAYOUT VALUE_KF_SK_TR_UW_M FNC_VALUES 0 UWORD ROW_DIR DIRECT /end RECORD_LAYOUT
/begin AXIS_PTS KF_SK_TR_UW_M_x_AXIS "-" 0x223A x KF_SK_TR_UW_M_x_AXIS 100.000000 F00031 4 0.000000 65535.000000 /end AXIS_PTS
/begin RECORD_LAYOUT KF_SK_TR_UW_M_x_AXIS FIX_NO_AXIS_PTS_X 4 AXIS_PTS_X 0 UWORD INDEX_INCR DIRECT /end RECORD_LAYOUT
/begin AXIS_PTS KF_SK_TR_UW_M_y_AXIS "-" 0x2242 y KF_SK_TR_UW_M_y_AXIS 100.000000 F00031 4 0.000000 65535.000000 /end AXIS_PTS
/begin RECORD_LAYOUT KF_SK_TR_UW_M_y_AXIS FIX_NO_AXIS_PTS_Y 4 AXIS_PTS_Y 0 UWORD INDEX_INCR DIRECT /end RECORD_LAYOUT
/begin CHARACTERISTIC KF_SK_TR_SB_M "-" MAP 0x2274 VALUE_KF_SK_TR_SB_M 100.000000 F00031 -128.000000 127.000000
 /begin AXIS_DESCR COM_AXIS x F00031 4 0.000000 255.000000 AXIS_PTS_REF KF_SK_TR_SB_M_x_AXIS /end AXIS_DESCR
 /begin AXIS_DESCR COM_AXIS y F00031 4 0.000000 255.000000 AXIS_PTS_REF KF_SK_TR_SB_M_y_AXIS /end AXIS_DESCR
 FUNCTION_LIST Sicherheitskonzept /end CHARACTERISTIC
/begin RECORD_LAYOUT VALUE_KF_SK_TR_SB_M FNC_VALUES 0 SBYTE ROW_DIR DIRECT /end RECORD_LAYOUT
/begin AXIS_PTS KF_SK_TR_SB_M_x_AXIS "-" 0x226C x KF_SK_TR_SB_M_x_AXIS 100.000000 F00031 4 0.000000 255.000000 /end AXIS_PTS
/begin RECORD_LAYOUT KF_SK_TR_SB_M_x_AXIS FIX_NO_AXIS_PTS_X 4 AXIS_PTS_X 0 UBYTE INDEX_INCR DIRECT /end RECORD_LAYOUT
/begin AXIS_PTS KF_SK_TR_SB_M_y_AXIS "-" 0x2270 y KF_SK_TR_SB_M_y_AXIS 100.000000 F00031 4 0.000000 255.000000 /end AXIS_PTS
/begin RECORD_LAYOUT KF_SK_TR_SB_M_y_AXIS FIX_NO_AXIS_PTS_Y 4 AXIS_PTS_Y 0 UBYTE INDEX_INCR DIRECT /end RECORD_LAYOUT
/begin CHARACTERISTIC KL_SLP_UB "-" CURVE 0x3534 VALUE_KL_SLP_UB 100.000000 F00220 0.000000 255.000000
 /begin AXIS_DESCR COM_AXIS ub F00018 6 0.000000 20.000000 AXIS_PTS_REF KL_SLP_UB_ub_AXIS /end AXIS_DESCR
 FUNCTION_LIST Sekundaerluftsystem /end CHARACTERISTIC
/begin RECORD_LAYOUT VALUE_KL_SLP_UB FNC_VALUES 0 UBYTE ROW_DIR DIRECT /end RECORD_LAYOUT
/begin AXIS_PTS KL_SLP_UB_ub_AXIS "-" 0x352E ub KL_SLP_UB_ub_AXIS 100.000000 F00018 6 0.000000 20.000000 /end AXIS_PTS
/begin RECORD_LAYOUT KL_SLP_UB_ub_AXIS FIX_NO_AXIS_PTS_X 6 AXIS_PTS_X 0 UBYTE INDEX_INCR DIRECT /end RECORD_LAYOUT
/begin CHARACTERISTIC KL_SLP_ML "-" CURVE 0x3540 VALUE_KL_SLP_ML 100.000000 F00099 0.000000 0.000000
 /begin AXIS_DESCR COM_AXIS ml F00221 4 0.000000 1020.000000 AXIS_PTS_REF KL_SLP_ML_ml_AXIS /end AXIS_DESCR
 FUNCTION_LIST Sekundaerluftsystem /end CHARACTERISTIC
/begin RECORD_LAYOUT VALUE_KL_SLP_ML FNC_VALUES 0 UBYTE ROW_DIR DIRECT /end RECORD_LAYOUT
/begin AXIS_PTS KL_SLP_ML_ml_AXIS "-" 0x353C ml KL_SLP_ML_ml_AXIS 100.000000 F00221 4 0.000000 1020.000000 /end AXIS_PTS
/begin RECORD_LAYOUT KL_SLP_ML_ml_AXIS FIX_NO_AXIS_PTS_X 4 AXIS_PTS_X 0 UBYTE INDEX_INCR DIRECT /end RECORD_LAYOUT
/begin CHARACTERISTIC KL_SLP_P_UMG "-" CURVE 0x354A VALUE_KL_SLP_P_UMG 100.000000 F00099 0.000000 0.000000
 /begin AXIS_DESCR COM_AXIS p_umg F00104 4 500.000000 1150.000000 AXIS_PTS_REF KL_SLP_P_UMG_p_umg_AXIS /end AXIS_DESCR
 FUNCTION_LIST Sekundaerluftsystem /end CHARACTERISTIC
/begin RECORD_LAYOUT VALUE_KL_SLP_P_UMG FNC_VALUES 0 UBYTE ROW_DIR DIRECT /end RECORD_LAYOUT
/begin AXIS_PTS KL_SLP_P_UMG_p_umg_AXIS "-" 0x3546 p_umg KL_SLP_P_UMG_p_umg_AXIS 100.000000 F00104 4 500.000000 1150.000000 /end AXIS_PTS
/begin RECORD_LAYOUT KL_SLP_P_UMG_p_umg_AXIS FIX_NO_AXIS_PTS_X 4 AXIS_PTS_X 0 UBYTE INDEX_INCR DIRECT /end RECORD_LAYOUT
/begin CHARACTERISTIC KL_SLS_DIAG_KORR "-" CURVE 0x35F6 VALUE_KL_SLS_DIAG_KORR 100.000000 F00085 0.000000 2.000000
 /begin AXIS_DESCR COM_AXIS ml F00095 4 0.000000 1400.000000 AXIS_PTS_REF KL_SLS_DIAG_KORR_ml_AXIS /end AXIS_DESCR
 FUNCTION_LIST Sekundaerluftsystem /end CHARACTERISTIC
/begin RECORD_LAYOUT VALUE_KL_SLS_DIAG_KORR FNC_VALUES 0 UWORD ROW_DIR DIRECT /end RECORD_LAYOUT
/begin AXIS_PTS KL_SLS_DIAG_KORR_ml_AXIS "-" 0x35EE ml KL_SLS_DIAG_KORR_ml_AXIS 100.000000 F00095 4 0.000000 1400.000000 /end AXIS_PTS
/begin RECORD_LAYOUT KL_SLS_DIAG_KORR_ml_AXIS FIX_NO_AXIS_PTS_X 4 AXIS_PTS_X 0 UWORD INDEX_INCR DIRECT /end RECORD_LAYOUT
/begin CHARACTERISTIC KL_SLV_ZYKLUS1 "-" CURVE 0x3566 VALUE_KL_SLV_ZYKLUS1 100.000000 F00013 0.000000 1.000000
 /begin AXIS_DESCR COM_AXIS t_ml F00017 4 0.000000 65535.000000 AXIS_PTS_REF KL_SLV_ZYKLUS1_t_ml_AXIS /end AXIS_DESCR
 FUNCTION_LIST Sekundaerluftsystem /end CHARACTERISTIC
/begin RECORD_LAYOUT VALUE_KL_SLV_ZYKLUS1 FNC_VALUES 0 UWORD ROW_DIR DIRECT /end RECORD_LAYOUT
/begin AXIS_PTS KL_SLV_ZYKLUS1_t_ml_AXIS "-" 0x355E t_ml KL_SLV_ZYKLUS1_t_ml_AXIS 100.000000 F00017 4 0.000000 65535.000000 /end AXIS_PTS
/begin RECORD_LAYOUT KL_SLV_ZYKLUS1_t_ml_AXIS FIX_NO_AXIS_PTS_X 4 AXIS_PTS_X 0 UWORD INDEX_INCR DIRECT /end RECORD_LAYOUT
/begin CHARACTERISTIC KL_SLV_ZYKLUS2 "-" CURVE 0x3578 VALUE_KL_SLV_ZYKLUS2 100.000000 F00013 0.000000 1.000000
 /begin AXIS_DESCR COM_AXIS t_ml F00017 4 0.000000 65535.000000 AXIS_PTS_REF KL_SLV_ZYKLUS2_t_ml_AXIS /end AXIS_DESCR
 FUNCTION_LIST Sekundaerluftsystem /end CHARACTERISTIC
/begin RECORD_LAYOUT VALUE_KL_SLV_ZYKLUS2 FNC_VALUES 0 UWORD ROW_DIR DIRECT /end RECORD_LAYOUT
/begin AXIS_PTS KL_SLV_ZYKLUS2_t_ml_AXIS "-" 0x3570 t_ml KL_SLV_ZYKLUS2_t_ml_AXIS 100.000000 F00017 4 0.000000 65535.000000 /end AXIS_PTS
/begin RECORD_LAYOUT KL_SLV_ZYKLUS2_t_ml_AXIS FIX_NO_AXIS_PTS_X 4 AXIS_PTS_X 0 UWORD INDEX_INCR DIRECT /end RECORD_LAYOUT
/begin CHARACTERISTIC KL_SLV_ZYKLUS3 "-" CURVE 0x358A VALUE_KL_SLV_ZYKLUS3 100.000000 F00013 0.000000 1.000000
 /begin AXIS_DESCR COM_AXIS t_ml F00017 4 0.000000 65535.000000 AXIS_PTS_REF KL_SLV_ZYKLUS3_t_ml_AXIS /end AXIS_DESCR
 FUNCTION_LIST Sekundaerluftsystem /end CHARACTERISTIC
/begin RECORD_LAYOUT VALUE_KL_SLV_ZYKLUS3 FNC_VALUES 0 UWORD ROW_DIR DIRECT /end RECORD_LAYOUT
/begin AXIS_PTS KL_SLV_ZYKLUS3_t_ml_AXIS "-" 0x3582 t_ml KL_SLV_ZYKLUS3_t_ml_AXIS 100.000000 F00017 4 0.000000 65535.000000 /end AXIS_PTS
/begin RECORD_LAYOUT KL_SLV_ZYKLUS3_t_ml_AXIS FIX_NO_AXIS_PTS_X 4 AXIS_PTS_X 0 UWORD INDEX_INCR DIRECT /end RECORD_LAYOUT
/begin CHARACTERISTIC KL_SLV_ZYKLUS4 "-" CURVE 0x359C VALUE_KL_SLV_ZYKLUS4 100.000000 F00013 0.000000 1.000000
 /begin AXIS_DESCR COM_AXIS t_ml F00017 4 0.000000 65535.000000 AXIS_PTS_REF KL_SLV_ZYKLUS4_t_ml_AXIS /end AXIS_DESCR
 FUNCTION_LIST Sekundaerluftsystem /end CHARACTERISTIC
/begin RECORD_LAYOUT VALUE_KL_SLV_ZYKLUS4 FNC_VALUES 0 UWORD ROW_DIR DIRECT /end RECORD_LAYOUT
/begin AXIS_PTS KL_SLV_ZYKLUS4_t_ml_AXIS "-" 0x3594 t_ml KL_SLV_ZYKLUS4_t_ml_AXIS 100.000000 F00017 4 0.000000 65535.000000 /end AXIS_PTS
/begin RECORD_LAYOUT KL_SLV_ZYKLUS4_t_ml_AXIS FIX_NO_AXIS_PTS_X 4 AXIS_PTS_X 0 UWORD INDEX_INCR DIRECT /end RECORD_LAYOUT
/begin CHARACTERISTIC KL_SLV_ZYKLUS5 "-" CURVE 0x35AE VALUE_KL_SLV_ZYKLUS5 100.000000 F00013 0.000000 1.000000
 /begin AXIS_DESCR COM_AXIS t_ml F00017 4 0.000000 65535.000000 AXIS_PTS_REF KL_SLV_ZYKLUS5_t_ml_AXIS /end AXIS_DESCR
 FUNCTION_LIST Sekundaerluftsystem /end CHARACTERISTIC
/begin RECORD_LAYOUT VALUE_KL_SLV_ZYKLUS5 FNC_VALUES 0 UWORD ROW_DIR DIRECT /end RECORD_LAYOUT
/begin AXIS_PTS KL_SLV_ZYKLUS5_t_ml_AXIS "-" 0x35A6 t_ml KL_SLV_ZYKLUS5_t_ml_AXIS 100.000000 F00017 4 0.000000 65535.000000 /end AXIS_PTS
/begin RECORD_LAYOUT KL_SLV_ZYKLUS5_t_ml_AXIS FIX_NO_AXIS_PTS_X 4 AXIS_PTS_X 0 UWORD INDEX_INCR DIRECT /end RECORD_LAYOUT
/begin CHARACTERISTIC KL_START_ENDE "-" CURVE 0x34B6 VALUE_KL_START_ENDE 100.000000 F00007 0.000000 10000.000000
 /begin AXIS_DESCR COM_AXIS tmot F00014 6 -48.000000 65487.000000 AXIS_PTS_REF KL_START_ENDE_tmot_AXIS /end AXIS_DESCR
 FUNCTION_LIST Startrelais /end CHARACTERISTIC
/begin RECORD_LAYOUT VALUE_KL_START_ENDE FNC_VALUES 0 UWORD ROW_DIR DIRECT /end RECORD_LAYOUT
/begin AXIS_PTS KL_START_ENDE_tmot_AXIS "-" 0x34AA tmot KL_START_ENDE_tmot_AXIS 100.000000 F00014 6 -48.000000 65487.000000 /end AXIS_PTS
/begin RECORD_LAYOUT KL_START_ENDE_tmot_AXIS FIX_NO_AXIS_PTS_X 6 AXIS_PTS_X 0 UWORD INDEX_INCR DIRECT /end RECORD_LAYOUT
/begin CHARACTERISTIC KL_SWE_SW_DIFF "-" CURVE 0xA5A VALUE_KL_SWE_SW_DIFF 100.000000 F00225 0.000000 5.000000
 /begin AXIS_DESCR COM_AXIS v F00004 6 0.000000 360.000000 AXIS_PTS_REF KL_SWE_SW_DIFF_v_AXIS /end AXIS_DESCR
 FUNCTION_LIST Schlechtweg-Erkennung /end CHARACTERISTIC
/begin RECORD_LAYOUT VALUE_KL_SWE_SW_DIFF FNC_VALUES 0 UWORD ROW_DIR DIRECT /end RECORD_LAYOUT
/begin AXIS_PTS KL_SWE_SW_DIFF_v_AXIS "-" 0xA4E v KL_SWE_SW_DIFF_v_AXIS 100.000000 F00004 6 0.000000 360.000000 /end AXIS_PTS
/begin RECORD_LAYOUT KL_SWE_SW_DIFF_v_AXIS FIX_NO_AXIS_PTS_X 6 AXIS_PTS_X 0 UWORD INDEX_INCR DIRECT /end RECORD_LAYOUT
/begin CHARACTERISTIC KL_TABG_ERSATZ_TAU "-" CURVE 0x1E60 VALUE_KL_TABG_ERSATZ_TAU 100.000000 F00019 0.000000 6553500.000000
 /begin AXIS_DESCR COM_AXIS ml F00095 4 0.000000 1400.000000 AXIS_PTS_REF KL_TABG_ERSATZ_TAU_ml_AXIS /end AXIS_DESCR
 FUNCTION_LIST Messwerte /end CHARACTERISTIC
/begin RECORD_LAYOUT VALUE_KL_TABG_ERSATZ_TAU FNC_VALUES 0 UWORD ROW_DIR DIRECT /end RECORD_LAYOUT
/begin AXIS_PTS KL_TABG_ERSATZ_TAU_ml_AXIS "-" 0x1E58 ml KL_TABG_ERSATZ_TAU_ml_AXIS 100.000000 F00095 4 0.000000 1400.000000 /end AXIS_PTS
/begin RECORD_LAYOUT KL_TABG_ERSATZ_TAU_ml_AXIS FIX_NO_AXIS_PTS_X 4 AXIS_PTS_X 0 UWORD INDEX_INCR DIRECT /end RECORD_LAYOUT
/begin CHARACTERISTIC KL_TABG_ERSATZ_TI "-" CURVE 0x1E6E VALUE_KL_TABG_ERSATZ_TI 100.000000 F00056 0.000000 1.000000
 /begin AXIS_DESCR /* md_la_ist */ COM_AXIS md_la_ist F00056 4 0.000000 1.000000 AXIS_PTS_REF KL_TABG_ERSATZ_TI_md_la_ist_AXIS /end AXIS_DESCR
 FUNCTION_LIST Messwerte /end CHARACTERISTIC
/begin RECORD_LAYOUT VALUE_KL_TABG_ERSATZ_TI FNC_VALUES 0 UBYTE ROW_DIR DIRECT /end RECORD_LAYOUT
/begin AXIS_PTS KL_TABG_ERSATZ_TI_md_la_ist_AXIS "-" 0x1E6A md_la_ist KL_TABG_ERSATZ_TI_md_la_ist_AXIS 100.000000 F00056 4 0.000000 1.000000 /end AXIS_PTS
/begin RECORD_LAYOUT KL_TABG_ERSATZ_TI_md_la_ist_AXIS FIX_NO_AXIS_PTS_X 4 AXIS_PTS_X 0 UBYTE INDEX_INCR DIRECT /end RECORD_LAYOUT
/begin CHARACTERISTIC KL_TABG_ERSATZ_TZ "-" CURVE 0x1E7C VALUE_KL_TABG_ERSATZ_TZ 100.000000 F00056 0.000000 2.000000
 /begin AXIS_DESCR /* md_eta_ne */ COM_AXIS md_eta_ne F00177 4 0.000000 100.000000 AXIS_PTS_REF KL_TABG_ERSATZ_TZ_md_eta_ne_AXIS /end AXIS_DESCR
 FUNCTION_LIST Messwerte /end CHARACTERISTIC
/begin RECORD_LAYOUT VALUE_KL_TABG_ERSATZ_TZ FNC_VALUES 0 UWORD ROW_DIR DIRECT /end RECORD_LAYOUT
/begin AXIS_PTS KL_TABG_ERSATZ_TZ_md_eta_ne_AXIS "-" 0x1E74 md_eta_ne KL_TABG_ERSATZ_TZ_md_eta_ne_AXIS 100.000000 F00177 4 0.000000 100.000000 /end AXIS_PTS
/begin RECORD_LAYOUT KL_TABG_ERSATZ_TZ_md_eta_ne_AXIS FIX_NO_AXIS_PTS_X 4 AXIS_PTS_X 0 UWORD INDEX_INCR DIRECT /end RECORD_LAYOUT
/begin CHARACTERISTIC KL_TABG_STAND "-" CURVE 0x1E92 VALUE_KL_TABG_STAND 100.000000 F00085 0.000000 4.000000
 /begin AXIS_DESCR /* tabg_stand */ COM_AXIS tabg_stand F00223 6 0.000000 65535.000000 AXIS_PTS_REF KL_TABG_STAND_tabg_stand_AXIS /end AXIS_DESCR
 FUNCTION_LIST Messwerte /end CHARACTERISTIC
/begin RECORD_LAYOUT VALUE_KL_TABG_STAND FNC_VALUES 0 UWORD ROW_DIR DIRECT /end RECORD_LAYOUT
/begin AXIS_PTS KL_TABG_STAND_tabg_stand_AXIS "-" 0x1E86 tabg_stand KL_TABG_STAND_tabg_stand_AXIS 100.000000 F00223 6 0.000000 65535.000000 /end AXIS_PTS
/begin RECORD_LAYOUT KL_TABG_STAND_tabg_stand_AXIS FIX_NO_AXIS_PTS_X 6 AXIS_PTS_X 0 UWORD INDEX_INCR DIRECT /end RECORD_LAYOUT
/begin CHARACTERISTIC KL_TABG_PT200 "-" CURVE 0x1EC4 VALUE_KL_TABG_PT200 100.000000 F00015 -55.000000 1250.000000
 /begin AXIS_DESCR /* ad_tabg */ COM_AXIS ad_tabg F00013 18 0.000000 1023.000000 AXIS_PTS_REF KL_TABG_PT200_ad_tabg_AXIS /end AXIS_DESCR
 FUNCTION_LIST Messwerte /end CHARACTERISTIC
/begin RECORD_LAYOUT VALUE_KL_TABG_PT200 FNC_VALUES 0 SWORD ROW_DIR DIRECT /end RECORD_LAYOUT
/begin AXIS_PTS KL_TABG_PT200_ad_tabg_AXIS "-" 0x1EA0 ad_tabg KL_TABG_PT200_ad_tabg_AXIS 100.000000 F00013 18 0.000000 1023.000000 /end AXIS_PTS
/begin RECORD_LAYOUT KL_TABG_PT200_ad_tabg_AXIS FIX_NO_AXIS_PTS_X 18 AXIS_PTS_X 0 UWORD INDEX_INCR DIRECT /end RECORD_LAYOUT
/begin CHARACTERISTIC KF_TABG_ERSATZ "-" MAP 0x1EFC VALUE_KF_TABG_ERSATZ 100.000000 F00235 0.000000 1000.000000
 /begin AXIS_DESCR COM_AXIS n F00007 6 0.000000 10000.000000 AXIS_PTS_REF KF_TABG_ERSATZ_n_AXIS /end AXIS_DESCR
 /begin AXIS_DESCR COM_AXIS rf F00068 3 0.000000 2.000000 AXIS_PTS_REF KF_TABG_ERSATZ_rf_AXIS /end AXIS_DESCR
 FUNCTION_LIST Messwerte /end CHARACTERISTIC
/begin RECORD_LAYOUT VALUE_KF_TABG_ERSATZ FNC_VALUES 0 UWORD ROW_DIR DIRECT /end RECORD_LAYOUT
/begin AXIS_PTS KF_TABG_ERSATZ_n_AXIS "-" 0x1EEA n KF_TABG_ERSATZ_n_AXIS 100.000000 F00007 6 0.000000 10000.000000 /end AXIS_PTS
/begin RECORD_LAYOUT KF_TABG_ERSATZ_n_AXIS FIX_NO_AXIS_PTS_X 6 AXIS_PTS_X 0 UWORD INDEX_INCR DIRECT /end RECORD_LAYOUT
/begin AXIS_PTS KF_TABG_ERSATZ_rf_AXIS "-" 0x1EF6 rf KF_TABG_ERSATZ_rf_AXIS 100.000000 F00068 3 0.000000 2.000000 /end AXIS_PTS
/begin RECORD_LAYOUT KF_TABG_ERSATZ_rf_AXIS FIX_NO_AXIS_PTS_Y 3 AXIS_PTS_Y 0 UWORD INDEX_INCR DIRECT /end RECORD_LAYOUT
/begin CHARACTERISTIC KL_TAN_NTC "-" CURVE 0x1DA0 VALUE_KL_TAN_NTC 100.000000 F00236 -48.000000 207.000000
 /begin AXIS_DESCR /* ad_tan */ COM_AXIS ad_tan F00013 8 0.000000 1023.000000 AXIS_PTS_REF KL_TAN_NTC_ad_tan_AXIS /end AXIS_DESCR
 FUNCTION_LIST Messwerte /end CHARACTERISTIC
/begin RECORD_LAYOUT VALUE_KL_TAN_NTC FNC_VALUES 0 UWORD ROW_DIR DIRECT /end RECORD_LAYOUT
/begin AXIS_PTS KL_TAN_NTC_ad_tan_AXIS "-" 0x1D90 ad_tan KL_TAN_NTC_ad_tan_AXIS 100.000000 F00013 8 0.000000 1023.000000 /end AXIS_PTS
/begin RECORD_LAYOUT KL_TAN_NTC_ad_tan_AXIS FIX_NO_AXIS_PTS_X 8 AXIS_PTS_X 0 UWORD INDEX_INCR DIRECT /end RECORD_LAYOUT
/begin CHARACTERISTIC KL_TKATM_AUFHEIZ "-" CURVE 0x1F8A VALUE_KL_TKATM_AUFHEIZ 100.000000 F00238 0.000000 599.000000
 /begin AXIS_DESCR COM_AXIS ml F00095 6 0.000000 1400.000000 AXIS_PTS_REF KL_TKATM_AUFHEIZ_ml_AXIS /end AXIS_DESCR
 FUNCTION_LIST Messwerte /end CHARACTERISTIC
/begin RECORD_LAYOUT VALUE_KL_TKATM_AUFHEIZ FNC_VALUES 0 UWORD ROW_DIR DIRECT /end RECORD_LAYOUT
/begin AXIS_PTS KL_TKATM_AUFHEIZ_ml_AXIS "-" 0x1F7E ml KL_TKATM_AUFHEIZ_ml_AXIS 100.000000 F00095 6 0.000000 1400.000000 /end AXIS_PTS
/begin RECORD_LAYOUT KL_TKATM_AUFHEIZ_ml_AXIS FIX_NO_AXIS_PTS_X 6 AXIS_PTS_X 0 UWORD INDEX_INCR DIRECT /end RECORD_LAYOUT
/begin CHARACTERISTIC KL_TKATM_ABKUEHL "-" CURVE 0x1FA4 VALUE_KL_TKATM_ABKUEHL 100.000000 F00238 0.000000 599.000000
 /begin AXIS_DESCR COM_AXIS ml F00095 6 0.000000 1400.000000 AXIS_PTS_REF KL_TKATM_ABKUEHL_ml_AXIS /end AXIS_DESCR
 FUNCTION_LIST Messwerte /end CHARACTERISTIC
/begin RECORD_LAYOUT VALUE_KL_TKATM_ABKUEHL FNC_VALUES 0 UWORD ROW_DIR DIRECT /end RECORD_LAYOUT
/begin AXIS_PTS KL_TKATM_ABKUEHL_ml_AXIS "-" 0x1F98 ml KL_TKATM_ABKUEHL_ml_AXIS 100.000000 F00095 6 0.000000 1400.000000 /end AXIS_PTS
/begin RECORD_LAYOUT KL_TKATM_ABKUEHL_ml_AXIS FIX_NO_AXIS_PTS_X 6 AXIS_PTS_X 0 UWORD INDEX_INCR DIRECT /end RECORD_LAYOUT
/begin CHARACTERISTIC KL_TKATM_STAND "-" CURVE 0x1FBE VALUE_KL_TKATM_STAND 100.000000 F00085 0.000000 4.000000
 /begin AXIS_DESCR /* tkatm_stand */ COM_AXIS tkatm_stand F00223 6 0.000000 65535.000000 AXIS_PTS_REF KL_TKATM_STAND_tkatm_stand_AXIS /end AXIS_DESCR
 FUNCTION_LIST Messwerte /end CHARACTERISTIC
/begin RECORD_LAYOUT VALUE_KL_TKATM_STAND FNC_VALUES 0 UWORD ROW_DIR DIRECT /end RECORD_LAYOUT
/begin AXIS_PTS KL_TKATM_STAND_tkatm_stand_AXIS "-" 0x1FB2 tkatm_stand KL_TKATM_STAND_tkatm_stand_AXIS 100.000000 F00223 6 0.000000 65535.000000 /end AXIS_PTS
/begin RECORD_LAYOUT KL_TKATM_STAND_tkatm_stand_AXIS FIX_NO_AXIS_PTS_X 6 AXIS_PTS_X 0 UWORD INDEX_INCR DIRECT /end RECORD_LAYOUT
/begin CHARACTERISTIC KL_TDME_NTC "-" CURVE 0x1F50 VALUE_KL_TDME_NTC 100.000000 F00240 -48.000000 140.000000
 /begin AXIS_DESCR /* ad_tdme */ COM_AXIS ad_tdme F00013 18 0.000000 1023.000000 AXIS_PTS_REF KL_TDME_NTC_ad_tdme_AXIS /end AXIS_DESCR
 FUNCTION_LIST Messwerte /end CHARACTERISTIC
/begin RECORD_LAYOUT VALUE_KL_TDME_NTC FNC_VALUES 0 UWORD ROW_DIR DIRECT /end RECORD_LAYOUT
/begin AXIS_PTS KL_TDME_NTC_ad_tdme_AXIS "-" 0x1F2C ad_tdme KL_TDME_NTC_ad_tdme_AXIS 100.000000 F00013 18 0.000000 1023.000000 /end AXIS_PTS
/begin RECORD_LAYOUT KL_TDME_NTC_ad_tdme_AXIS FIX_NO_AXIS_PTS_X 18 AXIS_PTS_X 0 UWORD INDEX_INCR DIRECT /end RECORD_LAYOUT
/begin CHARACTERISTIC KL_TMOT_NTC "-" CURVE 0x1DD6 VALUE_KL_TMOT_NTC 100.000000 F00241 -48.000000 207.000000
 /begin AXIS_DESCR /* ad_tmot */ COM_AXIS ad_tmot F00013 10 0.000000 1023.000000 AXIS_PTS_REF KL_TMOT_NTC_ad_tmot_AXIS /end AXIS_DESCR
 FUNCTION_LIST Messwerte /end CHARACTERISTIC
/begin RECORD_LAYOUT VALUE_KL_TMOT_NTC FNC_VALUES 0 UWORD ROW_DIR DIRECT /end RECORD_LAYOUT
/begin AXIS_PTS KL_TMOT_NTC_ad_tmot_AXIS "-" 0x1DC2 ad_tmot KL_TMOT_NTC_ad_tmot_AXIS 100.000000 F00013 10 0.000000 1023.000000 /end AXIS_PTS
/begin RECORD_LAYOUT KL_TMOT_NTC_ad_tmot_AXIS FIX_NO_AXIS_PTS_X 10 AXIS_PTS_X 0 UWORD INDEX_INCR DIRECT /end RECORD_LAYOUT
/begin CHARACTERISTIC KL_TMOT_LA_TIME_MIN "-" CURVE 0x1DF4 VALUE_KL_TMOT_LA_TIME_MIN 100.000000 F00028 0.000000 6554.000000
 /begin AXIS_DESCR COM_AXIS tmot F00014 4 -48.000000 207.000000 AXIS_PTS_REF KL_TMOT_LA_TIME_MIN_tmot_AXIS /end AXIS_DESCR
 FUNCTION_LIST Messwerte /end CHARACTERISTIC
/begin RECORD_LAYOUT VALUE_KL_TMOT_LA_TIME_MIN FNC_VALUES 0 UWORD ROW_DIR DIRECT /end RECORD_LAYOUT
/begin AXIS_PTS KL_TMOT_LA_TIME_MIN_tmot_AXIS "-" 0x1DEC tmot KL_TMOT_LA_TIME_MIN_tmot_AXIS 100.000000 F00014 4 -48.000000 207.000000 /end AXIS_PTS
/begin RECORD_LAYOUT KL_TMOT_LA_TIME_MIN_tmot_AXIS FIX_NO_AXIS_PTS_X 4 AXIS_PTS_X 0 UWORD INDEX_INCR DIRECT /end RECORD_LAYOUT
/begin CHARACTERISTIC KL_TMOT_WL_TIME_MIN "-" CURVE 0x1E06 VALUE_KL_TMOT_WL_TIME_MIN 100.000000 F00017 2.000000 65535.000000
 /begin AXIS_DESCR COM_AXIS tmot F00014 4 -48.000000 207.000000 AXIS_PTS_REF KL_TMOT_WL_TIME_MIN_tmot_AXIS /end AXIS_DESCR
 FUNCTION_LIST Messwerte /end CHARACTERISTIC
/begin RECORD_LAYOUT VALUE_KL_TMOT_WL_TIME_MIN FNC_VALUES 0 UWORD ROW_DIR DIRECT /end RECORD_LAYOUT
/begin AXIS_PTS KL_TMOT_WL_TIME_MIN_tmot_AXIS "-" 0x1DFE tmot KL_TMOT_WL_TIME_MIN_tmot_AXIS 100.000000 F00014 4 -48.000000 207.000000 /end AXIS_PTS
/begin RECORD_LAYOUT KL_TMOT_WL_TIME_MIN_tmot_AXIS FIX_NO_AXIS_PTS_X 4 AXIS_PTS_X 0 UWORD INDEX_INCR DIRECT /end RECORD_LAYOUT
/begin CHARACTERISTIC KL_TMOT_LA_TIME_ML "-" CURVE 0x1E1C VALUE_KL_TMOT_LA_TIME_ML 100.000000 F00099 0.000000 4.000000
 /begin AXIS_DESCR COM_AXIS ml F00095 6 0.000000 1400.000000 AXIS_PTS_REF KL_TMOT_LA_TIME_ML_ml_AXIS /end AXIS_DESCR
 FUNCTION_LIST Messwerte /end CHARACTERISTIC
/begin RECORD_LAYOUT VALUE_KL_TMOT_LA_TIME_ML FNC_VALUES 0 UWORD ROW_DIR DIRECT /end RECORD_LAYOUT
/begin AXIS_PTS KL_TMOT_LA_TIME_ML_ml_AXIS "-" 0x1E10 ml KL_TMOT_LA_TIME_ML_ml_AXIS 100.000000 F00095 6 0.000000 1400.000000 /end AXIS_PTS
/begin RECORD_LAYOUT KL_TMOT_LA_TIME_ML_ml_AXIS FIX_NO_AXIS_PTS_X 6 AXIS_PTS_X 0 UWORD INDEX_INCR DIRECT /end RECORD_LAYOUT
/begin CHARACTERISTIC KL_TMOT_MODELL_ML "-" CURVE 0x1E36 VALUE_KL_TMOT_MODELL_ML 100.000000 F00242 0.000000 10.000000
 /begin AXIS_DESCR COM_AXIS ml F00095 6 0.000000 1400.000000 AXIS_PTS_REF KL_TMOT_MODELL_ML_ml_AXIS /end AXIS_DESCR
 FUNCTION_LIST Messwerte /end CHARACTERISTIC
/begin RECORD_LAYOUT VALUE_KL_TMOT_MODELL_ML FNC_VALUES 0 UWORD ROW_DIR DIRECT /end RECORD_LAYOUT
/begin AXIS_PTS KL_TMOT_MODELL_ML_ml_AXIS "-" 0x1E2A ml KL_TMOT_MODELL_ML_ml_AXIS 100.000000 F00095 6 0.000000 1400.000000 /end AXIS_PTS
/begin RECORD_LAYOUT KL_TMOT_MODELL_ML_ml_AXIS FIX_NO_AXIS_PTS_X 6 AXIS_PTS_X 0 UWORD INDEX_INCR DIRECT /end RECORD_LAYOUT
/begin CHARACTERISTIC KL_TOG_NIVEAU "-" CURVE 0x1B95 VALUE_KL_TOG_NIVEAU 100.000000 F00000 0.000000 255.000000
 /begin AXIS_DESCR /* tog_n */ COM_AXIS tog_n F00109 15 0.000000 10000.000000 AXIS_PTS_REF KL_TOG_NIVEAU_tog_n_AXIS /end AXIS_DESCR
 FUNCTION_LIST Oelniveaugeber /end CHARACTERISTIC
/begin RECORD_LAYOUT VALUE_KL_TOG_NIVEAU FNC_VALUES 0 UBYTE ROW_DIR DIRECT /end RECORD_LAYOUT
/begin AXIS_PTS KL_TOG_NIVEAU_tog_n_AXIS "-" 0x1B86 tog_n KL_TOG_NIVEAU_tog_n_AXIS 100.000000 F00109 15 0.000000 10000.000000 /end AXIS_PTS
/begin RECORD_LAYOUT KL_TOG_NIVEAU_tog_n_AXIS FIX_NO_AXIS_PTS_X 15 AXIS_PTS_X 0 UBYTE INDEX_INCR DIRECT /end RECORD_LAYOUT
/begin CHARACTERISTIC KL_TOG_IMP_MIN1 "-" CURVE 0x1BB6 VALUE_KL_TOG_IMP_MIN1 100.000000 F00248 0.000000 65535.000000
 /begin AXIS_DESCR COM_AXIS n F00007 8 0.000000 10000.000000 AXIS_PTS_REF KL_TOG_IMP_MIN1_n_AXIS /end AXIS_DESCR
 FUNCTION_LIST Oelniveaugeber /end CHARACTERISTIC
/begin RECORD_LAYOUT VALUE_KL_TOG_IMP_MIN1 FNC_VALUES 0 UWORD ROW_DIR DIRECT /end RECORD_LAYOUT
/begin AXIS_PTS KL_TOG_IMP_MIN1_n_AXIS "-" 0x1BA6 n KL_TOG_IMP_MIN1_n_AXIS 100.000000 F00007 8 0.000000 10000.000000 /end AXIS_PTS
/begin RECORD_LAYOUT KL_TOG_IMP_MIN1_n_AXIS FIX_NO_AXIS_PTS_X 8 AXIS_PTS_X 0 UWORD INDEX_INCR DIRECT /end RECORD_LAYOUT
/begin CHARACTERISTIC KL_TOG_ASCAY_DIFF "-" CURVE 0x1C38 VALUE_KL_TOG_ASCAY_DIFF 100.000000 F00000 -10.000000 10.000000
 /begin AXIS_DESCR /* afz */ COM_AXIS afz F00254 6 -3276.000000 3276.000000 AXIS_PTS_REF KL_TOG_ASCAY_DIFF_afz_AXIS /end AXIS_DESCR
 FUNCTION_LIST Oelniveaugeber /end CHARACTERISTIC
/begin RECORD_LAYOUT VALUE_KL_TOG_ASCAY_DIFF FNC_VALUES 0 SWORD ROW_DIR DIRECT /end RECORD_LAYOUT
/begin AXIS_PTS KL_TOG_ASCAY_DIFF_afz_AXIS "-" 0x1C2C afz KL_TOG_ASCAY_DIFF_afz_AXIS 100.000000 F00254 6 -3276.000000 3276.000000 /end AXIS_PTS
/begin RECORD_LAYOUT KL_TOG_ASCAY_DIFF_afz_AXIS FIX_NO_AXIS_PTS_X 6 AXIS_PTS_X 0 UWORD INDEX_INCR DIRECT /end RECORD_LAYOUT
/begin CHARACTERISTIC KL_TOG_P_DIFF "-" CURVE 0x1C52 VALUE_KL_TOG_P_DIFF 100.000000 F00000 -20.000000 20.000000
 /begin AXIS_DESCR /* p_umg_hoehe */ COM_AXIS p_umg_hoehe F00255 6 -500.000000 65035.000000 AXIS_PTS_REF KL_TOG_P_DIFF_p_umg_hoehe_AXIS /end AXIS_DESCR
 FUNCTION_LIST Oelniveaugeber /end CHARACTERISTIC
/begin RECORD_LAYOUT VALUE_KL_TOG_P_DIFF FNC_VALUES 0 SWORD ROW_DIR DIRECT /end RECORD_LAYOUT
/begin AXIS_PTS KL_TOG_P_DIFF_p_umg_hoehe_AXIS "-" 0x1C46 p_umg_hoehe KL_TOG_P_DIFF_p_umg_hoehe_AXIS 100.000000 F00255 6 -500.000000 65035.000000 /end AXIS_PTS
/begin RECORD_LAYOUT KL_TOG_P_DIFF_p_umg_hoehe_AXIS FIX_NO_AXIS_PTS_X 6 AXIS_PTS_X 0 UWORD INDEX_INCR DIRECT /end RECORD_LAYOUT
/begin CHARACTERISTIC KL_TOG_TOEL_NKL "-" CURVE 0x1C84 VALUE_KL_TOG_TOEL_NKL 100.000000 F00256 0.000000 15.000000
 /begin AXIS_DESCR COM_AXIS n F00007 4 0.000000 10000.000000 AXIS_PTS_REF KL_TOG_TOEL_NKL_n_AXIS /end AXIS_DESCR
 FUNCTION_LIST Oelniveaugeber /end CHARACTERISTIC
/begin RECORD_LAYOUT VALUE_KL_TOG_TOEL_NKL FNC_VALUES 0 UWORD ROW_DIR DIRECT /end RECORD_LAYOUT
/begin AXIS_PTS KL_TOG_TOEL_NKL_n_AXIS "-" 0x1C7C n KL_TOG_TOEL_NKL_n_AXIS 100.000000 F00007 4 0.000000 10000.000000 /end AXIS_PTS
/begin RECORD_LAYOUT KL_TOG_TOEL_NKL_n_AXIS FIX_NO_AXIS_PTS_X 4 AXIS_PTS_X 0 UWORD INDEX_INCR DIRECT /end RECORD_LAYOUT
/begin CHARACTERISTIC KL_TOG_ASCAX_DIFF "-" CURVE 0x1C9C VALUE_KL_TOG_ASCAX_DIFF 100.000000 F00000 -10.000000 10.000000
 /begin AXIS_DESCR /* afz */ COM_AXIS afz F00254 6 -3276.000000 3276.000000 AXIS_PTS_REF KL_TOG_ASCAX_DIFF_afz_AXIS /end AXIS_DESCR
 FUNCTION_LIST Oelniveaugeber /end CHARACTERISTIC
/begin RECORD_LAYOUT VALUE_KL_TOG_ASCAX_DIFF FNC_VALUES 0 SWORD ROW_DIR DIRECT /end RECORD_LAYOUT
/begin AXIS_PTS KL_TOG_ASCAX_DIFF_afz_AXIS "-" 0x1C90 afz KL_TOG_ASCAX_DIFF_afz_AXIS 100.000000 F00254 6 -3276.000000 3276.000000 /end AXIS_PTS
/begin RECORD_LAYOUT KL_TOG_ASCAX_DIFF_afz_AXIS FIX_NO_AXIS_PTS_X 6 AXIS_PTS_X 0 UWORD INDEX_INCR DIRECT /end RECORD_LAYOUT
/begin CHARACTERISTIC KL_TOG_G_TMOT "-" CURVE 0x1CAD VALUE_KL_TOG_G_TMOT 100.000000 F00099 0.000000 0.000000
 /begin AXIS_DESCR COM_AXIS tmot F00014 3 -48.000000 207.000000 AXIS_PTS_REF KL_TOG_G_TMOT_tmot_AXIS /end AXIS_DESCR
 FUNCTION_LIST Oelniveaugeber /end CHARACTERISTIC
/begin RECORD_LAYOUT VALUE_KL_TOG_G_TMOT FNC_VALUES 0 UBYTE ROW_DIR DIRECT /end RECORD_LAYOUT
/begin AXIS_PTS KL_TOG_G_TMOT_tmot_AXIS "-" 0x1CAA tmot KL_TOG_G_TMOT_tmot_AXIS 100.000000 F00014 3 -48.000000 207.000000 /end AXIS_PTS
/begin RECORD_LAYOUT KL_TOG_G_TMOT_tmot_AXIS FIX_NO_AXIS_PTS_X 3 AXIS_PTS_X 0 UBYTE INDEX_INCR DIRECT /end RECORD_LAYOUT
/begin CHARACTERISTIC KL_TOG_TOEL_UB_KORR "-" CURVE 0x1CBA VALUE_KL_TOG_TOEL_UB_KORR 100.000000 F00085 -32.000000 31.000000
 /begin AXIS_DESCR COM_AXIS ub F00018 4 0.000000 20.000000 AXIS_PTS_REF KL_TOG_TOEL_UB_KORR_ub_AXIS /end AXIS_DESCR
 FUNCTION_LIST Oelniveaugeber /end CHARACTERISTIC
/begin RECORD_LAYOUT VALUE_KL_TOG_TOEL_UB_KORR FNC_VALUES 0 SWORD ROW_DIR DIRECT /end RECORD_LAYOUT
/begin AXIS_PTS KL_TOG_TOEL_UB_KORR_ub_AXIS "-" 0x1CB2 ub KL_TOG_TOEL_UB_KORR_ub_AXIS 100.000000 F00018 4 0.000000 20.000000 /end AXIS_PTS
/begin RECORD_LAYOUT KL_TOG_TOEL_UB_KORR_ub_AXIS FIX_NO_AXIS_PTS_X 4 AXIS_PTS_X 0 UWORD INDEX_INCR DIRECT /end RECORD_LAYOUT
/begin CHARACTERISTIC KF_TOG_TEMP "-" MAP 0x1BEE VALUE_KF_TOG_TEMP 100.000000 F00014 -48.000000 180.000000
 /begin AXIS_DESCR /* tog_heiz */ COM_AXIS tog_heiz F00249 15 0.000000 80.000000 AXIS_PTS_REF KF_TOG_TEMP_tog_heiz_AXIS /end AXIS_DESCR
 /begin AXIS_DESCR /* tog_niveau */ COM_AXIS tog_niveau F00257 4 0.000000 65535.000000 AXIS_PTS_REF KF_TOG_TEMP_tog_niveau_AXIS /end AXIS_DESCR
 FUNCTION_LIST Oelniveaugeber /end CHARACTERISTIC
/begin RECORD_LAYOUT VALUE_KF_TOG_TEMP FNC_VALUES 0 UBYTE ROW_DIR DIRECT /end RECORD_LAYOUT
/begin AXIS_PTS KF_TOG_TEMP_tog_heiz_AXIS "-" 0x1BC8 tog_heiz KF_TOG_TEMP_tog_heiz_AXIS 100.000000 F00249 15 0.000000 80.000000 /end AXIS_PTS
/begin RECORD_LAYOUT KF_TOG_TEMP_tog_heiz_AXIS FIX_NO_AXIS_PTS_X 15 AXIS_PTS_X 0 UWORD INDEX_INCR DIRECT /end RECORD_LAYOUT
/begin AXIS_PTS KF_TOG_TEMP_tog_niveau_AXIS "-" 0x1BE6 tog_niveau KF_TOG_TEMP_tog_niveau_AXIS 100.000000 F00257 4 0.000000 65535.000000 /end AXIS_PTS
/begin RECORD_LAYOUT KF_TOG_TEMP_tog_niveau_AXIS FIX_NO_AXIS_PTS_Y 4 AXIS_PTS_Y 0 UWORD INDEX_INCR DIRECT /end RECORD_LAYOUT
/begin CHARACTERISTIC KF_TOG_TOEL_V "-" MAP 0x1C72 VALUE_KF_TOG_TOEL_V 100.000000 F00258 -32.000000 31.000000
 /begin AXIS_DESCR COM_AXIS v F00004 4 0.000000 255.000000 AXIS_PTS_REF KF_TOG_TOEL_V_v_AXIS /end AXIS_DESCR
 /begin AXIS_DESCR COM_AXIS tan F00014 2 -48.000000 207.000000 AXIS_PTS_REF KF_TOG_TOEL_V_tan_AXIS /end AXIS_DESCR
 FUNCTION_LIST Oelniveaugeber /end CHARACTERISTIC
/begin RECORD_LAYOUT VALUE_KF_TOG_TOEL_V FNC_VALUES 0 SBYTE ROW_DIR DIRECT /end RECORD_LAYOUT
/begin AXIS_PTS KF_TOG_TOEL_V_v_AXIS "-" 0x1C6C v KF_TOG_TOEL_V_v_AXIS 100.000000 F00004 4 0.000000 255.000000 /end AXIS_PTS
/begin RECORD_LAYOUT KF_TOG_TOEL_V_v_AXIS FIX_NO_AXIS_PTS_X 4 AXIS_PTS_X 0 UBYTE INDEX_INCR DIRECT /end RECORD_LAYOUT
/begin AXIS_PTS KF_TOG_TOEL_V_tan_AXIS "-" 0x1C70 tan KF_TOG_TOEL_V_tan_AXIS 100.000000 F00014 2 -48.000000 207.000000 /end AXIS_PTS
/begin RECORD_LAYOUT KF_TOG_TOEL_V_tan_AXIS FIX_NO_AXIS_PTS_Y 2 AXIS_PTS_Y 0 UBYTE INDEX_INCR DIRECT /end RECORD_LAYOUT
/begin CHARACTERISTIC KL_TZ_ZWB_SA "-" CURVE 0x1496 VALUE_KL_TZ_ZWB_SA 100.000000 F00268 -100.000000 0.000000
 /begin AXIS_DESCR COM_AXIS n F00007 4 0.000000 10000.000000 AXIS_PTS_REF KL_TZ_ZWB_SA_n_AXIS /end AXIS_DESCR
 FUNCTION_LIST Zuendung /end CHARACTERISTIC
/begin RECORD_LAYOUT VALUE_KL_TZ_ZWB_SA FNC_VALUES 0 SWORD ROW_DIR DIRECT /end RECORD_LAYOUT
/begin AXIS_PTS KL_TZ_ZWB_SA_n_AXIS "-" 0x148E n KL_TZ_ZWB_SA_n_AXIS 100.000000 F00007 4 0.000000 10000.000000 /end AXIS_PTS
/begin RECORD_LAYOUT KL_TZ_ZWB_SA_n_AXIS FIX_NO_AXIS_PTS_X 4 AXIS_PTS_X 0 UWORD INDEX_INCR DIRECT /end RECORD_LAYOUT
/begin CHARACTERISTIC KL_TZ_ZWB_WE_SOFT "-" CURVE 0x14A8 VALUE_KL_TZ_ZWB_WE_SOFT 100.000000 F00268 0.000000 200.000000
 /begin AXIS_DESCR COM_AXIS n F00007 4 0.000000 10000.000000 AXIS_PTS_REF KL_TZ_ZWB_WE_SOFT_n_AXIS /end AXIS_DESCR
 FUNCTION_LIST Zuendung /end CHARACTERISTIC
/begin RECORD_LAYOUT VALUE_KL_TZ_ZWB_WE_SOFT FNC_VALUES 0 SWORD ROW_DIR DIRECT /end RECORD_LAYOUT
/begin AXIS_PTS KL_TZ_ZWB_WE_SOFT_n_AXIS "-" 0x14A0 n KL_TZ_ZWB_WE_SOFT_n_AXIS 100.000000 F00007 4 0.000000 10000.000000 /end AXIS_PTS
/begin RECORD_LAYOUT KL_TZ_ZWB_WE_SOFT_n_AXIS FIX_NO_AXIS_PTS_X 4 AXIS_PTS_X 0 UWORD INDEX_INCR DIRECT /end RECORD_LAYOUT
/begin CHARACTERISTIC KL_TZ_START_N "-" CURVE 0x14CE VALUE_KL_TZ_START_N 100.000000 F00045 -50.000000 60.000000
 /begin AXIS_DESCR COM_AXIS n F00007 3 0.000000 10000.000000 AXIS_PTS_REF KL_TZ_START_N_n_AXIS /end AXIS_DESCR
 FUNCTION_LIST Zuendung /end CHARACTERISTIC
/begin RECORD_LAYOUT VALUE_KL_TZ_START_N FNC_VALUES 0 SWORD ROW_DIR DIRECT /end RECORD_LAYOUT
/begin AXIS_PTS KL_TZ_START_N_n_AXIS "-" 0x14C8 n KL_TZ_START_N_n_AXIS 100.000000 F00007 3 0.000000 10000.000000 /end AXIS_PTS
/begin RECORD_LAYOUT KL_TZ_START_N_n_AXIS FIX_NO_AXIS_PTS_X 3 AXIS_PTS_X 0 UWORD INDEX_INCR DIRECT /end RECORD_LAYOUT
/begin CHARACTERISTIC KL_TZ_START_TMOT "-" CURVE 0x14DC VALUE_KL_TZ_START_TMOT 100.000000 F00045 -50.000000 60.000000
 /begin AXIS_DESCR COM_AXIS tmot F00014 3 -48.000000 207.000000 AXIS_PTS_REF KL_TZ_START_TMOT_tmot_AXIS /end AXIS_DESCR
 FUNCTION_LIST Zuendung /end CHARACTERISTIC
/begin RECORD_LAYOUT VALUE_KL_TZ_START_TMOT FNC_VALUES 0 SWORD ROW_DIR DIRECT /end RECORD_LAYOUT
/begin AXIS_PTS KL_TZ_START_TMOT_tmot_AXIS "-" 0x14D6 tmot KL_TZ_START_TMOT_tmot_AXIS 100.000000 F00014 3 -48.000000 207.000000 /end AXIS_PTS
/begin RECORD_LAYOUT KL_TZ_START_TMOT_tmot_AXIS FIX_NO_AXIS_PTS_X 3 AXIS_PTS_X 0 UWORD INDEX_INCR DIRECT /end RECORD_LAYOUT
/begin CHARACTERISTIC KL_TZ_TKORR_LL "-" CURVE 0x17A0 VALUE_KL_TZ_TKORR_LL 100.000000 F00045 -50.000000 60.000000
 /begin AXIS_DESCR COM_AXIS tmot F00014 6 -48.000000 207.000000 AXIS_PTS_REF KL_TZ_TKORR_LL_tmot_AXIS /end AXIS_DESCR
 FUNCTION_LIST Zuendung /end CHARACTERISTIC
/begin RECORD_LAYOUT VALUE_KL_TZ_TKORR_LL FNC_VALUES 0 SWORD ROW_DIR DIRECT /end RECORD_LAYOUT
/begin AXIS_PTS KL_TZ_TKORR_LL_tmot_AXIS "-" 0x1794 tmot KL_TZ_TKORR_LL_tmot_AXIS 100.000000 F00014 6 -48.000000 207.000000 /end AXIS_PTS
/begin RECORD_LAYOUT KL_TZ_TKORR_LL_tmot_AXIS FIX_NO_AXIS_PTS_X 6 AXIS_PTS_X 0 UWORD INDEX_INCR DIRECT /end RECORD_LAYOUT
/begin CHARACTERISTIC KL_TZ_TKORR_TL "-" CURVE 0x17BA VALUE_KL_TZ_TKORR_TL 100.000000 F00045 -50.000000 60.000000
 /begin AXIS_DESCR COM_AXIS tmot F00014 6 -48.000000 207.000000 AXIS_PTS_REF KL_TZ_TKORR_TL_tmot_AXIS /end AXIS_DESCR
 FUNCTION_LIST Zuendung /end CHARACTERISTIC
/begin RECORD_LAYOUT VALUE_KL_TZ_TKORR_TL FNC_VALUES 0 SWORD ROW_DIR DIRECT /end RECORD_LAYOUT
/begin AXIS_PTS KL_TZ_TKORR_TL_tmot_AXIS "-" 0x17AE tmot KL_TZ_TKORR_TL_tmot_AXIS 100.000000 F00014 6 -48.000000 207.000000 /end AXIS_PTS
/begin RECORD_LAYOUT KL_TZ_TKORR_TL_tmot_AXIS FIX_NO_AXIS_PTS_X 6 AXIS_PTS_X 0 UWORD INDEX_INCR DIRECT /end RECORD_LAYOUT
/begin CHARACTERISTIC KL_TZ_PHASE "-" CURVE 0x17D0 VALUE_KL_TZ_PHASE 100.000000 F00045 -50.000000 60.000000
 /begin AXIS_DESCR COM_AXIS n F00007 4 0.000000 10000.000000 AXIS_PTS_REF KL_TZ_PHASE_n_AXIS /end AXIS_DESCR
 FUNCTION_LIST Zuendung /end CHARACTERISTIC
/begin RECORD_LAYOUT VALUE_KL_TZ_PHASE FNC_VALUES 0 SWORD ROW_DIR DIRECT /end RECORD_LAYOUT
/begin AXIS_PTS KL_TZ_PHASE_n_AXIS "-" 0x17C8 n KL_TZ_PHASE_n_AXIS 100.000000 F00007 4 0.000000 10000.000000 /end AXIS_PTS
/begin RECORD_LAYOUT KL_TZ_PHASE_n_AXIS FIX_NO_AXIS_PTS_X 4 AXIS_PTS_X 0 UWORD INDEX_INCR DIRECT /end RECORD_LAYOUT
/begin CHARACTERISTIC KL_TZ_MIN_TMOT "-" CURVE 0x1922 VALUE_KL_TZ_MIN_TMOT 100.000000 F00045 -50.000000 60.000000
 /begin AXIS_DESCR COM_AXIS tmot F00014 4 -48.000000 207.000000 AXIS_PTS_REF KL_TZ_MIN_TMOT_tmot_AXIS /end AXIS_DESCR
 FUNCTION_LIST Zuendung /end CHARACTERISTIC
/begin RECORD_LAYOUT VALUE_KL_TZ_MIN_TMOT FNC_VALUES 0 SWORD ROW_DIR DIRECT /end RECORD_LAYOUT
/begin AXIS_PTS KL_TZ_MIN_TMOT_tmot_AXIS "-" 0x191A tmot KL_TZ_MIN_TMOT_tmot_AXIS 100.000000 F00014 4 -48.000000 207.000000 /end AXIS_PTS
/begin RECORD_LAYOUT KL_TZ_MIN_TMOT_tmot_AXIS FIX_NO_AXIS_PTS_X 4 AXIS_PTS_X 0 UWORD INDEX_INCR DIRECT /end RECORD_LAYOUT
/begin CHARACTERISTIC KL_TZ_KATH_ETA_LL "-" CURVE 0x19EC VALUE_KL_TZ_KATH_ETA_LL 100.000000 F00177 0.000000 100.000000
 /begin AXIS_DESCR COM_AXIS n F00007 4 0.000000 10000.000000 AXIS_PTS_REF KL_TZ_KATH_ETA_LL_n_AXIS /end AXIS_DESCR
 FUNCTION_LIST Zuendung /end CHARACTERISTIC
/begin RECORD_LAYOUT VALUE_KL_TZ_KATH_ETA_LL FNC_VALUES 0 UWORD ROW_DIR DIRECT /end RECORD_LAYOUT
/begin AXIS_PTS KL_TZ_KATH_ETA_LL_n_AXIS "-" 0x19E4 n KL_TZ_KATH_ETA_LL_n_AXIS 100.000000 F00007 4 0.000000 10000.000000 /end AXIS_PTS
/begin RECORD_LAYOUT KL_TZ_KATH_ETA_LL_n_AXIS FIX_NO_AXIS_PTS_X 4 AXIS_PTS_X 0 UWORD INDEX_INCR DIRECT /end RECORD_LAYOUT
/begin CHARACTERISTIC KL_TZ_KATH_ETA_PUMG "-" CURVE 0x1AEC VALUE_KL_TZ_KATH_ETA_PUMG 100.000000 F00056 0.000000 1.000000
 /begin AXIS_DESCR COM_AXIS p_umg F00104 4 500.000000 1150.000000 AXIS_PTS_REF KL_TZ_KATH_ETA_PUMG_p_umg_AXIS /end AXIS_DESCR
 FUNCTION_LIST Zuendung /end CHARACTERISTIC
/begin RECORD_LAYOUT VALUE_KL_TZ_KATH_ETA_PUMG FNC_VALUES 0 UBYTE ROW_DIR DIRECT /end RECORD_LAYOUT
/begin AXIS_PTS KL_TZ_KATH_ETA_PUMG_p_umg_AXIS "-" 0x1AE8 p_umg KL_TZ_KATH_ETA_PUMG_p_umg_AXIS 100.000000 F00104 4 500.000000 1150.000000 /end AXIS_PTS
/begin RECORD_LAYOUT KL_TZ_KATH_ETA_PUMG_p_umg_AXIS FIX_NO_AXIS_PTS_X 4 AXIS_PTS_X 0 UBYTE INDEX_INCR DIRECT /end RECORD_LAYOUT
/begin CHARACTERISTIC KF_TZ_LL "-" MAP 0x14F4 VALUE_KF_TZ_LL 100.000000 F00045 -50.000000 60.000000
 /begin AXIS_DESCR COM_AXIS n F00007 6 0.000000 10000.000000 AXIS_PTS_REF KF_TZ_LL_n_AXIS /end AXIS_DESCR
 /begin AXIS_DESCR COM_AXIS rf F00068 2 0.000000 2.000000 AXIS_PTS_REF KF_TZ_LL_rf_AXIS /end AXIS_DESCR
 FUNCTION_LIST Zuendung /end CHARACTERISTIC
/begin RECORD_LAYOUT VALUE_KF_TZ_LL FNC_VALUES 0 SWORD ROW_DIR DIRECT /end RECORD_LAYOUT
/begin AXIS_PTS KF_TZ_LL_n_AXIS "-" 0x14E4 n KF_TZ_LL_n_AXIS 100.000000 F00007 6 0.000000 10000.000000 /end AXIS_PTS
/begin RECORD_LAYOUT KF_TZ_LL_n_AXIS FIX_NO_AXIS_PTS_X 6 AXIS_PTS_X 0 UWORD INDEX_INCR DIRECT /end RECORD_LAYOUT
/begin AXIS_PTS KF_TZ_LL_rf_AXIS "-" 0x14F0 rf KF_TZ_LL_rf_AXIS 100.000000 F00068 2 0.000000 2.000000 /end AXIS_PTS
/begin RECORD_LAYOUT KF_TZ_LL_rf_AXIS FIX_NO_AXIS_PTS_Y 2 AXIS_PTS_Y 0 UWORD INDEX_INCR DIRECT /end RECORD_LAYOUT
/begin CHARACTERISTIC KF_TZ_GRUND "-" MAP 0x154A VALUE_KF_TZ_GRUND 100.000000 F00045 -50.000000 60.000000
 /begin AXIS_DESCR COM_AXIS n F00007 18 0.000000 10000.000000 AXIS_PTS_REF KF_TZ_GRUND_n_AXIS /end AXIS_DESCR
 /begin AXIS_DESCR COM_AXIS rf F00068 12 0.000000 2.000000 AXIS_PTS_REF KF_TZ_GRUND_rf_AXIS /end AXIS_DESCR
 FUNCTION_LIST Zuendung /end CHARACTERISTIC
/begin RECORD_LAYOUT VALUE_KF_TZ_GRUND FNC_VALUES 0 SWORD ROW_DIR DIRECT /end RECORD_LAYOUT
/begin AXIS_PTS KF_TZ_GRUND_n_AXIS "-" 0x150E n KF_TZ_GRUND_n_AXIS 100.000000 F00007 18 0.000000 10000.000000 /end AXIS_PTS
/begin RECORD_LAYOUT KF_TZ_GRUND_n_AXIS FIX_NO_AXIS_PTS_X 18 AXIS_PTS_X 0 UWORD INDEX_INCR DIRECT /end RECORD_LAYOUT
/begin AXIS_PTS KF_TZ_GRUND_rf_AXIS "-" 0x1532 rf KF_TZ_GRUND_rf_AXIS 100.000000 F00068 12 0.000000 2.000000 /end AXIS_PTS
/begin RECORD_LAYOUT KF_TZ_GRUND_rf_AXIS FIX_NO_AXIS_PTS_Y 12 AXIS_PTS_Y 0 UWORD INDEX_INCR DIRECT /end RECORD_LAYOUT
/begin CHARACTERISTIC KF_TZ_VL "-" MAP 0x1726 VALUE_KF_TZ_VL 100.000000 F00045 -50.000000 60.000000
 /begin AXIS_DESCR COM_AXIS n F00007 18 0.000000 10000.000000 AXIS_PTS_REF KF_TZ_VL_n_AXIS /end AXIS_DESCR
 /begin AXIS_DESCR COM_AXIS rf F00068 3 0.000000 2.000000 AXIS_PTS_REF KF_TZ_VL_rf_AXIS /end AXIS_DESCR
 FUNCTION_LIST Zuendung /end CHARACTERISTIC
/begin RECORD_LAYOUT VALUE_KF_TZ_VL FNC_VALUES 0 SWORD ROW_DIR DIRECT /end RECORD_LAYOUT
/begin AXIS_PTS KF_TZ_VL_n_AXIS "-" 0x16FC n KF_TZ_VL_n_AXIS 100.000000 F00007 18 0.000000 10000.000000 /end AXIS_PTS
/begin RECORD_LAYOUT KF_TZ_VL_n_AXIS FIX_NO_AXIS_PTS_X 18 AXIS_PTS_X 0 UWORD INDEX_INCR DIRECT /end RECORD_LAYOUT
/begin AXIS_PTS KF_TZ_VL_rf_AXIS "-" 0x1720 rf KF_TZ_VL_rf_AXIS 100.000000 F00068 3 0.000000 2.000000 /end AXIS_PTS
/begin RECORD_LAYOUT KF_TZ_VL_rf_AXIS FIX_NO_AXIS_PTS_Y 3 AXIS_PTS_Y 0 UWORD INDEX_INCR DIRECT /end RECORD_LAYOUT
/begin CHARACTERISTIC KF_TZ_SZ "-" MAP 0x17F2 VALUE_KF_TZ_SZ 100.000000 F00269 0.000000 30.000000
 /begin AXIS_DESCR COM_AXIS n F00007 5 0.000000 10000.000000 AXIS_PTS_REF KF_TZ_SZ_n_AXIS /end AXIS_DESCR
 /begin AXIS_DESCR COM_AXIS ub F00018 7 0.000000 20.000000 AXIS_PTS_REF KF_TZ_SZ_ub_AXIS /end AXIS_DESCR
 FUNCTION_LIST Zuendung /end CHARACTERISTIC
/begin RECORD_LAYOUT VALUE_KF_TZ_SZ FNC_VALUES 0 UWORD ROW_DIR DIRECT /end RECORD_LAYOUT
/begin AXIS_PTS KF_TZ_SZ_n_AXIS "-" 0x17DA n KF_TZ_SZ_n_AXIS 100.000000 F00007 5 0.000000 10000.000000 /end AXIS_PTS
/begin RECORD_LAYOUT KF_TZ_SZ_n_AXIS FIX_NO_AXIS_PTS_X 5 AXIS_PTS_X 0 UWORD INDEX_INCR DIRECT /end RECORD_LAYOUT
/begin AXIS_PTS KF_TZ_SZ_ub_AXIS "-" 0x17E4 ub KF_TZ_SZ_ub_AXIS 100.000000 F00018 7 0.000000 20.000000 /end AXIS_PTS
/begin RECORD_LAYOUT KF_TZ_SZ_ub_AXIS FIX_NO_AXIS_PTS_Y 7 AXIS_PTS_Y 0 UWORD INDEX_INCR DIRECT /end RECORD_LAYOUT
/begin CHARACTERISTIC KF_TZ_SZ_IONSTR "-" MAP 0x1852 VALUE_KF_TZ_SZ_IONSTR 100.000000 F00269 0.000000 30.000000
 /begin AXIS_DESCR COM_AXIS n F00007 5 0.000000 10000.000000 AXIS_PTS_REF KF_TZ_SZ_IONSTR_n_AXIS /end AXIS_DESCR
 /begin AXIS_DESCR COM_AXIS ub F00018 7 0.000000 20.000000 AXIS_PTS_REF KF_TZ_SZ_IONSTR_ub_AXIS /end AXIS_DESCR
 FUNCTION_LIST Zuendung /end CHARACTERISTIC
/begin RECORD_LAYOUT VALUE_KF_TZ_SZ_IONSTR FNC_VALUES 0 UWORD ROW_DIR DIRECT /end RECORD_LAYOUT
/begin AXIS_PTS KF_TZ_SZ_IONSTR_n_AXIS "-" 0x183A n KF_TZ_SZ_IONSTR_n_AXIS 100.000000 F00007 5 0.000000 10000.000000 /end AXIS_PTS
/begin RECORD_LAYOUT KF_TZ_SZ_IONSTR_n_AXIS FIX_NO_AXIS_PTS_X 5 AXIS_PTS_X 0 UWORD INDEX_INCR DIRECT /end RECORD_LAYOUT
/begin AXIS_PTS KF_TZ_SZ_IONSTR_ub_AXIS "-" 0x1844 ub KF_TZ_SZ_IONSTR_ub_AXIS 100.000000 F00018 7 0.000000 20.000000 /end AXIS_PTS
/begin RECORD_LAYOUT KF_TZ_SZ_IONSTR_ub_AXIS FIX_NO_AXIS_PTS_Y 7 AXIS_PTS_Y 0 UWORD INDEX_INCR DIRECT /end RECORD_LAYOUT
/begin CHARACTERISTIC KF_TZ_MIN "-" MAP 0x18B8 VALUE_KF_TZ_MIN 100.000000 F00045 -50.000000 60.000000
 /begin AXIS_DESCR COM_AXIS n F00007 8 0.000000 10000.000000 AXIS_PTS_REF KF_TZ_MIN_n_AXIS /end AXIS_DESCR
 /begin AXIS_DESCR COM_AXIS rf F00068 6 0.000000 2.000000 AXIS_PTS_REF KF_TZ_MIN_rf_AXIS /end AXIS_DESCR
 FUNCTION_LIST Zuendung /end CHARACTERISTIC
/begin RECORD_LAYOUT VALUE_KF_TZ_MIN FNC_VALUES 0 SWORD ROW_DIR DIRECT /end RECORD_LAYOUT
/begin AXIS_PTS KF_TZ_MIN_n_AXIS "-" 0x189C n KF_TZ_MIN_n_AXIS 100.000000 F00007 8 0.000000 10000.000000 /end AXIS_PTS
/begin RECORD_LAYOUT KF_TZ_MIN_n_AXIS FIX_NO_AXIS_PTS_X 8 AXIS_PTS_X 0 UWORD INDEX_INCR DIRECT /end RECORD_LAYOUT
/begin AXIS_PTS KF_TZ_MIN_rf_AXIS "-" 0x18AC rf KF_TZ_MIN_rf_AXIS 100.000000 F00068 6 0.000000 2.000000 /end AXIS_PTS
/begin RECORD_LAYOUT KF_TZ_MIN_rf_AXIS FIX_NO_AXIS_PTS_Y 6 AXIS_PTS_Y 0 UWORD INDEX_INCR DIRECT /end RECORD_LAYOUT
/begin CHARACTERISTIC KF_TZ_KATH_FAKTOR "-" MAP 0x1950 VALUE_KF_TZ_KATH_FAKTOR 100.000000 F00100 0.000000 2.000000
 /begin AXIS_DESCR /* sectimer */ COM_AXIS sectimer F00017 6 0.000000 65535.000000 AXIS_PTS_REF KF_TZ_KATH_FAKTOR_sectimer_AXIS /end AXIS_DESCR
 /begin AXIS_DESCR COM_AXIS tmot F00014 8 -48.000000 207.000000 AXIS_PTS_REF KF_TZ_KATH_FAKTOR_tmot_AXIS /end AXIS_DESCR
 FUNCTION_LIST Zuendung /end CHARACTERISTIC
/begin RECORD_LAYOUT VALUE_KF_TZ_KATH_FAKTOR FNC_VALUES 0 UWORD ROW_DIR DIRECT /end RECORD_LAYOUT
/begin AXIS_PTS KF_TZ_KATH_FAKTOR_sectimer_AXIS "-" 0x1934 sectimer KF_TZ_KATH_FAKTOR_sectimer_AXIS 100.000000 F00017 6 0.000000 65535.000000 /end AXIS_PTS
/begin RECORD_LAYOUT KF_TZ_KATH_FAKTOR_sectimer_AXIS FIX_NO_AXIS_PTS_X 6 AXIS_PTS_X 0 UWORD INDEX_INCR DIRECT /end RECORD_LAYOUT
/begin AXIS_PTS KF_TZ_KATH_FAKTOR_tmot_AXIS "-" 0x1940 tmot KF_TZ_KATH_FAKTOR_tmot_AXIS 100.000000 F00014 8 -48.000000 207.000000 /end AXIS_PTS
/begin RECORD_LAYOUT KF_TZ_KATH_FAKTOR_tmot_AXIS FIX_NO_AXIS_PTS_Y 8 AXIS_PTS_Y 0 UWORD INDEX_INCR DIRECT /end RECORD_LAYOUT
/begin CHARACTERISTIC KF_TZ_KATH_LLFAKTOR "-" MAP 0x19C2 VALUE_KF_TZ_KATH_LLFAKTOR 100.000000 F00100 0.000000 2.000000
 /begin AXIS_DESCR /* zeit */ COM_AXIS zeit F00017 4 0.000000 65535.000000 AXIS_PTS_REF KF_TZ_KATH_LLFAKTOR_zeit_AXIS /end AXIS_DESCR
 /begin AXIS_DESCR COM_AXIS tmot F00014 4 -48.000000 207.000000 AXIS_PTS_REF KF_TZ_KATH_LLFAKTOR_tmot_AXIS /end AXIS_DESCR
 FUNCTION_LIST Zuendung /end CHARACTERISTIC
/begin RECORD_LAYOUT VALUE_KF_TZ_KATH_LLFAKTOR FNC_VALUES 0 UWORD ROW_DIR DIRECT /end RECORD_LAYOUT
/begin AXIS_PTS KF_TZ_KATH_LLFAKTOR_zeit_AXIS "-" 0x19B2 zeit KF_TZ_KATH_LLFAKTOR_zeit_AXIS 100.000000 F00017 4 0.000000 65535.000000 /end AXIS_PTS
/begin RECORD_LAYOUT KF_TZ_KATH_LLFAKTOR_zeit_AXIS FIX_NO_AXIS_PTS_X 4 AXIS_PTS_X 0 UWORD INDEX_INCR DIRECT /end RECORD_LAYOUT
/begin AXIS_PTS KF_TZ_KATH_LLFAKTOR_tmot_AXIS "-" 0x19BA tmot KF_TZ_KATH_LLFAKTOR_tmot_AXIS 100.000000 F00014 4 -48.000000 207.000000 /end AXIS_PTS
/begin RECORD_LAYOUT KF_TZ_KATH_LLFAKTOR_tmot_AXIS FIX_NO_AXIS_PTS_Y 4 AXIS_PTS_Y 0 UWORD INDEX_INCR DIRECT /end RECORD_LAYOUT
/begin CHARACTERISTIC KF_TZ_KATH_ETA "-" MAP 0x1A1E VALUE_KF_TZ_KATH_ETA 100.000000 F00177 0.000000 100.000000
 /begin AXIS_DESCR COM_AXIS n F00007 10 0.000000 10000.000000 AXIS_PTS_REF KF_TZ_KATH_ETA_n_AXIS /end AXIS_DESCR
 /begin AXIS_DESCR COM_AXIS rf F00068 10 0.000000 2.000000 AXIS_PTS_REF KF_TZ_KATH_ETA_rf_AXIS /end AXIS_DESCR
 FUNCTION_LIST Zuendung /end CHARACTERISTIC
/begin RECORD_LAYOUT VALUE_KF_TZ_KATH_ETA FNC_VALUES 0 UWORD ROW_DIR DIRECT /end RECORD_LAYOUT
/begin AXIS_PTS KF_TZ_KATH_ETA_n_AXIS "-" 0x19F6 n KF_TZ_KATH_ETA_n_AXIS 100.000000 F00007 10 0.000000 10000.000000 /end AXIS_PTS
/begin RECORD_LAYOUT KF_TZ_KATH_ETA_n_AXIS FIX_NO_AXIS_PTS_X 10 AXIS_PTS_X 0 UWORD INDEX_INCR DIRECT /end RECORD_LAYOUT
/begin AXIS_PTS KF_TZ_KATH_ETA_rf_AXIS "-" 0x1A0A rf KF_TZ_KATH_ETA_rf_AXIS 100.000000 F00068 10 0.000000 2.000000 /end AXIS_PTS
/begin RECORD_LAYOUT KF_TZ_KATH_ETA_rf_AXIS FIX_NO_AXIS_PTS_Y 10 AXIS_PTS_Y 0 UWORD INDEX_INCR DIRECT /end RECORD_LAYOUT
/begin CHARACTERISTIC KL_WDK_MAX_DIFF "-" CURVE 0x1D1A VALUE_KL_WDK_MAX_DIFF 100.000000 F00048 0.000000 100.000000
 /begin AXIS_DESCR /* wdk1_2 */ COM_AXIS wdk1_2 F00048 3 0.000000 120.000000 AXIS_PTS_REF KL_WDK_MAX_DIFF_wdk1_2_AXIS /end AXIS_DESCR
 FUNCTION_LIST Messwerte /end CHARACTERISTIC
/begin RECORD_LAYOUT VALUE_KL_WDK_MAX_DIFF FNC_VALUES 0 UWORD ROW_DIR DIRECT /end RECORD_LAYOUT
/begin AXIS_PTS KL_WDK_MAX_DIFF_wdk1_2_AXIS "-" 0x1D14 wdk1_2 KL_WDK_MAX_DIFF_wdk1_2_AXIS 100.000000 F00048 3 0.000000 120.000000 /end AXIS_PTS
/begin RECORD_LAYOUT KL_WDK_MAX_DIFF_wdk1_2_AXIS FIX_NO_AXIS_PTS_X 3 AXIS_PTS_X 0 UWORD INDEX_INCR DIRECT /end RECORD_LAYOUT
/begin CHARACTERISTIC KL_BZ_N_START_EXIT "-" CURVE 0x1408 VALUE_KL_BZ_N_START_EXIT 100.000000 F00007 0.000000 10000.000000
 /begin AXIS_DESCR COM_AXIS tmot F00014 3 -48.000000 207.000000 AXIS_PTS_REF KL_BZ_N_START_EXIT_tmot_AXIS /end AXIS_DESCR
 FUNCTION_LIST Betriebszustaende /end CHARACTERISTIC
/begin RECORD_LAYOUT VALUE_KL_BZ_N_START_EXIT FNC_VALUES 0 UWORD ROW_DIR DIRECT /end RECORD_LAYOUT
/begin AXIS_PTS KL_BZ_N_START_EXIT_tmot_AXIS "-" 0x1402 tmot KL_BZ_N_START_EXIT_tmot_AXIS 100.000000 F00014 3 -48.000000 207.000000 /end AXIS_PTS
/begin RECORD_LAYOUT KL_BZ_N_START_EXIT_tmot_AXIS FIX_NO_AXIS_PTS_X 3 AXIS_PTS_X 0 UWORD INDEX_INCR DIRECT /end RECORD_LAYOUT
/begin CHARACTERISTIC KL_BZ_N_START_ENTRY "-" CURVE 0x1416 VALUE_KL_BZ_N_START_ENTRY 100.000000 F00007 0.000000 10000.000000
 /begin AXIS_DESCR COM_AXIS tan F00014 3 -48.000000 207.000000 AXIS_PTS_REF KL_BZ_N_START_ENTRY_tan_AXIS /end AXIS_DESCR
 FUNCTION_LIST Betriebszustaende /end CHARACTERISTIC
/begin RECORD_LAYOUT VALUE_KL_BZ_N_START_ENTRY FNC_VALUES 0 UWORD ROW_DIR DIRECT /end RECORD_LAYOUT
/begin AXIS_PTS KL_BZ_N_START_ENTRY_tan_AXIS "-" 0x1410 tan KL_BZ_N_START_ENTRY_tan_AXIS 100.000000 F00014 3 -48.000000 207.000000 /end AXIS_PTS
/begin RECORD_LAYOUT KL_BZ_N_START_ENTRY_tan_AXIS FIX_NO_AXIS_PTS_X 3 AXIS_PTS_X 0 UWORD INDEX_INCR DIRECT /end RECORD_LAYOUT
/begin CHARACTERISTIC KL_BZ_WDK_LL "-" CURVE 0x1426 VALUE_KL_BZ_WDK_LL 100.000000 F00048 0.000000 100.000000
 /begin AXIS_DESCR COM_AXIS n F00007 4 0.000000 10000.000000 AXIS_PTS_REF KL_BZ_WDK_LL_n_AXIS /end AXIS_DESCR
 FUNCTION_LIST Betriebszustaende /end CHARACTERISTIC
/begin RECORD_LAYOUT VALUE_KL_BZ_WDK_LL FNC_VALUES 0 UWORD ROW_DIR DIRECT /end RECORD_LAYOUT
/begin AXIS_PTS KL_BZ_WDK_LL_n_AXIS "-" 0x141E n KL_BZ_WDK_LL_n_AXIS 100.000000 F00007 4 0.000000 10000.000000 /end AXIS_PTS
/begin RECORD_LAYOUT KL_BZ_WDK_LL_n_AXIS FIX_NO_AXIS_PTS_X 4 AXIS_PTS_X 0 UWORD INDEX_INCR DIRECT /end RECORD_LAYOUT
/begin CHARACTERISTIC KF_BZ_WDK_VL "-" MAP 0x1440 VALUE_KF_BZ_WDK_VL 100.000000 F00048 0.000000 100.000000
 /begin AXIS_DESCR COM_AXIS n F00007 4 0.000000 10000.000000 AXIS_PTS_REF KF_BZ_WDK_VL_n_AXIS /end AXIS_DESCR
 /begin AXIS_DESCR COM_AXIS tmot F00014 4 -48.000000 207.000000 AXIS_PTS_REF KF_BZ_WDK_VL_tmot_AXIS /end AXIS_DESCR
 FUNCTION_LIST Betriebszustaende /end CHARACTERISTIC
/begin RECORD_LAYOUT VALUE_KF_BZ_WDK_VL FNC_VALUES 0 UWORD ROW_DIR DIRECT /end RECORD_LAYOUT
/begin AXIS_PTS KF_BZ_WDK_VL_n_AXIS "-" 0x1430 n KF_BZ_WDK_VL_n_AXIS 100.000000 F00007 4 0.000000 10000.000000 /end AXIS_PTS
/begin RECORD_LAYOUT KF_BZ_WDK_VL_n_AXIS FIX_NO_AXIS_PTS_X 4 AXIS_PTS_X 0 UWORD INDEX_INCR DIRECT /end RECORD_LAYOUT
/begin AXIS_PTS KF_BZ_WDK_VL_tmot_AXIS "-" 0x1438 tmot KF_BZ_WDK_VL_tmot_AXIS 100.000000 F00014 4 -48.000000 207.000000 /end AXIS_PTS
/begin RECORD_LAYOUT KF_BZ_WDK_VL_tmot_AXIS FIX_NO_AXIS_PTS_Y 4 AXIS_PTS_Y 0 UWORD INDEX_INCR DIRECT /end RECORD_LAYOUT
/begin CHARACTERISTIC KL_AQ_ABS_LLS "-" CURVE 0x6FC8 VALUE_KL_AQ_ABS_LLS 100.000000 F00281 0.000000 2000.000000
 /begin AXIS_DESCR /* lls_tv */ COM_AXIS lls_tv F00159 8 0.000000 100.000000 AXIS_PTS_REF KL_AQ_ABS_LLS_lls_tv_AXIS /end AXIS_DESCR
 FUNCTION_LIST Relativer_Oeffnungsquerschnitt /end CHARACTERISTIC
/begin RECORD_LAYOUT VALUE_KL_AQ_ABS_LLS FNC_VALUES 0 UWORD ROW_DIR DIRECT /end RECORD_LAYOUT
/begin AXIS_PTS KL_AQ_ABS_LLS_lls_tv_AXIS "-" 0x6FB8 lls_tv KL_AQ_ABS_LLS_lls_tv_AXIS 100.000000 F00159 8 0.000000 100.000000 /end AXIS_PTS
/begin RECORD_LAYOUT KL_AQ_ABS_LLS_lls_tv_AXIS FIX_NO_AXIS_PTS_X 8 AXIS_PTS_X 0 UWORD INDEX_INCR DIRECT /end RECORD_LAYOUT
/begin COMPU_METHOD F00090 "-*-" FORM "%4.2" "-" FORMULA "((x-32768)/16)" /end COMPU_METHOD
/begin COMPU_METHOD F00240 "-*-" FORM "%3.0" "øC" FORMULA "((x-6144)/128)" /end COMPU_METHOD
/begin COMPU_METHOD F00132 "-*-" FORM "%2.1" "øKW" FORMULA "((x/10)-720)" /end COMPU_METHOD
/begin COMPU_METHOD F00242 "-*-" FORM "%1.3" "øC/s" FORMULA "(x*10)/65536" /end COMPU_METHOD
/begin COMPU_METHOD F00155 "-*-" FORM "%2.1" "Nm/s" FORMULA "(x*50)/(10*16)" /end COMPU_METHOD
/begin COMPU_METHOD F00089 "-*-" FORM "%2.3" "%/s" FORMULA "(x*50)/640" /end COMPU_METHOD
/begin COMPU_METHOD F00254 "-*-" FORM "%4.1" "m/(s*s)" FORMULA "(x-32768)/10" /end COMPU_METHOD
/begin COMPU_METHOD F00241 "-*-" FORM "%3.2" "øC" FORMULA "(x/128)-48" /end COMPU_METHOD
/begin COMPU_METHOD F00236 "-*-" FORM "%3.2" "øC" FORMULA "(x/4)-48" /end COMPU_METHOD
/begin COMPU_METHOD F00238 "-*-" FORM "%3.4" "1/min" FORMULA "(x/65536)*600" /end COMPU_METHOD
/begin COMPU_METHOD F00151 "-*-" FORM "%4.0" "Upm" FORMULA "-x" /end COMPU_METHOD
/begin COMPU_METHOD F00156 "-*-" FORM "%5.2" "-" FORMULA "-x+1000" /end COMPU_METHOD
/begin COMPU_METHOD F00125 "-*-" FORM "%2.2" "kHz" FORMULA "1.165e0*exp(x*4.426e-2)" /end COMPU_METHOD
/begin COMPU_METHOD F00196 "-*-" FORM "%1.2" "s" FORMULA "2.56/x" /end COMPU_METHOD
/begin COMPU_METHOD F00106 "-*-" FORM "%3.2" "s" FORMULA "255/x" /end COMPU_METHOD
/begin COMPU_METHOD F00126 "-*-" FORM "%3.0" "us" FORMULA "4.128e1*exp(x*1.74e-1)" /end COMPU_METHOD
/begin COMPU_METHOD F00134 "-*-" FORM "%4.0" "-" FORMULA "5*x" /end COMPU_METHOD
/begin COMPU_METHOD F00147 "-*-" FORM "%1.2" "-" FORMULA "5.12/x" /end COMPU_METHOD
/begin COMPU_METHOD F00024 "-*-" FORM "%1.2" "s" FORMULA "5.12/x" /end COMPU_METHOD
/begin COMPU_METHOD F00108 "-*-" FORM "%2.2" "s" FORMULA "50/x" /end COMPU_METHOD
/begin COMPU_METHOD F00013 "-*-" FORM "%5.0" "-" FORMULA "x" /end COMPU_METHOD
/begin COMPU_METHOD F00220 "-*-" FORM "%3.0" "kg/h" FORMULA "x" /end COMPU_METHOD
/begin COMPU_METHOD F00004 "-*-" FORM "%3.0" "km/h" FORMULA "x" /end COMPU_METHOD
/begin COMPU_METHOD F00205 "-*-" FORM "%4.0" "m" FORMULA "x" /end COMPU_METHOD
/begin COMPU_METHOD F00223 "-*-" FORM "%3.0" "min" FORMULA "x" /end COMPU_METHOD
/begin COMPU_METHOD F00000 "-*-" FORM "%4.0" "mm" FORMULA "x" /end COMPU_METHOD
/begin COMPU_METHOD F00248 "-*-" FORM "%4.0" "msec" FORMULA "x" /end COMPU_METHOD
/begin COMPU_METHOD F00281 "-*-" FORM "%5.0" "qmm" FORMULA "x" /end COMPU_METHOD
/begin COMPU_METHOD F00017 "-*-" FORM "%3.0" "s" FORMULA "x" /end COMPU_METHOD
/begin COMPU_METHOD F00007 "-*-" FORM "%4.0" "Upm" FORMULA "x" /end COMPU_METHOD
/begin COMPU_METHOD F00142 "-*-" FORM "%4.0" "Upm/s" FORMULA "x" /end COMPU_METHOD
/begin COMPU_METHOD F00015 "-*-" FORM "%3.0" "øC" FORMULA "x" /end COMPU_METHOD
/begin COMPU_METHOD F00031 "-*-" FORM "%3.2" "-" FORMULA "X" /end COMPU_METHOD
/begin COMPU_METHOD F00257 "-*-" FORM "%5.2" "mm" FORMULA "X" /end COMPU_METHOD
/begin COMPU_METHOD F00001 "-*-" FORM "%1.1" "Grad" FORMULA "x*0.04375" /end COMPU_METHOD
/begin COMPU_METHOD F00046 "-*-" FORM "%3.1" "%" FORMULA "x*0.4" /end COMPU_METHOD
/begin COMPU_METHOD F00212 "-*-" FORM "%3.0" "mA" FORMULA "X*0.89" /end COMPU_METHOD
/begin COMPU_METHOD F00189 "-*-" FORM "%6.0" "-/s" FORMULA "x*10" /end COMPU_METHOD
/begin COMPU_METHOD F00181 "-*-" FORM "%4.0" "Nm/s" FORMULA "x*10" /end COMPU_METHOD
/begin COMPU_METHOD F00019 "-*-" FORM "%5.1" "ms" FORMULA "x*100" /end COMPU_METHOD
/begin COMPU_METHOD F00191 "-*-" FORM "%4.1" "%" FORMULA "x*100/1024" /end COMPU_METHOD
/begin COMPU_METHOD F00188 "-*-" FORM "%2.2" "1/s" FORMULA "x*100/65536" /end COMPU_METHOD
/begin COMPU_METHOD F00120 "-*-" FORM "%5.0" "ms" FORMULA "x*1000/1024" /end COMPU_METHOD
/begin COMPU_METHOD F00249 "-*-" FORM "%3.2" "msec" FORMULA "x*128/10000" /end COMPU_METHOD
/begin COMPU_METHOD F00104 "-*-" FORM "%4.0" "mbar" FORMULA "x*3+500" /end COMPU_METHOD
/begin COMPU_METHOD F00115 "-*-" FORM "%2.1" "ø" FORMULA "x*3/10" /end COMPU_METHOD
/begin COMPU_METHOD F00221 "-*-" FORM "%4.0" "kg/h" FORMULA "x*4" /end COMPU_METHOD
/begin COMPU_METHOD F00109 "-*-" FORM "%4.0" "Upm" FORMULA "x*40" /end COMPU_METHOD
/begin COMPU_METHOD F00040 "-*-" FORM "%4.0" "%/s" FORMULA "x*5" /end COMPU_METHOD
/begin COMPU_METHOD F00170 "-*-" FORM "%4.0" "Nm/s" FORMULA "x*5" /end COMPU_METHOD
/begin COMPU_METHOD F00107 "-*-" FORM "%4.0" "kg/h" FORMULA "x*8" /end COMPU_METHOD
/begin COMPU_METHOD F00152 "-*-" FORM "%5.2" "-" FORMULA "x-32768" /end COMPU_METHOD
/begin COMPU_METHOD F00150 "-*-" FORM "%4.0" "Upm" FORMULA "x-32768" /end COMPU_METHOD
/begin COMPU_METHOD F00014 "-*-" FORM "%3.0" "øC" FORMULA "x-48" /end COMPU_METHOD
/begin COMPU_METHOD F00154 "-*-" FORM "%3.2" "-" FORMULA "X-48" /end COMPU_METHOD
/begin COMPU_METHOD F00255 "-*-" FORM "%5.0" "m" FORMULA "x-500" /end COMPU_METHOD
/begin COMPU_METHOD F00149 "-*-" FORM "%2.3" "Nm" FORMULA "x/(10*16)" /end COMPU_METHOD
/begin COMPU_METHOD F00071 "-*-" FORM "%3.2" "%" FORMULA "x/(10*64)" /end COMPU_METHOD
/begin COMPU_METHOD F00148 "-*-" FORM "%2.3" "Nm" FORMULA "x/(10*8)" /end COMPU_METHOD
/begin COMPU_METHOD F00256 "-*-" FORM "%2.4" "øC/100ms" FORMULA "x/(256*16)" /end COMPU_METHOD
/begin COMPU_METHOD F00070 "-*-" FORM "%1.4" "-" FORMULA "x/(32768*16)" /end COMPU_METHOD
/begin COMPU_METHOD F00048 "-*-" FORM "%3.2" "%" FORMULA "x/10" /end COMPU_METHOD
/begin COMPU_METHOD F00042 "-*-" FORM "%2.1" "%/20ms" FORMULA "x/10" /end COMPU_METHOD
/begin COMPU_METHOD F00002 "-*-" FORM "%4.1" "m" FORMULA "x/10" /end COMPU_METHOD
/begin COMPU_METHOD F00193 "-*-" FORM "%2.1" "m/(s*s)" FORMULA "x/10" /end COMPU_METHOD
/begin COMPU_METHOD F00145 "-*-" FORM "%2.1" "Nm" FORMULA "x/10" /end COMPU_METHOD
/begin COMPU_METHOD F00190 "-*-" FORM "%3.1" "Nm-%" FORMULA "x/10" /end COMPU_METHOD
/begin COMPU_METHOD F00168 "-*-" FORM "%4.1" "Nm/10ms" FORMULA "x/10" /end COMPU_METHOD
/begin COMPU_METHOD F00194 "-*-" FORM "%1.1" "Nm/20ms" FORMULA "x/10" /end COMPU_METHOD
/begin COMPU_METHOD F00187 "-*-" FORM "%2.2" "Nm/Upm" FORMULA "x/10" /end COMPU_METHOD
/begin COMPU_METHOD F00028 "-*-" FORM "%2.1" "s" FORMULA "x/10" /end COMPU_METHOD
/begin COMPU_METHOD F00018 "-*-" FORM "%2.1" "V" FORMULA "x/10" /end COMPU_METHOD
/begin COMPU_METHOD F00045 "-*-" FORM "%2.1" "ø" FORMULA "x/10" /end COMPU_METHOD
/begin COMPU_METHOD F00006 "-*-" FORM "%2.1" "øKW" FORMULA "x/10" /end COMPU_METHOD
/begin COMPU_METHOD F00068 "-*-" FORM "%1.3" "-" FORMULA "x/1000" /end COMPU_METHOD
/begin COMPU_METHOD F00269 "-*-" FORM "%2.2" "ms" FORMULA "x/1000" /end COMPU_METHOD
/begin COMPU_METHOD F00044 "-*-" FORM "%1.3" "ms/Segm" FORMULA "x/1000" /end COMPU_METHOD
/begin COMPU_METHOD F00060 "-*-" FORM "%1.4" "-" FORMULA "x/10000" /end COMPU_METHOD
/begin COMPU_METHOD F00103 "-*-" FORM "%3.2" "V" FORMULA "X/1023*5" /end COMPU_METHOD
/begin COMPU_METHOD F00085 "-*-" FORM "%1.3" "-" FORMULA "x/1024" /end COMPU_METHOD
/begin COMPU_METHOD F00056 "-*-" FORM "%1.2" "-" FORMULA "x/128" /end COMPU_METHOD
/begin COMPU_METHOD F00079 "-*-" FORM "%4.0" "km/h" FORMULA "x/16" /end COMPU_METHOD
/begin COMPU_METHOD F00235 "-*-" FORM "%4.0" "øC" FORMULA "x/16" /end COMPU_METHOD
/begin COMPU_METHOD F00225 "-*-" FORM "%1.2" "km/h" FORMULA "X/16" /end COMPU_METHOD
/begin COMPU_METHOD F00268 "-*-" FORM "%2.2" "Grad/10m" FORMULA "x/160" /end COMPU_METHOD
/begin COMPU_METHOD F00139 "-*-" FORM "%2.3" "Nm" FORMULA "X/160" /end COMPU_METHOD
/begin COMPU_METHOD F00097 "-*-" FORM "%1.4" "-" FORMULA "x/16384" /end COMPU_METHOD
/begin COMPU_METHOD F00157 "-*-" FORM "%3.1" "kg/h" FORMULA "x/2" /end COMPU_METHOD
/begin COMPU_METHOD F00055 "-*-" FORM "%2.1" "%tv" FORMULA "x/20" /end COMPU_METHOD
/begin COMPU_METHOD F00116 "-*-" FORM "%1.3" "-" FORMULA "x/200" /end COMPU_METHOD
/begin COMPU_METHOD F00186 "-*-" FORM "%1.2" "Nm/Upm*s" FORMULA "x/25.6" /end COMPU_METHOD
/begin COMPU_METHOD F00099 "-*-" FORM "%1.2" "-" FORMULA "x/256" /end COMPU_METHOD
/begin COMPU_METHOD F00158 "-*-" FORM "%3.2" "kg/h" FORMULA "x/256" /end COMPU_METHOD
/begin COMPU_METHOD F00153 "-*-" FORM "%2.2" "-" FORMULA "X/256" /end COMPU_METHOD
/begin COMPU_METHOD F00169 "-*-" FORM "%3.2" "Nms2" FORMULA "x/268" /end COMPU_METHOD
/begin COMPU_METHOD F00131 "-*-" FORM "%1.2" "-" FORMULA "x/32" /end COMPU_METHOD
/begin COMPU_METHOD F00185 "-*-" FORM "%2.2" "Nm/s" FORMULA "x/32" /end COMPU_METHOD
/begin COMPU_METHOD F00184 "-*-" FORM "%2.1" "Nm" FORMULA "x/320" /end COMPU_METHOD
/begin COMPU_METHOD F00100 "-*-" FORM "%1.2" "-" FORMULA "x/32768" /end COMPU_METHOD
/begin COMPU_METHOD F00095 "-*-" FORM "%2.1" "kg/h" FORMULA "x/4" /end COMPU_METHOD
/begin COMPU_METHOD F00258 "-*-" FORM "%2.2" "°C" FORMULA "x/4" /end COMPU_METHOD
/begin COMPU_METHOD F00146 "-*-" FORM "%2.1" "kg/h" FORMULA "x/40" /end COMPU_METHOD
/begin COMPU_METHOD F00117 "-*-" FORM "%2.1" "ø" FORMULA "x/5" /end COMPU_METHOD
/begin COMPU_METHOD F00159 "-*-" FORM "%2.1" "%" FORMULA "x/50" /end COMPU_METHOD
/begin COMPU_METHOD F00003 "-*-" FORM "%1.2" "-" FORMULA "x/64" /end COMPU_METHOD
/begin COMPU_METHOD F00177 "-*-" FORM "%2.1" "%" FORMULA "x/65535*100" /end COMPU_METHOD
/begin COMPU_METHOD F00051 "-*-" FORM "%2.1" "%tv" FORMULA "x/80" /end COMPU_METHOD
/begin FUNCTION ANTIRUCKELFUNKTION "ANTIRUCKELFUNKTION" /end FUNCTION
/begin FUNCTION AQUER "AQUER" /end FUNCTION
/begin FUNCTION Aussetzerkennung "Aussetzerkennung" /end FUNCTION
/begin FUNCTION BA "BA" /end FUNCTION
/begin FUNCTION Betriebszustaende "Betriebszustaende" /end FUNCTION
/begin FUNCTION CAN_Schnittstelle "CAN_Schnittstelle" /end FUNCTION
/begin FUNCTION CAN_Schnittstelle-Slave "CAN_Schnittstelle-Slave" /end FUNCTION
/begin FUNCTION D/A_Konfiguration "D/A_Konfiguration" /end FUNCTION
/begin FUNCTION DKBA "DKBA" /end FUNCTION
/begin FUNCTION Drehzahlwarnfeld "Drehzahlwarnfeld" /end FUNCTION
/begin FUNCTION Druckspeicherventil "Druckspeicherventil" /end FUNCTION
/begin FUNCTION Dynamik "Dynamik" /end FUNCTION
/begin FUNCTION EDK "EDK" /end FUNCTION
/begin FUNCTION EDK_Soll_Ist "EDK_Soll_Ist" /end FUNCTION
/begin FUNCTION EGAS "EGAS" /end FUNCTION
/begin FUNCTION Eigendiagnose "Eigendiagnose" /end FUNCTION
/begin FUNCTION Einspritzung "Einspritzung" /end FUNCTION
/begin FUNCTION Elektroluefter "Elektroluefter" /end FUNCTION
/begin FUNCTION Fehlerfilter "Fehlerfilter" /end FUNCTION
/begin FUNCTION FGR "FGR" /end FUNCTION
/begin FUNCTION FUELLUNGSREGLER "FUELLUNGSREGLER" /end FUNCTION
/begin FUNCTION Fz_Geschwindigkeit "Fz_Geschwindigkeit" /end FUNCTION
/begin FUNCTION Gangerkennung "Gangerkennung" /end FUNCTION
/begin FUNCTION Katheiz_Funktion "Katheiz_Funktion" /end FUNCTION
/begin FUNCTION Katschutz "Katschutz" /end FUNCTION
/begin FUNCTION Klimaanlage "Klimaanlage" /end FUNCTION
/begin FUNCTION Klopfen "Klopfen" /end FUNCTION
/begin FUNCTION Kontrolle "Kontrolle" /end FUNCTION
/begin FUNCTION Kraftstoffpumpe "Kraftstoffpumpe" /end FUNCTION
/begin FUNCTION Lambda "Lambda" /end FUNCTION
/begin FUNCTION Lambda-OBD "Lambda-OBD" /end FUNCTION
/begin FUNCTION Lambdadiagnose "Lambdadiagnose" /end FUNCTION
/begin FUNCTION Lamdasondenheizung "Lamdasondenheizung" /end FUNCTION
/begin FUNCTION Lasterfassung "Lasterfassung" /end FUNCTION
/begin FUNCTION Laufunruhe "Laufunruhe" /end FUNCTION
/begin FUNCTION Leerlaufregelung "Leerlaufregelung" /end FUNCTION
/begin FUNCTION LEERLAUFREGLER "LEERLAUFREGLER" /end FUNCTION
/begin FUNCTION Leerlaufsteller "Leerlaufsteller" /end FUNCTION
/begin FUNCTION LeerLaufSYNChornisation "LeerLaufSYNChornisation" /end FUNCTION
/begin FUNCTION Messwerte "Messwerte" /end FUNCTION
/begin FUNCTION Momentenmanager "Momentenmanager" /end FUNCTION
/begin FUNCTION NO_FUNCTION "NO_FUNCTION" /end FUNCTION
/begin FUNCTION OEK "OEK" /end FUNCTION
/begin FUNCTION Oelniveaugeber "Oelniveaugeber" /end FUNCTION
/begin FUNCTION PDR "PDR" /end FUNCTION
/begin FUNCTION Relativer_Oeffnungsquerschnitt "Relativer_Oeffnungsquerschnitt" /end FUNCTION
/begin FUNCTION Saugstrahlpumpe "Saugstrahlpumpe" /end FUNCTION
/begin FUNCTION SA_WE "SA_WE" /end FUNCTION
/begin FUNCTION Schlechtweg-Erkennung "Schlechtweg-Erkennung" /end FUNCTION
/begin FUNCTION Sekundaerluftsystem "Sekundaerluftsystem" /end FUNCTION
/begin FUNCTION Servotronic "Servotronic" /end FUNCTION
/begin FUNCTION Sicherheitskonzept "Sicherheitskonzept" /end FUNCTION
/begin FUNCTION SK-Momentenmanager "SK-Momentenmanager" /end FUNCTION
/begin FUNCTION SK_FGR "SK_FGR" /end FUNCTION
/begin FUNCTION smg "smg" /end FUNCTION
/begin FUNCTION Startrelais "Startrelais" /end FUNCTION
/begin FUNCTION System_Kontrolle "System_Kontrolle" /end FUNCTION
/begin FUNCTION Tankentlueftung "Tankentlueftung" /end FUNCTION
/begin FUNCTION Tankleckdiagnose "Tankleckdiagnose" /end FUNCTION
/begin FUNCTION TPU_Synchronisation "TPU_Synchronisation" /end FUNCTION
/begin FUNCTION Vanos "Vanos" /end FUNCTION
/begin FUNCTION Versionskontrolle "Versionskontrolle" /end FUNCTION
/begin FUNCTION Zuendung "Zuendung" /end FUNCTION
/end MODULE
/* === End of file === */
