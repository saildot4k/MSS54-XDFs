/begin MODULE 52_V508.A2L "52_V508.A2L"
/begin MOD_COMMON "BMSCOMMON" /* Definition der Standard-Byteorder */ BYTE_ORDER LITTLE_ENDIAN /* Motorola byte order */ /end MOD_COMMON
/begin CHARACTERISTIC KL_TI_KATS_VL_N "-" CURVE 0x43F8 VALUE_KL_TI_KATS_VL_N 100.000000 F00416 0.000000 255.000000
 /begin AXIS_DESCR COM_AXIS n F00007 4 0.000000 10000.000000 AXIS_PTS_REF KL_TI_KATS_VL_N_n_AXIS /end AXIS_DESCR
 FUNCTION_LIST Einspritzung /end CHARACTERISTIC
/begin RECORD_LAYOUT VALUE_KL_TI_KATS_VL_N FNC_VALUES 0 UWORD ROW_DIR DIRECT /end RECORD_LAYOUT
/begin AXIS_PTS KL_TI_KATS_VL_N_n_AXIS "-" 0x43F0 n KL_TI_KATS_VL_N_n_AXIS 100.000000 F00007 4 0.000000 10000.000000 /end AXIS_PTS
/begin RECORD_LAYOUT KL_TI_KATS_VL_N_n_AXIS FIX_NO_AXIS_PTS_X 4 AXIS_PTS_X 0 UWORD INDEX_INCR DIRECT /end RECORD_LAYOUT
/begin CHARACTERISTIC KF_TI_KATS_N_RF "-" MAP 0x441A VALUE_KF_TI_KATS_N_RF 100.000000 F00416 0.000000 255.000000
 /begin AXIS_DESCR COM_AXIS n F00007 6 0.000000 10000.000000 AXIS_PTS_REF KF_TI_KATS_N_RF_n_AXIS /end AXIS_DESCR
 /begin AXIS_DESCR COM_AXIS rf F00068 6 0.000000 2.000000 AXIS_PTS_REF KF_TI_KATS_N_RF_rf_AXIS /end AXIS_DESCR
 FUNCTION_LIST Einspritzung /end CHARACTERISTIC
/begin RECORD_LAYOUT VALUE_KF_TI_KATS_N_RF FNC_VALUES 0 UBYTE ROW_DIR DIRECT /end RECORD_LAYOUT
/begin AXIS_PTS KF_TI_KATS_N_RF_n_AXIS "-" 0x4402 n KF_TI_KATS_N_RF_n_AXIS 100.000000 F00007 6 0.000000 10000.000000 /end AXIS_PTS
/begin RECORD_LAYOUT KF_TI_KATS_N_RF_n_AXIS FIX_NO_AXIS_PTS_X 6 AXIS_PTS_X 0 UWORD INDEX_INCR DIRECT /end RECORD_LAYOUT
/begin AXIS_PTS KF_TI_KATS_N_RF_rf_AXIS "-" 0x440E rf KF_TI_KATS_N_RF_rf_AXIS 100.000000 F00068 6 0.000000 2.000000 /end AXIS_PTS
/begin RECORD_LAYOUT KF_TI_KATS_N_RF_rf_AXIS FIX_NO_AXIS_PTS_Y 6 AXIS_PTS_Y 0 UWORD INDEX_INCR DIRECT /end RECORD_LAYOUT
/begin CHARACTERISTIC KF_TI_N_RF_SLP_F "-" MAP 0x4460 VALUE_KF_TI_N_RF_SLP_F 100.000000 F00056 -1.000000 0.000000
 /begin AXIS_DESCR COM_AXIS n F00007 8 0.000000 10000.000000 AXIS_PTS_REF KF_TI_N_RF_SLP_F_n_AXIS /end AXIS_DESCR
 /begin AXIS_DESCR COM_AXIS rf F00068 8 0.000000 2.000000 AXIS_PTS_REF KF_TI_N_RF_SLP_F_rf_AXIS /end AXIS_DESCR
 FUNCTION_LIST Einspritzung /end CHARACTERISTIC
/begin RECORD_LAYOUT VALUE_KF_TI_N_RF_SLP_F FNC_VALUES 0 SBYTE ROW_DIR DIRECT /end RECORD_LAYOUT
/begin AXIS_PTS KF_TI_N_RF_SLP_F_n_AXIS "-" 0x4440 n KF_TI_N_RF_SLP_F_n_AXIS 100.000000 F00007 8 0.000000 10000.000000 /end AXIS_PTS
/begin RECORD_LAYOUT KF_TI_N_RF_SLP_F_n_AXIS FIX_NO_AXIS_PTS_X 8 AXIS_PTS_X 0 UWORD INDEX_INCR DIRECT /end RECORD_LAYOUT
/begin AXIS_PTS KF_TI_N_RF_SLP_F_rf_AXIS "-" 0x4450 rf KF_TI_N_RF_SLP_F_rf_AXIS 100.000000 F00068 8 0.000000 2.000000 /end AXIS_PTS
/begin RECORD_LAYOUT KF_TI_N_RF_SLP_F_rf_AXIS FIX_NO_AXIS_PTS_Y 8 AXIS_PTS_Y 0 UWORD INDEX_INCR DIRECT /end RECORD_LAYOUT
/begin CHARACTERISTIC KF_TI_N_RF_KAT_F "-" MAP 0x44C2 VALUE_KF_TI_N_RF_KAT_F 100.000000 F00056 -1.000000 0.000000
 /begin AXIS_DESCR COM_AXIS n F00007 8 0.000000 10000.000000 AXIS_PTS_REF KF_TI_N_RF_KAT_F_n_AXIS /end AXIS_DESCR
 /begin AXIS_DESCR COM_AXIS rf F00068 8 0.000000 2.000000 AXIS_PTS_REF KF_TI_N_RF_KAT_F_rf_AXIS /end AXIS_DESCR
 FUNCTION_LIST Einspritzung /end CHARACTERISTIC
/begin RECORD_LAYOUT VALUE_KF_TI_N_RF_KAT_F FNC_VALUES 0 SBYTE ROW_DIR DIRECT /end RECORD_LAYOUT
/begin AXIS_PTS KF_TI_N_RF_KAT_F_n_AXIS "-" 0x44A2 n KF_TI_N_RF_KAT_F_n_AXIS 100.000000 F00007 8 0.000000 10000.000000 /end AXIS_PTS
/begin RECORD_LAYOUT KF_TI_N_RF_KAT_F_n_AXIS FIX_NO_AXIS_PTS_X 8 AXIS_PTS_X 0 UWORD INDEX_INCR DIRECT /end RECORD_LAYOUT
/begin AXIS_PTS KF_TI_N_RF_KAT_F_rf_AXIS "-" 0x44B2 rf KF_TI_N_RF_KAT_F_rf_AXIS 100.000000 F00068 8 0.000000 2.000000 /end AXIS_PTS
/begin RECORD_LAYOUT KF_TI_N_RF_KAT_F_rf_AXIS FIX_NO_AXIS_PTS_Y 8 AXIS_PTS_Y 0 UWORD INDEX_INCR DIRECT /end RECORD_LAYOUT
/begin CHARACTERISTIC KF_TI_N_RF_WL "-" MAP 0x4524 VALUE_KF_TI_N_RF_WL 100.000000 F00056 -1.000000 0.000000
 /begin AXIS_DESCR COM_AXIS n F00007 8 0.000000 10000.000000 AXIS_PTS_REF KF_TI_N_RF_WL_n_AXIS /end AXIS_DESCR
 /begin AXIS_DESCR COM_AXIS rf F00068 8 0.000000 2.000000 AXIS_PTS_REF KF_TI_N_RF_WL_rf_AXIS /end AXIS_DESCR
 FUNCTION_LIST Einspritzung /end CHARACTERISTIC
/begin RECORD_LAYOUT VALUE_KF_TI_N_RF_WL FNC_VALUES 0 SBYTE ROW_DIR DIRECT /end RECORD_LAYOUT
/begin AXIS_PTS KF_TI_N_RF_WL_n_AXIS "-" 0x4504 n KF_TI_N_RF_WL_n_AXIS 100.000000 F00007 8 0.000000 10000.000000 /end AXIS_PTS
/begin RECORD_LAYOUT KF_TI_N_RF_WL_n_AXIS FIX_NO_AXIS_PTS_X 8 AXIS_PTS_X 0 UWORD INDEX_INCR DIRECT /end RECORD_LAYOUT
/begin AXIS_PTS KF_TI_N_RF_WL_rf_AXIS "-" 0x4514 rf KF_TI_N_RF_WL_rf_AXIS 100.000000 F00068 8 0.000000 2.000000 /end AXIS_PTS
/begin RECORD_LAYOUT KF_TI_N_RF_WL_rf_AXIS FIX_NO_AXIS_PTS_Y 8 AXIS_PTS_Y 0 UWORD INDEX_INCR DIRECT /end RECORD_LAYOUT
/begin CHARACTERISTIC KF_TI_TMOT_TML_SLP_F "-" MAP 0x4586 VALUE_KF_TI_TMOT_TML_SLP_F 100.000000 F00085 -1.000000 4.000000
 /begin AXIS_DESCR COM_AXIS tmot F00014 8 -48.000000 207.000000 AXIS_PTS_REF KF_TI_TMOT_TML_SLP_F_tmot_AXIS /end AXIS_DESCR
 /begin AXIS_DESCR COM_AXIS t_ml F00250 8 0.000000 3600.000000 AXIS_PTS_REF KF_TI_TMOT_TML_SLP_F_t_ml_AXIS /end AXIS_DESCR
 FUNCTION_LIST Einspritzung /end CHARACTERISTIC
/begin RECORD_LAYOUT VALUE_KF_TI_TMOT_TML_SLP_F FNC_VALUES 0 SWORD ROW_DIR DIRECT /end RECORD_LAYOUT
/begin AXIS_PTS KF_TI_TMOT_TML_SLP_F_tmot_AXIS "-" 0x4566 tmot KF_TI_TMOT_TML_SLP_F_tmot_AXIS 100.000000 F00014 8 -48.000000 207.000000 /end AXIS_PTS
/begin RECORD_LAYOUT KF_TI_TMOT_TML_SLP_F_tmot_AXIS FIX_NO_AXIS_PTS_X 8 AXIS_PTS_X 0 UWORD INDEX_INCR DIRECT /end RECORD_LAYOUT
/begin AXIS_PTS KF_TI_TMOT_TML_SLP_F_t_ml_AXIS "-" 0x4576 t_ml KF_TI_TMOT_TML_SLP_F_t_ml_AXIS 100.000000 F00250 8 0.000000 3600.000000 /end AXIS_PTS
/begin RECORD_LAYOUT KF_TI_TMOT_TML_SLP_F_t_ml_AXIS FIX_NO_AXIS_PTS_Y 8 AXIS_PTS_Y 0 UWORD INDEX_INCR DIRECT /end RECORD_LAYOUT
/begin CHARACTERISTIC KF_TI_TMOT_TML_KAT_F "-" MAP 0x4628 VALUE_KF_TI_TMOT_TML_KAT_F 100.000000 F00085 -1.000000 4.000000
 /begin AXIS_DESCR COM_AXIS tmot F00014 8 -48.000000 207.000000 AXIS_PTS_REF KF_TI_TMOT_TML_KAT_F_tmot_AXIS /end AXIS_DESCR
 /begin AXIS_DESCR COM_AXIS t_ml F00250 8 0.000000 3600.000000 AXIS_PTS_REF KF_TI_TMOT_TML_KAT_F_t_ml_AXIS /end AXIS_DESCR
 FUNCTION_LIST Einspritzung /end CHARACTERISTIC
/begin RECORD_LAYOUT VALUE_KF_TI_TMOT_TML_KAT_F FNC_VALUES 0 SWORD ROW_DIR DIRECT /end RECORD_LAYOUT
/begin AXIS_PTS KF_TI_TMOT_TML_KAT_F_tmot_AXIS "-" 0x4608 tmot KF_TI_TMOT_TML_KAT_F_tmot_AXIS 100.000000 F00014 8 -48.000000 207.000000 /end AXIS_PTS
/begin RECORD_LAYOUT KF_TI_TMOT_TML_KAT_F_tmot_AXIS FIX_NO_AXIS_PTS_X 8 AXIS_PTS_X 0 UWORD INDEX_INCR DIRECT /end RECORD_LAYOUT
/begin AXIS_PTS KF_TI_TMOT_TML_KAT_F_t_ml_AXIS "-" 0x4618 t_ml KF_TI_TMOT_TML_KAT_F_t_ml_AXIS 100.000000 F00250 8 0.000000 3600.000000 /end AXIS_PTS
/begin RECORD_LAYOUT KF_TI_TMOT_TML_KAT_F_t_ml_AXIS FIX_NO_AXIS_PTS_Y 8 AXIS_PTS_Y 0 UWORD INDEX_INCR DIRECT /end RECORD_LAYOUT
/begin CHARACTERISTIC KF_TI_TMOT_TML_SLP_M "-" MAP 0x46CA VALUE_KF_TI_TMOT_TML_SLP_M 100.000000 F00085 -1.000000 4.000000
 /begin AXIS_DESCR COM_AXIS tmot F00014 8 -48.000000 207.000000 AXIS_PTS_REF KF_TI_TMOT_TML_SLP_M_tmot_AXIS /end AXIS_DESCR
 /begin AXIS_DESCR COM_AXIS t_ml F00250 8 0.000000 3600.000000 AXIS_PTS_REF KF_TI_TMOT_TML_SLP_M_t_ml_AXIS /end AXIS_DESCR
 FUNCTION_LIST Einspritzung /end CHARACTERISTIC
/begin RECORD_LAYOUT VALUE_KF_TI_TMOT_TML_SLP_M FNC_VALUES 0 SWORD ROW_DIR DIRECT /end RECORD_LAYOUT
/begin AXIS_PTS KF_TI_TMOT_TML_SLP_M_tmot_AXIS "-" 0x46AA tmot KF_TI_TMOT_TML_SLP_M_tmot_AXIS 100.000000 F00014 8 -48.000000 207.000000 /end AXIS_PTS
/begin RECORD_LAYOUT KF_TI_TMOT_TML_SLP_M_tmot_AXIS FIX_NO_AXIS_PTS_X 8 AXIS_PTS_X 0 UWORD INDEX_INCR DIRECT /end RECORD_LAYOUT
/begin AXIS_PTS KF_TI_TMOT_TML_SLP_M_t_ml_AXIS "-" 0x46BA t_ml KF_TI_TMOT_TML_SLP_M_t_ml_AXIS 100.000000 F00250 8 0.000000 3600.000000 /end AXIS_PTS
/begin RECORD_LAYOUT KF_TI_TMOT_TML_SLP_M_t_ml_AXIS FIX_NO_AXIS_PTS_Y 8 AXIS_PTS_Y 0 UWORD INDEX_INCR DIRECT /end RECORD_LAYOUT
/begin CHARACTERISTIC KF_TI_TMOT_TML_KAT_M "-" MAP 0x476C VALUE_KF_TI_TMOT_TML_KAT_M 100.000000 F00085 -1.000000 4.000000
 /begin AXIS_DESCR COM_AXIS tmot F00014 8 -48.000000 207.000000 AXIS_PTS_REF KF_TI_TMOT_TML_KAT_M_tmot_AXIS /end AXIS_DESCR
 /begin AXIS_DESCR COM_AXIS t_ml F00250 8 0.000000 3600.000000 AXIS_PTS_REF KF_TI_TMOT_TML_KAT_M_t_ml_AXIS /end AXIS_DESCR
 FUNCTION_LIST Einspritzung /end CHARACTERISTIC
/begin RECORD_LAYOUT VALUE_KF_TI_TMOT_TML_KAT_M FNC_VALUES 0 SWORD ROW_DIR DIRECT /end RECORD_LAYOUT
/begin AXIS_PTS KF_TI_TMOT_TML_KAT_M_tmot_AXIS "-" 0x474C tmot KF_TI_TMOT_TML_KAT_M_tmot_AXIS 100.000000 F00014 8 -48.000000 207.000000 /end AXIS_PTS
/begin RECORD_LAYOUT KF_TI_TMOT_TML_KAT_M_tmot_AXIS FIX_NO_AXIS_PTS_X 8 AXIS_PTS_X 0 UWORD INDEX_INCR DIRECT /end RECORD_LAYOUT
/begin AXIS_PTS KF_TI_TMOT_TML_KAT_M_t_ml_AXIS "-" 0x475C t_ml KF_TI_TMOT_TML_KAT_M_t_ml_AXIS 100.000000 F00250 8 0.000000 3600.000000 /end AXIS_PTS
/begin RECORD_LAYOUT KF_TI_TMOT_TML_KAT_M_t_ml_AXIS FIX_NO_AXIS_PTS_Y 8 AXIS_PTS_Y 0 UWORD INDEX_INCR DIRECT /end RECORD_LAYOUT
/begin CHARACTERISTIC KF_TI_TMOT_TML_WL "-" MAP 0x480E VALUE_KF_TI_TMOT_TML_WL 100.000000 F00085 -1.000000 4.000000
 /begin AXIS_DESCR COM_AXIS tmot F00014 8 -48.000000 207.000000 AXIS_PTS_REF KF_TI_TMOT_TML_WL_tmot_AXIS /end AXIS_DESCR
 /begin AXIS_DESCR COM_AXIS t_ml F00250 8 0.000000 3600.000000 AXIS_PTS_REF KF_TI_TMOT_TML_WL_t_ml_AXIS /end AXIS_DESCR
 FUNCTION_LIST Einspritzung /end CHARACTERISTIC
/begin RECORD_LAYOUT VALUE_KF_TI_TMOT_TML_WL FNC_VALUES 0 SWORD ROW_DIR DIRECT /end RECORD_LAYOUT
/begin AXIS_PTS KF_TI_TMOT_TML_WL_tmot_AXIS "-" 0x47EE tmot KF_TI_TMOT_TML_WL_tmot_AXIS 100.000000 F00014 8 -48.000000 207.000000 /end AXIS_PTS
/begin RECORD_LAYOUT KF_TI_TMOT_TML_WL_tmot_AXIS FIX_NO_AXIS_PTS_X 8 AXIS_PTS_X 0 UWORD INDEX_INCR DIRECT /end RECORD_LAYOUT
/begin AXIS_PTS KF_TI_TMOT_TML_WL_t_ml_AXIS "-" 0x47FE t_ml KF_TI_TMOT_TML_WL_t_ml_AXIS 100.000000 F00250 8 0.000000 3600.000000 /end AXIS_PTS
/begin RECORD_LAYOUT KF_TI_TMOT_TML_WL_t_ml_AXIS FIX_NO_AXIS_PTS_Y 8 AXIS_PTS_Y 0 UWORD INDEX_INCR DIRECT /end RECORD_LAYOUT
/begin CHARACTERISTIC KF_TI_N_RF "-" MAP 0x48CC VALUE_KF_TI_N_RF 100.000000 F00056 0.000000 1.000000
 /begin AXIS_DESCR COM_AXIS n F00007 18 0.000000 10000.000000 AXIS_PTS_REF KF_TI_N_RF_n_AXIS /end AXIS_DESCR
 /begin AXIS_DESCR COM_AXIS rf F00068 12 0.000000 2.000000 AXIS_PTS_REF KF_TI_N_RF_rf_AXIS /end AXIS_DESCR
 FUNCTION_LIST Einspritzung /end CHARACTERISTIC
/begin RECORD_LAYOUT VALUE_KF_TI_N_RF FNC_VALUES 0 UBYTE ROW_DIR DIRECT /end RECORD_LAYOUT
/begin AXIS_PTS KF_TI_N_RF_n_AXIS "-" 0x4890 n KF_TI_N_RF_n_AXIS 100.000000 F00007 18 0.000000 10000.000000 /end AXIS_PTS
/begin RECORD_LAYOUT KF_TI_N_RF_n_AXIS FIX_NO_AXIS_PTS_X 18 AXIS_PTS_X 0 UWORD INDEX_INCR DIRECT /end RECORD_LAYOUT
/begin AXIS_PTS KF_TI_N_RF_rf_AXIS "-" 0x48B4 rf KF_TI_N_RF_rf_AXIS 100.000000 F00068 12 0.000000 2.000000 /end AXIS_PTS
/begin RECORD_LAYOUT KF_TI_N_RF_rf_AXIS FIX_NO_AXIS_PTS_Y 12 AXIS_PTS_Y 0 UWORD INDEX_INCR DIRECT /end RECORD_LAYOUT
/begin CHARACTERISTIC KF_TI_TAN_TMOT_NAS "-" MAP 0x49AE VALUE_KF_TI_TAN_TMOT_NAS 100.000000 F00417 655.000000 3.000000
 /begin AXIS_DESCR COM_AXIS tan F00014 4 -48.000000 207.000000 AXIS_PTS_REF KF_TI_TAN_TMOT_NAS_tan_AXIS /end AXIS_DESCR
 /begin AXIS_DESCR COM_AXIS tmot F00014 4 -48.000000 207.000000 AXIS_PTS_REF KF_TI_TAN_TMOT_NAS_tmot_AXIS /end AXIS_DESCR
 FUNCTION_LIST Einspritzung /end CHARACTERISTIC
/begin RECORD_LAYOUT VALUE_KF_TI_TAN_TMOT_NAS FNC_VALUES 0 UBYTE ROW_DIR DIRECT /end RECORD_LAYOUT
/begin AXIS_PTS KF_TI_TAN_TMOT_NAS_tan_AXIS "-" 0x49A6 tan KF_TI_TAN_TMOT_NAS_tan_AXIS 100.000000 F00014 4 -48.000000 207.000000 /end AXIS_PTS
/begin RECORD_LAYOUT KF_TI_TAN_TMOT_NAS_tan_AXIS FIX_NO_AXIS_PTS_X 4 AXIS_PTS_X 0 UBYTE INDEX_INCR DIRECT /end RECORD_LAYOUT
/begin AXIS_PTS KF_TI_TAN_TMOT_NAS_tmot_AXIS "-" 0x49AA tmot KF_TI_TAN_TMOT_NAS_tmot_AXIS 100.000000 F00014 4 -48.000000 207.000000 /end AXIS_PTS
/begin RECORD_LAYOUT KF_TI_TAN_TMOT_NAS_tmot_AXIS FIX_NO_AXIS_PTS_Y 4 AXIS_PTS_Y 0 UBYTE INDEX_INCR DIRECT /end RECORD_LAYOUT
/begin CHARACTERISTIC KF_TIENDE_N_RF "-" MAP 0x49DC VALUE_KF_TIENDE_N_RF 100.000000 F00006 0.000000 6553.000000
 /begin AXIS_DESCR COM_AXIS n F00007 8 0.000000 10000.000000 AXIS_PTS_REF KF_TIENDE_N_RF_n_AXIS /end AXIS_DESCR
 /begin AXIS_DESCR COM_AXIS rf F00068 6 0.000000 2.000000 AXIS_PTS_REF KF_TIENDE_N_RF_rf_AXIS /end AXIS_DESCR
 FUNCTION_LIST Einspritzung /end CHARACTERISTIC
/begin RECORD_LAYOUT VALUE_KF_TIENDE_N_RF FNC_VALUES 0 UWORD ROW_DIR DIRECT /end RECORD_LAYOUT
/begin AXIS_PTS KF_TIENDE_N_RF_n_AXIS "-" 0x49C0 n KF_TIENDE_N_RF_n_AXIS 100.000000 F00007 8 0.000000 10000.000000 /end AXIS_PTS
/begin RECORD_LAYOUT KF_TIENDE_N_RF_n_AXIS FIX_NO_AXIS_PTS_X 8 AXIS_PTS_X 0 UWORD INDEX_INCR DIRECT /end RECORD_LAYOUT
/begin AXIS_PTS KF_TIENDE_N_RF_rf_AXIS "-" 0x49D0 rf KF_TIENDE_N_RF_rf_AXIS 100.000000 F00068 6 0.000000 2.000000 /end AXIS_PTS
/begin RECORD_LAYOUT KF_TIENDE_N_RF_rf_AXIS FIX_NO_AXIS_PTS_Y 6 AXIS_PTS_Y 0 UWORD INDEX_INCR DIRECT /end RECORD_LAYOUT
/begin CHARACTERISTIC KF_TI_N_RF_SLP_M "-" MAP 0x4A5E VALUE_KF_TI_N_RF_SLP_M 100.000000 F00056 -1.000000 0.000000
 /begin AXIS_DESCR COM_AXIS n F00007 8 0.000000 10000.000000 AXIS_PTS_REF KF_TI_N_RF_SLP_M_n_AXIS /end AXIS_DESCR
 /begin AXIS_DESCR COM_AXIS rf F00068 8 0.000000 2.000000 AXIS_PTS_REF KF_TI_N_RF_SLP_M_rf_AXIS /end AXIS_DESCR
 FUNCTION_LIST Einspritzung /end CHARACTERISTIC
/begin RECORD_LAYOUT VALUE_KF_TI_N_RF_SLP_M FNC_VALUES 0 SBYTE ROW_DIR DIRECT /end RECORD_LAYOUT
/begin AXIS_PTS KF_TI_N_RF_SLP_M_n_AXIS "-" 0x4A3E n KF_TI_N_RF_SLP_M_n_AXIS 100.000000 F00007 8 0.000000 10000.000000 /end AXIS_PTS
/begin RECORD_LAYOUT KF_TI_N_RF_SLP_M_n_AXIS FIX_NO_AXIS_PTS_X 8 AXIS_PTS_X 0 UWORD INDEX_INCR DIRECT /end RECORD_LAYOUT
/begin AXIS_PTS KF_TI_N_RF_SLP_M_rf_AXIS "-" 0x4A4E rf KF_TI_N_RF_SLP_M_rf_AXIS 100.000000 F00068 8 0.000000 2.000000 /end AXIS_PTS
/begin RECORD_LAYOUT KF_TI_N_RF_SLP_M_rf_AXIS FIX_NO_AXIS_PTS_Y 8 AXIS_PTS_Y 0 UWORD INDEX_INCR DIRECT /end RECORD_LAYOUT
/begin CHARACTERISTIC KF_TI_N_RF_KAT_M "-" MAP 0x4AC0 VALUE_KF_TI_N_RF_KAT_M 100.000000 F00056 -1.000000 0.000000
 /begin AXIS_DESCR COM_AXIS n F00007 8 0.000000 10000.000000 AXIS_PTS_REF KF_TI_N_RF_KAT_M_n_AXIS /end AXIS_DESCR
 /begin AXIS_DESCR COM_AXIS rf F00068 8 0.000000 2.000000 AXIS_PTS_REF KF_TI_N_RF_KAT_M_rf_AXIS /end AXIS_DESCR
 FUNCTION_LIST Einspritzung /end CHARACTERISTIC
/begin RECORD_LAYOUT VALUE_KF_TI_N_RF_KAT_M FNC_VALUES 0 SBYTE ROW_DIR DIRECT /end RECORD_LAYOUT
/begin AXIS_PTS KF_TI_N_RF_KAT_M_n_AXIS "-" 0x4AA0 n KF_TI_N_RF_KAT_M_n_AXIS 100.000000 F00007 8 0.000000 10000.000000 /end AXIS_PTS
/begin RECORD_LAYOUT KF_TI_N_RF_KAT_M_n_AXIS FIX_NO_AXIS_PTS_X 8 AXIS_PTS_X 0 UWORD INDEX_INCR DIRECT /end RECORD_LAYOUT
/begin AXIS_PTS KF_TI_N_RF_KAT_M_rf_AXIS "-" 0x4AB0 rf KF_TI_N_RF_KAT_M_rf_AXIS 100.000000 F00068 8 0.000000 2.000000 /end AXIS_PTS
/begin RECORD_LAYOUT KF_TI_N_RF_KAT_M_rf_AXIS FIX_NO_AXIS_PTS_Y 8 AXIS_PTS_Y 0 UWORD INDEX_INCR DIRECT /end RECORD_LAYOUT
/begin CHARACTERISTIC KF_TI_N_RF_VL "-" MAP 0x4B2C VALUE_KF_TI_N_RF_VL 100.000000 F00056 0.000000 1.000000
 /begin AXIS_DESCR COM_AXIS n F00007 18 0.000000 10000.000000 AXIS_PTS_REF KF_TI_N_RF_VL_n_AXIS /end AXIS_DESCR
 /begin AXIS_DESCR COM_AXIS rf F00068 3 0.000000 2.000000 AXIS_PTS_REF KF_TI_N_RF_VL_rf_AXIS /end AXIS_DESCR
 FUNCTION_LIST Einspritzung /end CHARACTERISTIC
/begin RECORD_LAYOUT VALUE_KF_TI_N_RF_VL FNC_VALUES 0 UBYTE ROW_DIR DIRECT /end RECORD_LAYOUT
/begin AXIS_PTS KF_TI_N_RF_VL_n_AXIS "-" 0x4B02 n KF_TI_N_RF_VL_n_AXIS 100.000000 F00007 18 0.000000 10000.000000 /end AXIS_PTS
/begin RECORD_LAYOUT KF_TI_N_RF_VL_n_AXIS FIX_NO_AXIS_PTS_X 18 AXIS_PTS_X 0 UWORD INDEX_INCR DIRECT /end RECORD_LAYOUT
/begin AXIS_PTS KF_TI_N_RF_VL_rf_AXIS "-" 0x4B26 rf KF_TI_N_RF_VL_rf_AXIS 100.000000 F00068 3 0.000000 2.000000 /end AXIS_PTS
/begin RECORD_LAYOUT KF_TI_N_RF_VL_rf_AXIS FIX_NO_AXIS_PTS_Y 3 AXIS_PTS_Y 0 UWORD INDEX_INCR DIRECT /end RECORD_LAYOUT
/begin CHARACTERISTIC KF_TI_PT_KORR_N_RF "-" MAP 0x4B76 VALUE_KF_TI_PT_KORR_N_RF 100.000000 F00056 -1.000000 0.000000
 /begin AXIS_DESCR COM_AXIS n F00007 5 0.000000 10000.000000 AXIS_PTS_REF KF_TI_PT_KORR_N_RF_n_AXIS /end AXIS_DESCR
 /begin AXIS_DESCR COM_AXIS rf F00068 4 0.000000 2.000000 AXIS_PTS_REF KF_TI_PT_KORR_N_RF_rf_AXIS /end AXIS_DESCR
 FUNCTION_LIST Einspritzung /end CHARACTERISTIC
/begin RECORD_LAYOUT VALUE_KF_TI_PT_KORR_N_RF FNC_VALUES 0 SBYTE ROW_DIR DIRECT /end RECORD_LAYOUT
/begin AXIS_PTS KF_TI_PT_KORR_N_RF_n_AXIS "-" 0x4B64 n KF_TI_PT_KORR_N_RF_n_AXIS 100.000000 F00007 5 0.000000 10000.000000 /end AXIS_PTS
/begin RECORD_LAYOUT KF_TI_PT_KORR_N_RF_n_AXIS FIX_NO_AXIS_PTS_X 5 AXIS_PTS_X 0 UWORD INDEX_INCR DIRECT /end RECORD_LAYOUT
/begin AXIS_PTS KF_TI_PT_KORR_N_RF_rf_AXIS "-" 0x4B6E rf KF_TI_PT_KORR_N_RF_rf_AXIS 100.000000 F00068 4 0.000000 2.000000 /end AXIS_PTS
/begin RECORD_LAYOUT KF_TI_PT_KORR_N_RF_rf_AXIS FIX_NO_AXIS_PTS_Y 4 AXIS_PTS_Y 0 UWORD INDEX_INCR DIRECT /end RECORD_LAYOUT
/begin CHARACTERISTIC KF_TI_EV_ABGESCH_N_R "-" MAP 0x4BA0 VALUE_KF_TI_EV_ABGESCH_N_R 100.000000 F00056 0.000000 1.000000
 /begin AXIS_DESCR COM_AXIS n F00007 5 0.000000 10000.000000 AXIS_PTS_REF KF_TI_EV_ABGESCH_N_R_n_AXIS /end AXIS_DESCR
 /begin AXIS_DESCR COM_AXIS rf F00068 5 0.000000 2.000000 AXIS_PTS_REF KF_TI_EV_ABGESCH_N_R_rf_AXIS /end AXIS_DESCR
 FUNCTION_LIST Einspritzung /end CHARACTERISTIC
/begin RECORD_LAYOUT VALUE_KF_TI_EV_ABGESCH_N_R FNC_VALUES 0 UBYTE ROW_DIR DIRECT /end RECORD_LAYOUT
/begin AXIS_PTS KF_TI_EV_ABGESCH_N_R_n_AXIS "-" 0x4B8C n KF_TI_EV_ABGESCH_N_R_n_AXIS 100.000000 F00007 5 0.000000 10000.000000 /end AXIS_PTS
/begin RECORD_LAYOUT KF_TI_EV_ABGESCH_N_R_n_AXIS FIX_NO_AXIS_PTS_X 5 AXIS_PTS_X 0 UWORD INDEX_INCR DIRECT /end RECORD_LAYOUT
/begin AXIS_PTS KF_TI_EV_ABGESCH_N_R_rf_AXIS "-" 0x4B96 rf KF_TI_EV_ABGESCH_N_R_rf_AXIS 100.000000 F00068 5 0.000000 2.000000 /end AXIS_PTS
/begin RECORD_LAYOUT KF_TI_EV_ABGESCH_N_R_rf_AXIS FIX_NO_AXIS_PTS_Y 5 AXIS_PTS_Y 0 UWORD INDEX_INCR DIRECT /end RECORD_LAYOUT
/begin CHARACTERISTIC KL_TKA_NTC "-" CURVE 0x752E VALUE_KL_TKA_NTC 100.000000 F00236 -48.000000 207.000000
 /begin AXIS_DESCR /* ad_tka */ COM_AXIS ad_tka F00013 8 0.000000 1023.000000 AXIS_PTS_REF KL_TKA_NTC_ad_tka_AXIS /end AXIS_DESCR
 FUNCTION_LIST Messwerte /end CHARACTERISTIC
/begin RECORD_LAYOUT VALUE_KL_TKA_NTC FNC_VALUES 0 UWORD ROW_DIR DIRECT /end RECORD_LAYOUT
/begin AXIS_PTS KL_TKA_NTC_ad_tka_AXIS "-" 0x751E ad_tka KL_TKA_NTC_ad_tka_AXIS 100.000000 F00013 8 0.000000 1023.000000 /end AXIS_PTS
/begin RECORD_LAYOUT KL_TKA_NTC_ad_tka_AXIS FIX_NO_AXIS_PTS_X 8 AXIS_PTS_X 0 UWORD INDEX_INCR DIRECT /end RECORD_LAYOUT
/begin CHARACTERISTIC K_FZG_RADST "" VALUE 0x1B22 CONST_2 100.000000 F00000 0.000000 5000.000000 FUNCTION_LIST AQUER /end CHARACTERISTIC
/begin CHARACTERISTIC K_FZG_SPW "" VALUE 0x1B24 CONST_2 100.000000 F00000 0.000000 2000.000000 FUNCTION_LIST AQUER /end CHARACTERISTIC
/begin CHARACTERISTIC K_A_QUER_LRW_OFFSET "" VALUE 0x1B26 CONST_2 100.000000 F00001 0.000000 10.000000 FUNCTION_LIST AQUER /end CHARACTERISTIC
/begin CHARACTERISTIC K_AVAN2_RAD "" VALUE 0x3504 CONST_1 100.000000 F00005 -360.000000 360.000000 FUNCTION_LIST Vanos /end CHARACTERISTIC
/begin CHARACTERISTIC K_AVAN2_OFFSET "" VALUE 0x3506 CONST_3 100.000000 F00006 -20.000000 80.000000 FUNCTION_LIST Vanos /end CHARACTERISTIC
/begin CHARACTERISTIC K_AVAN2_N_OFF "" VALUE 0x3508 CONST_2 100.000000 F00007 0.000000 10000.000000 FUNCTION_LIST Vanos /end CHARACTERISTIC
/begin CHARACTERISTIC K_AVAN2_IMPULS_MIN "" VALUE 0x350A CONST_2 100.000000 F00008 0.000000 210.000000 FUNCTION_LIST Vanos /end CHARACTERISTIC
/begin CHARACTERISTIC K_AVAN2_T_DRUCKAB "" VALUE 0x350C CONST_2 100.000000 F00009 0.000000 65.000000 FUNCTION_LIST Vanos /end CHARACTERISTIC
/begin CHARACTERISTIC K_AVAN2_T_ENTL "" VALUE 0x350E CONST_2 100.000000 F00009 0.000000 65.000000 FUNCTION_LIST Vanos /end CHARACTERISTIC
/begin CHARACTERISTIC K_AVAN2_REGLER_TAU "" VALUE 0x3510 CONST_0 100.000000 F00010 0.000000 25.000000 FUNCTION_LIST Vanos /end CHARACTERISTIC
/begin CHARACTERISTIC K_AVAN2_XD_REG_MIN "" VALUE 0x3511 CONST_0 100.000000 F00006 0.000000 25.000000 FUNCTION_LIST Vanos /end CHARACTERISTIC
/begin CHARACTERISTIC K_AVAN2_SOLL_DICHT "" VALUE 0x3512 CONST_1 100.000000 F00011 -20.000000 80.000000 FUNCTION_LIST Vanos /end CHARACTERISTIC
/begin CHARACTERISTIC K_AVAN2_XD_MAX "" VALUE 0x3514 CONST_3 100.000000 F00006 -20.000000 80.000000 FUNCTION_LIST Vanos /end CHARACTERISTIC
/begin CHARACTERISTIC K_AVAN2_CONTROL "" VALUE 0x3516 CONST_0 100.000000 F00012 0.000000 255.000000 FUNCTION_LIST Vanos /end CHARACTERISTIC
/begin CHARACTERISTIC K_BELU_DIAG_OPEN_E36_7 "" VALUE 0x35FE CONST_2 100.000000 F00013 0.000000 65535.000000 FUNCTION_LIST Elektroluefter /end CHARACTERISTIC
/begin CHARACTERISTIC K_BELU_DIAG_TDME "" VALUE 0x3600 CONST_0 100.000000 F00014 -48.000000 140.000000 FUNCTION_LIST Elektroluefter /end CHARACTERISTIC
/begin CHARACTERISTIC K_BELU_TDME "" VALUE 0x3601 CONST_0 100.000000 F00014 -48.000000 140.000000 FUNCTION_LIST Elektroluefter /end CHARACTERISTIC
/begin CHARACTERISTIC K_BELU_TDME_HYS "" VALUE 0x3602 CONST_0 100.000000 F00015 0.000000 140.000000 FUNCTION_LIST Elektroluefter /end CHARACTERISTIC
/begin CHARACTERISTIC K_BELU_DIAG_ANLAUF_SPERRE "" VALUE 0x3604 CONST_4 100.000000 F00016 0.000000 4194303.000000 FUNCTION_LIST Elektroluefter /end CHARACTERISTIC
/begin CHARACTERISTIC K_BELU_LOSBRECHEN "" VALUE 0x3608 CONST_0 100.000000 F00017 0.000000 255.000000 FUNCTION_LIST Elektroluefter /end CHARACTERISTIC
/begin CHARACTERISTIC K_CAN_UBMIN "" VALUE 0x3C CONST_0 100.000000 F00018 0.000000 20.000000 FUNCTION_LIST CAN_Schnittstelle /end CHARACTERISTIC
/begin CHARACTERISTIC K_CAN_ED_TSPERR "" VALUE 0x3D CONST_0 100.000000 F00019 0.000000 25500.000000 FUNCTION_LIST CAN_Schnittstelle /end CHARACTERISTIC
/begin CHARACTERISTIC K_ASC_ALIVE "" VALUE 0x3E CONST_0 100.000000 F00020 0.000000 255.000000 FUNCTION_LIST CAN_Schnittstelle /end CHARACTERISTIC
/begin CHARACTERISTIC K_ASC_MD_ABBRUCH "" VALUE 0x3F CONST_0 100.000000 F00021 0.000000 9.000000 FUNCTION_LIST CAN_Schnittstelle /end CHARACTERISTIC
/begin CHARACTERISTIC K_DSC_STAND "" VALUE 0x40 CONST_0 100.000000 F00022 0.000000 255.000000 FUNCTION_LIST CAN_Schnittstelle /end CHARACTERISTIC
/begin CHARACTERISTIC K_DSC_TYP "" VALUE 0x41 CONST_0 100.000000 F00023 0.000000 255.000000 FUNCTION_LIST CAN_Schnittstelle /end CHARACTERISTIC
/begin CHARACTERISTIC K_ASC_A_TAU "" VALUE 0x42 CONST_0 100.000000 F00024 5.000000 0.000000 FUNCTION_LIST CAN_Schnittstelle /end CHARACTERISTIC
/begin CHARACTERISTIC K_EGS_T_MAX_TZ "" VALUE 0x44 CONST_2 100.000000 F00025 0.000000 655.000000 FUNCTION_LIST CAN_Schnittstelle /end CHARACTERISTIC
/begin CHARACTERISTIC K_EGS_T_MAX_DK "" VALUE 0x46 CONST_2 100.000000 F00025 0.000000 655.000000 FUNCTION_LIST CAN_Schnittstelle /end CHARACTERISTIC
/begin CHARACTERISTIC K_DDS_CONTROL "" VALUE 0x48 CONST_0 100.000000 F00026 0.000000 255.000000 FUNCTION_LIST CAN_Schnittstelle /end CHARACTERISTIC
/begin CHARACTERISTIC K_DDS_PERIODE "" VALUE 0x49 CONST_0 100.000000 F00027 0.000000 2.000000 FUNCTION_LIST CAN_Schnittstelle /end CHARACTERISTIC
/begin CHARACTERISTIC K_DDS_HIGHTIME "" VALUE 0x4A CONST_0 100.000000 F00027 0.000000 2.000000 FUNCTION_LIST CAN_Schnittstelle /end CHARACTERISTIC
/begin CHARACTERISTIC K_CAN_LAMPEN_PRE_DRIVE "" VALUE 0x4B CONST_0 100.000000 F00028 0.000000 25.000000 FUNCTION_LIST CAN_Schnittstelle /end CHARACTERISTIC
/begin CHARACTERISTIC cfg_m.baureihe "" VALUE 0x6 CONST_1 100.000000 F00029 -128.000000 127.000000 FUNCTION_LIST NO_FUNCTION /end CHARACTERISTIC
/begin CHARACTERISTIC cfg_m.motortyp "" VALUE 0x7 CONST_1 100.000000 F00030 -128.000000 127.000000 FUNCTION_LIST NO_FUNCTION /end CHARACTERISTIC
/begin CHARACTERISTIC cfg_m.getriebetyp "" VALUE 0x8 CONST_1 100.000000 F00031 -128.000000 127.000000 FUNCTION_LIST NO_FUNCTION /end CHARACTERISTIC
/begin CHARACTERISTIC cfg_m.canstand "" VALUE 0x9 CONST_1 100.000000 F00032 -128.000000 127.000000 FUNCTION_LIST NO_FUNCTION /end CHARACTERISTIC
/begin CHARACTERISTIC cfg_m.variante "" VALUE 0xA CONST_1 100.000000 F00033 -128.000000 127.000000 FUNCTION_LIST NO_FUNCTION /end CHARACTERISTIC
/begin CHARACTERISTIC cfg_m.kr "" VALUE 0xB CONST_1 100.000000 F00034 -128.000000 127.000000 FUNCTION_LIST NO_FUNCTION /end CHARACTERISTIC
/begin CHARACTERISTIC cfg_m.diagnose "" VALUE 0xE CONST_1 100.000000 F00031 -128.000000 127.000000 FUNCTION_LIST NO_FUNCTION /end CHARACTERISTIC
/begin CHARACTERISTIC cfg_m.status "" VALUE 0xF CONST_1 100.000000 F00035 -128.000000 127.000000 FUNCTION_LIST NO_FUNCTION /end CHARACTERISTIC
/begin CHARACTERISTIC cfg_m.sg_typ "" VALUE 0x10 CONST_1 100.000000 F00031 -128.000000 127.000000 FUNCTION_LIST NO_FUNCTION /end CHARACTERISTIC
/begin CHARACTERISTIC cfg_m.betriebsmode "" VALUE 0x11 CONST_1 100.000000 F00036 -128.000000 127.000000 FUNCTION_LIST NO_FUNCTION /end CHARACTERISTIC
/begin CHARACTERISTIC cfg_m.egas "" VALUE 0x12 CONST_1 100.000000 F00037 -128.000000 127.000000 FUNCTION_LIST NO_FUNCTION /end CHARACTERISTIC
/begin CHARACTERISTIC K_DSV_CONTROL "" VALUE 0x3518 CONST_0 100.000000 F00038 0.000000 255.000000 FUNCTION_LIST Druckspeicherventil /end CHARACTERISTIC
/begin CHARACTERISTIC K_DSV_DLY "" VALUE 0x3519 CONST_0 100.000000 F00028 0.000000 25.000000 FUNCTION_LIST Druckspeicherventil /end CHARACTERISTIC
/begin CHARACTERISTIC K_VVDP_TMOT_MIN "" VALUE 0x351A CONST_0 100.000000 F00014 -48.000000 207.000000 FUNCTION_LIST Druckspeicherventil /end CHARACTERISTIC
/begin CHARACTERISTIC K_VVDP_TAN_MIN "" VALUE 0x351B CONST_0 100.000000 F00014 -48.000000 207.000000 FUNCTION_LIST Druckspeicherventil /end CHARACTERISTIC
/begin CHARACTERISTIC K_VVDP_UB_MIN "" VALUE 0x351C CONST_0 100.000000 F00018 0.000000 20.000000 FUNCTION_LIST Druckspeicherventil /end CHARACTERISTIC
/begin CHARACTERISTIC K_DWF_TOEL_0SEG "" VALUE 0x1460 CONST_0 100.000000 F00014 -48.000000 207.000000 FUNCTION_LIST Drehzahlwarnfeld /end CHARACTERISTIC
/begin CHARACTERISTIC K_DWF_TOEL_1SEG "" VALUE 0x1461 CONST_0 100.000000 F00014 -48.000000 207.000000 FUNCTION_LIST Drehzahlwarnfeld /end CHARACTERISTIC
/begin CHARACTERISTIC K_DWF_TOEL_2SEG "" VALUE 0x1462 CONST_0 100.000000 F00014 -48.000000 207.000000 FUNCTION_LIST Drehzahlwarnfeld /end CHARACTERISTIC
/begin CHARACTERISTIC K_DWF_TOEL_3SEG "" VALUE 0x1463 CONST_0 100.000000 F00014 -48.000000 207.000000 FUNCTION_LIST Drehzahlwarnfeld /end CHARACTERISTIC
/begin CHARACTERISTIC K_DWF_TOEL_4SEG "" VALUE 0x1464 CONST_0 100.000000 F00014 -48.000000 207.000000 FUNCTION_LIST Drehzahlwarnfeld /end CHARACTERISTIC
/begin CHARACTERISTIC K_DWF_TOEL_5SEG "" VALUE 0x1465 CONST_0 100.000000 F00014 -48.000000 207.000000 FUNCTION_LIST Drehzahlwarnfeld /end CHARACTERISTIC
/begin CHARACTERISTIC K_DWF_TOEL_6SEG "" VALUE 0x1466 CONST_0 100.000000 F00014 -48.000000 207.000000 FUNCTION_LIST Drehzahlwarnfeld /end CHARACTERISTIC
/begin CHARACTERISTIC K_DWF_T_HYS "" VALUE 0x1467 CONST_0 100.000000 F00039 0.000000 25.000000 FUNCTION_LIST Drehzahlwarnfeld /end CHARACTERISTIC
/begin CHARACTERISTIC K_DYN_DWDK_MIN "" VALUE 0x3680 CONST_3 100.000000 F00040 -5000.000000 5000.000000 FUNCTION_LIST Dynamik /end CHARACTERISTIC
/begin CHARACTERISTIC K_DYN_DBGR_N_MIN "" VALUE 0x3682 CONST_2 100.000000 F00007 0.000000 10000.000000 FUNCTION_LIST Dynamik /end CHARACTERISTIC
/begin CHARACTERISTIC K_DYN_DBGR_WDK_MIN "" VALUE 0x3684 CONST_0 100.000000 F00041 0.000000 100.000000 FUNCTION_LIST Dynamik /end CHARACTERISTIC
/begin CHARACTERISTIC K_DYN_DBGR_TMOT_MIN "" VALUE 0x3685 CONST_0 100.000000 F00014 -48.000000 207.000000 FUNCTION_LIST Dynamik /end CHARACTERISTIC
/begin CHARACTERISTIC K_DYN_CONTROL "" VALUE 0x3702 CONST_0 100.000000 F00013 0.000000 255.000000 BIT_MASK 0xFF FUNCTION_LIST Dynamik /end CHARACTERISTIC
/begin CHARACTERISTIC K_DYN_BA_DPWG "" VALUE 0x3703 CONST_1 100.000000 F00042 -12.000000 12.000000 FUNCTION_LIST Dynamik /end CHARACTERISTIC
/begin CHARACTERISTIC K_DYN_BA_TSPERR "" VALUE 0x374C CONST_0 100.000000 F00043 0.000000 255.000000 FUNCTION_LIST Dynamik /end CHARACTERISTIC
/begin CHARACTERISTIC K_DYN_SA_DPWG "" VALUE 0x374D CONST_1 100.000000 F00042 -12.000000 12.000000 FUNCTION_LIST Dynamik /end CHARACTERISTIC
/begin CHARACTERISTIC K_DYN_SA_TSPERR "" VALUE 0x3772 CONST_0 100.000000 F00043 0.000000 255.000000 FUNCTION_LIST Dynamik /end CHARACTERISTIC
/begin CHARACTERISTIC K_EDK_UBMIN "" VALUE 0x4C CONST_0 100.000000 F00018 0.000000 25.000000 FUNCTION_LIST EDK /end CHARACTERISTIC
/begin CHARACTERISTIC K_EDK_CYCL "" VALUE 0x4D CONST_0 100.000000 F00047 0.000000 255.000000 FUNCTION_LIST EDK /end CHARACTERISTIC
/begin CHARACTERISTIC K_EDK_D_NULL "" VALUE 0x4E CONST_2 100.000000 F00048 0.000000 200.000000 FUNCTION_LIST EDK /end CHARACTERISTIC
/begin CHARACTERISTIC K_EDK_D_MAX "" VALUE 0x50 CONST_2 100.000000 F00049 0.000000 200.000000 FUNCTION_LIST EDK /end CHARACTERISTIC
/begin CHARACTERISTIC K_EDK_DPOS "" VALUE 0x52 CONST_0 100.000000 F00050 0.000000 255.000000 FUNCTION_LIST EDK /end CHARACTERISTIC
/begin CHARACTERISTIC K_EDK_DNEG "" VALUE 0x53 CONST_0 100.000000 F00050 0.000000 255.000000 FUNCTION_LIST EDK /end CHARACTERISTIC
/begin CHARACTERISTIC K_EDK_D_EIN_POS "" VALUE 0x54 CONST_2 100.000000 F00048 0.000000 200.000000 FUNCTION_LIST EDK /end CHARACTERISTIC
/begin CHARACTERISTIC K_EDK_D_ANSCHL "" VALUE 0x56 CONST_3 100.000000 F00048 0.000000 120.000000 FUNCTION_LIST EDK /end CHARACTERISTIC
/begin CHARACTERISTIC K_EDK_I_NULL "" VALUE 0x58 CONST_2 100.000000 F00048 0.000000 200.000000 FUNCTION_LIST EDK /end CHARACTERISTIC
/begin CHARACTERISTIC K_EDK_IBEGR "" VALUE 0x5A CONST_2 100.000000 F00051 0.000000 100.000000 FUNCTION_LIST EDK /end CHARACTERISTIC
/begin CHARACTERISTIC K_EDK_IBEGR_AUFGEW "" VALUE 0x5C CONST_2 100.000000 F00051 0.000000 100.000000 FUNCTION_LIST EDK /end CHARACTERISTIC
/begin CHARACTERISTIC K_EDK_IBEGR_ANSCHLAG "" VALUE 0x5E CONST_2 100.000000 F00051 0.000000 100.000000 FUNCTION_LIST EDK /end CHARACTERISTIC
/begin CHARACTERISTIC K_EDK_T_AUFWEITUNG "" VALUE 0x60 CONST_2 100.000000 F00027 0.000000 655.000000 FUNCTION_LIST EDK /end CHARACTERISTIC
/begin CHARACTERISTIC K_EDK_T_ANSCHLAG "" VALUE 0x62 CONST_2 100.000000 F00027 0.000000 655.000000 FUNCTION_LIST EDK /end CHARACTERISTIC
/begin CHARACTERISTIC K_EDK_IDELTA "" VALUE 0x64 CONST_2 100.000000 F00048 0.000000 100.000000 FUNCTION_LIST EDK /end CHARACTERISTIC
/begin CHARACTERISTIC K_EDK_A100_DELTA "" VALUE 0x66 CONST_3 100.000000 F00048 -10.000000 10.000000 FUNCTION_LIST EDK /end CHARACTERISTIC
/begin CHARACTERISTIC K_EDK_A100_WAIT1 "" VALUE 0x68 CONST_0 100.000000 F00027 0.000000 1.000000 FUNCTION_LIST EDK /end CHARACTERISTIC
/begin CHARACTERISTIC K_EDK_A100_WAIT2 "" VALUE 0x69 CONST_0 100.000000 F00027 0.000000 1.000000 FUNCTION_LIST EDK /end CHARACTERISTIC
/begin CHARACTERISTIC K_EDK_A100_INC1 "" VALUE 0x6A CONST_0 100.000000 F00048 0.000000 25.000000 FUNCTION_LIST EDK /end CHARACTERISTIC
/begin CHARACTERISTIC K_EDK_A100_INC2 "" VALUE 0x6B CONST_0 100.000000 F00048 0.000000 25.000000 FUNCTION_LIST EDK /end CHARACTERISTIC
/begin CHARACTERISTIC K_EDK_A100_DEC3 "" VALUE 0x6C CONST_3 100.000000 F00048 -200.000000 200.000000 FUNCTION_LIST EDK /end CHARACTERISTIC
/begin CHARACTERISTIC K_EDK_A100_B1 "" VALUE 0x6E CONST_3 100.000000 F00048 -200.000000 200.000000 FUNCTION_LIST EDK /end CHARACTERISTIC
/begin CHARACTERISTIC K_EDK_GESCHLOSSEN "" VALUE 0x70 CONST_3 100.000000 F00048 -100.000000 100.000000 FUNCTION_LIST EDK /end CHARACTERISTIC
/begin CHARACTERISTIC K_EDK_HT_MAX "" VALUE 0x72 CONST_2 100.000000 F00049 0.000000 100.000000 FUNCTION_LIST EDK /end CHARACTERISTIC
/begin CHARACTERISTIC K_EDK_A100_HT_MAX "" VALUE 0x74 CONST_2 100.000000 F00049 0.000000 100.000000 FUNCTION_LIST EDK /end CHARACTERISTIC
/begin CHARACTERISTIC K_EDK_SK_HT_MAX "" VALUE 0x76 CONST_2 100.000000 F00049 0.000000 100.000000 FUNCTION_LIST EDK /end CHARACTERISTIC
/begin CHARACTERISTIC K_EDK_AUS_HT_MAX "" VALUE 0x78 CONST_2 100.000000 F00049 0.000000 100.000000 FUNCTION_LIST EDK /end CHARACTERISTIC
/begin CHARACTERISTIC K_EDK_D_IST "" VALUE 0x7A CONST_3 100.000000 F00052 -1000.000000 1000.000000 FUNCTION_LIST EDK /end CHARACTERISTIC
/begin CHARACTERISTIC K_EDK_DS2_DMAX "" VALUE 0x11C CONST_3 100.000000 F00048 -10.000000 10.000000 FUNCTION_LIST EDK /end CHARACTERISTIC
/begin CHARACTERISTIC K_EDK_DS2_TSPERR "" VALUE 0x11E CONST_0 100.000000 F00053 0.000000 0.000000 FUNCTION_LIST EDK /end CHARACTERISTIC
/begin CHARACTERISTIC K_EDK_DS2_TAU "" VALUE 0x11F CONST_0 100.000000 F00054 0.000000 127.000000 FUNCTION_LIST EDK /end CHARACTERISTIC
/begin CHARACTERISTIC K_EDKSI_T_BL_ZU "" VALUE 0x278E CONST_2 100.000000 F00057 0.000000 655350.000000 FUNCTION_LIST EDK_Soll_Ist /end CHARACTERISTIC
/begin CHARACTERISTIC K_EDKSI_T_SPALT "" VALUE 0x2790 CONST_2 100.000000 F00057 0.000000 655350.000000 FUNCTION_LIST EDK_Soll_Ist /end CHARACTERISTIC
/begin CHARACTERISTIC K_EDKSI_T_U_SOLL "" VALUE 0x2792 CONST_2 100.000000 F00057 0.000000 655350.000000 FUNCTION_LIST EDK_Soll_Ist /end CHARACTERISTIC
/begin CHARACTERISTIC K_EDKSI_T_N_GANZ "" VALUE 0x2794 CONST_2 100.000000 F00057 0.000000 655350.000000 FUNCTION_LIST EDK_Soll_Ist /end CHARACTERISTIC
/begin CHARACTERISTIC K_EDKSI_T_BL_AUF_R "" VALUE 0x2796 CONST_2 100.000000 F00057 0.000000 655350.000000 FUNCTION_LIST EDK_Soll_Ist /end CHARACTERISTIC
/begin CHARACTERISTIC K_EDKSI_T_BL_AUF_F "" VALUE 0x2798 CONST_2 100.000000 F00057 0.000000 655350.000000 FUNCTION_LIST EDK_Soll_Ist /end CHARACTERISTIC
/begin CHARACTERISTIC K_EDKSI_T_PDR "" VALUE 0x279A CONST_2 100.000000 F00057 0.000000 655350.000000 FUNCTION_LIST EDK_Soll_Ist /end CHARACTERISTIC
/begin CHARACTERISTIC K_EDKSI_POS_ZU "" VALUE 0x279C CONST_3 100.000000 F00048 -20.000000 120.000000 FUNCTION_LIST EDK_Soll_Ist /end CHARACTERISTIC
/begin CHARACTERISTIC K_EDKSI_HYS_ZU "" VALUE 0x279E CONST_3 100.000000 F00048 -20.000000 120.000000 FUNCTION_LIST EDK_Soll_Ist /end CHARACTERISTIC
/begin CHARACTERISTIC K_EDKSI_POS_SPALT "" VALUE 0x27A0 CONST_3 100.000000 F00048 -20.000000 120.000000 FUNCTION_LIST EDK_Soll_Ist /end CHARACTERISTIC
/begin CHARACTERISTIC K_EDKSI_HYS_U_SOLL "" VALUE 0x27A2 CONST_3 100.000000 F00048 -20.000000 120.000000 FUNCTION_LIST EDK_Soll_Ist /end CHARACTERISTIC
/begin CHARACTERISTIC K_EDKSI_HYS_N_GANZ "" VALUE 0x27A4 CONST_3 100.000000 F00048 -20.000000 120.000000 FUNCTION_LIST EDK_Soll_Ist /end CHARACTERISTIC
/begin CHARACTERISTIC K_EDKSI_POS_N_GANZ "" VALUE 0x27A6 CONST_3 100.000000 F00048 -20.000000 120.000000 FUNCTION_LIST EDK_Soll_Ist /end CHARACTERISTIC
/begin CHARACTERISTIC K_EDKSI_HYS_BL_AUF "" VALUE 0x27A8 CONST_3 100.000000 F00048 -20.000000 120.000000 FUNCTION_LIST EDK_Soll_Ist /end CHARACTERISTIC
/begin CHARACTERISTIC K_EDKSI_TMOT_N_GANZ "" VALUE 0x27AA CONST_0 100.000000 F00014 -48.000000 207.000000 FUNCTION_LIST EDK_Soll_Ist /end CHARACTERISTIC
/begin CHARACTERISTIC K_EDKSI_UB_N_GANZ "" VALUE 0x27AB CONST_0 100.000000 F00018 0.000000 20.000000 FUNCTION_LIST EDK_Soll_Ist /end CHARACTERISTIC
/begin CHARACTERISTIC K_EGAS_WDK_TAU "" VALUE 0x22A0 CONST_0 100.000000 F00058 0.000000 255.000000 FUNCTION_LIST EGAS /end CHARACTERISTIC
/begin CHARACTERISTIC K_EGAS_UBMIN "" VALUE 0x22A1 CONST_0 100.000000 F00018 0.000000 25.000000 FUNCTION_LIST EGAS /end CHARACTERISTIC
/begin CHARACTERISTIC K_EGAS_MAXKRAFT_DELTA "" VALUE 0x22A2 CONST_2 100.000000 F00048 0.000000 100.000000 FUNCTION_LIST EGAS /end CHARACTERISTIC
/begin CHARACTERISTIC K_EGAS_MAXKRAFT_T "" VALUE 0x22A4 CONST_0 100.000000 F00027 0.000000 2.000000 FUNCTION_LIST EGAS /end CHARACTERISTIC
/begin CHARACTERISTIC K_EGAS_MAXKRAFT_FAKTOR "" VALUE 0x22A5 CONST_0 100.000000 F00059 0.000000 4.000000 FUNCTION_LIST EGAS /end CHARACTERISTIC
/begin CHARACTERISTIC K_EVAN2_RAD "" VALUE 0x34EE CONST_1 100.000000 F00005 -360.000000 360.000000 FUNCTION_LIST Vanos /end CHARACTERISTIC
/begin CHARACTERISTIC K_EVAN2_OFFSET "" VALUE 0x34F0 CONST_3 100.000000 F00006 -20.000000 80.000000 FUNCTION_LIST Vanos /end CHARACTERISTIC
/begin CHARACTERISTIC K_EVAN2_N_OFF "" VALUE 0x34F2 CONST_2 100.000000 F00007 0.000000 10000.000000 FUNCTION_LIST Vanos /end CHARACTERISTIC
/begin CHARACTERISTIC K_EVAN2_IMPULS_MIN "" VALUE 0x34F4 CONST_2 100.000000 F00008 0.000000 210.000000 FUNCTION_LIST Vanos /end CHARACTERISTIC
/begin CHARACTERISTIC K_EVAN2_T_DRUCKAB "" VALUE 0x34F6 CONST_2 100.000000 F00009 0.000000 65.000000 FUNCTION_LIST Vanos /end CHARACTERISTIC
/begin CHARACTERISTIC K_EVAN2_SOLL_DICHT "" VALUE 0x34F8 CONST_1 100.000000 F00011 -20.000000 80.000000 FUNCTION_LIST Vanos /end CHARACTERISTIC
/begin CHARACTERISTIC K_EVAN2_DRUCK "" VALUE 0x34FA CONST_3 100.000000 F00006 -20.000000 80.000000 FUNCTION_LIST Vanos /end CHARACTERISTIC
/begin CHARACTERISTIC K_EVAN2_DRUCK_HYS "" VALUE 0x34FC CONST_3 100.000000 F00006 -20.000000 80.000000 FUNCTION_LIST Vanos /end CHARACTERISTIC
/begin CHARACTERISTIC K_EVAN2_REGLER_TAU "" VALUE 0x34FE CONST_0 100.000000 F00010 0.000000 25.000000 FUNCTION_LIST Vanos /end CHARACTERISTIC
/begin CHARACTERISTIC K_EVAN2_XD_REG_MIN "" VALUE 0x34FF CONST_0 100.000000 F00006 0.000000 25.000000 FUNCTION_LIST Vanos /end CHARACTERISTIC
/begin CHARACTERISTIC K_EVAN2_XD_MAX "" VALUE 0x3500 CONST_3 100.000000 F00006 -20.000000 80.000000 FUNCTION_LIST Vanos /end CHARACTERISTIC
/begin CHARACTERISTIC K_VAN2_REG_PAUSE "" VALUE 0x3502 CONST_0 100.000000 F00047 0.000000 255.000000 FUNCTION_LIST Vanos /end CHARACTERISTIC
/begin CHARACTERISTIC K_FR_IMIN "" VALUE 0x3780 CONST_3 100.000000 F00061 0.000000 1.000000 FUNCTION_LIST FUELLUNGSREGLER /end CHARACTERISTIC
/begin CHARACTERISTIC K_FR_IMAX "" VALUE 0x3782 CONST_3 100.000000 F00061 0.000000 1.000000 FUNCTION_LIST FUELLUNGSREGLER /end CHARACTERISTIC
/begin CHARACTERISTIC K_FR_EDK_DIFF "" VALUE 0x3784 CONST_2 100.000000 F00048 0.000000 100.000000 FUNCTION_LIST FUELLUNGSREGLER /end CHARACTERISTIC
/begin CHARACTERISTIC K_FR_DI_ENTDR "" VALUE 0x3786 CONST_2 100.000000 F00062 0.000000 5.000000 FUNCTION_LIST FUELLUNGSREGLER /end CHARACTERISTIC
/begin CHARACTERISTIC K_FR_ADAPT_TOL "" VALUE 0x37CC CONST_3 100.000000 F00063 0.000000 0.000000 FUNCTION_LIST FUELLUNGSREGLER /end CHARACTERISTIC
/begin CHARACTERISTIC K_FR_MLADAPT_OFFSET "" VALUE 0x37CE CONST_3 100.000000 F00064 -25.000000 25.000000 FUNCTION_LIST FUELLUNGSREGLER /end CHARACTERISTIC
/begin CHARACTERISTIC K_FR_TAU_ADAPT "" VALUE 0x37D0 CONST_2 100.000000 F00065 655.000000 0.000000 FUNCTION_LIST FUELLUNGSREGLER /end CHARACTERISTIC
/begin CHARACTERISTIC K_FR_DMLADAPT_MAX "" VALUE 0x37D2 CONST_3 100.000000 F00064 -25.000000 25.000000 FUNCTION_LIST FUELLUNGSREGLER /end CHARACTERISTIC
/begin CHARACTERISTIC K_FR_T_ADAPT "" VALUE 0x37D4 CONST_2 100.000000 F00066 0.000000 655.000000 FUNCTION_LIST FUELLUNGSREGLER /end CHARACTERISTIC
/begin CHARACTERISTIC K_FR_MLADAPT_MAX "" VALUE 0x37D6 CONST_3 100.000000 F00064 -25.000000 25.000000 FUNCTION_LIST FUELLUNGSREGLER /end CHARACTERISTIC
/begin CHARACTERISTIC K_FR_MLADAPT_MIN "" VALUE 0x37D8 CONST_3 100.000000 F00064 -25.000000 25.000000 FUNCTION_LIST FUELLUNGSREGLER /end CHARACTERISTIC
/begin CHARACTERISTIC K_FR_TMOT_ADAPT "" VALUE 0x37DA CONST_0 100.000000 F00014 -48.000000 207.000000 FUNCTION_LIST FUELLUNGSREGLER /end CHARACTERISTIC
/begin CHARACTERISTIC K_FRA_RF_FAKTOR "" VALUE 0x37DB CONST_0 100.000000 F00067 0.000000 2.000000 FUNCTION_LIST FUELLUNGSREGLER /end CHARACTERISTIC
/begin CHARACTERISTIC K_FRA_RF_ABREG "" VALUE 0x37DC CONST_2 100.000000 F00068 0.000000 2.000000 FUNCTION_LIST FUELLUNGSREGLER /end CHARACTERISTIC
/begin CHARACTERISTIC K_FRA_CONTROL "" VALUE 0x37DE CONST_0 100.000000 F00069 0.000000 255.000000 FUNCTION_LIST FUELLUNGSREGLER /end CHARACTERISTIC
/begin CHARACTERISTIC K_FGR_SV_FEST_AUF "" VALUE 0x260 CONST_2 100.000000 F00071 0.000000 102.000000 FUNCTION_LIST FGR /end CHARACTERISTIC
/begin CHARACTERISTIC K_FGR_WA_FEST_ASC "" VALUE 0x262 CONST_2 100.000000 F00071 0.000000 102.000000 FUNCTION_LIST FGR /end CHARACTERISTIC
/begin CHARACTERISTIC K_FGR_V_MIN "" VALUE 0x264 CONST_2 100.000000 F00072 0.000000 100.000000 FUNCTION_LIST FGR /end CHARACTERISTIC
/begin CHARACTERISTIC K_FGR_WA_FEST "" VALUE 0x266 CONST_2 100.000000 F00071 0.000000 102.000000 FUNCTION_LIST FGR /end CHARACTERISTIC
/begin CHARACTERISTIC K_FGR_V_INC_AMIN "" VALUE 0x268 CONST_2 100.000000 F00073 0.000000 63.000000 FUNCTION_LIST FGR /end CHARACTERISTIC
/begin CHARACTERISTIC K_FGR_VA_OFF_SB "" VALUE 0x26A CONST_2 100.000000 F00073 0.000000 63.000000 FUNCTION_LIST FGR /end CHARACTERISTIC
/begin CHARACTERISTIC K_FGR_TV_NORM "" VALUE 0x26C CONST_2 100.000000 F00074 0.000000 8192.000000 FUNCTION_LIST FGR /end CHARACTERISTIC
/begin CHARACTERISTIC K_FGR_V_DELTA_SV "" VALUE 0x26E CONST_2 100.000000 F00075 0.000000 409.000000 FUNCTION_LIST FGR /end CHARACTERISTIC
/begin CHARACTERISTIC K_FGR_V_INC_MAX "" VALUE 0x270 CONST_2 100.000000 F00076 0.000000 65535.000000 FUNCTION_LIST FGR /end CHARACTERISTIC
/begin CHARACTERISTIC K_FGR_V_INC_MAX_WA "" VALUE 0x272 CONST_2 100.000000 F00076 0.000000 65535.000000 FUNCTION_LIST FGR /end CHARACTERISTIC
/begin CHARACTERISTIC K_FGR_VA_OFF_WA "" VALUE 0x274 CONST_2 100.000000 F00073 0.000000 63.000000 FUNCTION_LIST FGR /end CHARACTERISTIC
/begin CHARACTERISTIC K_FGR_V_DELTA_DEL_WA "" VALUE 0x276 CONST_2 100.000000 F00075 0.000000 409.000000 FUNCTION_LIST FGR /end CHARACTERISTIC
/begin CHARACTERISTIC K_FGR_V_DELTA_ACC_TIPUP "" VALUE 0x278 CONST_2 100.000000 F00077 0.000000 41.000000 FUNCTION_LIST FGR /end CHARACTERISTIC
/begin CHARACTERISTIC K_FGR_V_DELTA_DEL_TIPDOWN "" VALUE 0x27A CONST_2 100.000000 F00077 0.000000 41.000000 FUNCTION_LIST FGR /end CHARACTERISTIC
/begin CHARACTERISTIC K_FGR_SB_NACHLAUF "" VALUE 0x27C CONST_2 100.000000 F00078 0.000000 1310.000000 FUNCTION_LIST FGR /end CHARACTERISTIC
/begin CHARACTERISTIC K_FGR_CONST_DRIV_TOL "" VALUE 0x27E CONST_2 100.000000 F00079 0.000000 4096.000000 FUNCTION_LIST FGR /end CHARACTERISTIC
/begin CHARACTERISTIC K_FGR_NV_ABW "" VALUE 0x280 CONST_2 100.000000 F00080 0.000000 255.000000 FUNCTION_LIST FGR /end CHARACTERISTIC
/begin CHARACTERISTIC K_FGR_SA "" VALUE 0x282 CONST_1 100.000000 F00081 -7.000000 7.000000 FUNCTION_LIST FGR /end CHARACTERISTIC
/begin CHARACTERISTIC K_FGR_TIP_ZEIT "" VALUE 0x283 CONST_0 100.000000 F00082 0.000000 5.000000 FUNCTION_LIST FGR /end CHARACTERISTIC
/begin CHARACTERISTIC K_FGR_ASC_CNT "" VALUE 0x284 CONST_0 100.000000 F00082 0.000000 5.000000 FUNCTION_LIST FGR /end CHARACTERISTIC
/begin CHARACTERISTIC K_FGR_V_TAU "" VALUE 0x285 CONST_0 100.000000 F00082 0.000000 5.000000 FUNCTION_LIST FGR /end CHARACTERISTIC
/begin CHARACTERISTIC K_FGR_MD_MAX "" VALUE 0x286 CONST_2 100.000000 F00071 0.000000 102.000000 FUNCTION_LIST FGR /end CHARACTERISTIC
/begin CHARACTERISTIC K_FGR_MD_MIN "" VALUE 0x288 CONST_2 100.000000 F00071 0.000000 102.000000 FUNCTION_LIST FGR /end CHARACTERISTIC
/begin CHARACTERISTIC K_FGR_FORMAT_ERROR "" VALUE 0x28A CONST_0 100.000000 F00013 0.000000 255.000000 FUNCTION_LIST FGR /end CHARACTERISTIC
/begin CHARACTERISTIC K_FGR_CODE_ERROR "" VALUE 0x28B CONST_0 100.000000 F00013 0.000000 255.000000 FUNCTION_LIST FGR /end CHARACTERISTIC
/begin CHARACTERISTIC K_FGR_HOLD_TIME "" VALUE 0x28C CONST_0 100.000000 F00083 0.000000 5100.000000 FUNCTION_LIST FGR /end CHARACTERISTIC
/begin CHARACTERISTIC K_FGR_TIMEOUT_MFL_LIM "" VALUE 0x28D CONST_0 100.000000 F00031 0.000000 255.000000 FUNCTION_LIST FGR /end CHARACTERISTIC
/begin CHARACTERISTIC K_FGR_CONFIG "" VALUE 0x28E CONST_0 100.000000 F00084 0.000000 255.000000 FUNCTION_LIST FGR /end CHARACTERISTIC
/begin CHARACTERISTIC K_FGR_DIA_SPE "" VALUE 0x290 CONST_2 100.000000 F00082 0.000000 1310.000000 FUNCTION_LIST FGR /end CHARACTERISTIC
/begin CHARACTERISTIC K_FGR_TIMEOUT_MFL "" VALUE 0x292 CONST_0 100.000000 F00031 0.000000 255.000000 FUNCTION_LIST FGR /end CHARACTERISTIC
/begin CHARACTERISTIC K_FGR_ABR_WERT "" VALUE 0x294 CONST_2 100.000000 F00071 0.000000 102.000000 FUNCTION_LIST FGR /end CHARACTERISTIC
/begin CHARACTERISTIC K_FGR_I_ANF "" VALUE 0x296 CONST_2 100.000000 F00071 0.000000 102.000000 FUNCTION_LIST FGR /end CHARACTERISTIC
/begin CHARACTERISTIC K_FGR_ABR_TAU "" VALUE 0x298 CONST_0 100.000000 F00013 0.000000 255.000000 FUNCTION_LIST FGR /end CHARACTERISTIC
/begin CHARACTERISTIC K_FGR_A_KOEF "" VALUE 0x29A CONST_2 100.000000 F00085 0.000000 2.000000 FUNCTION_LIST FGR /end CHARACTERISTIC
/begin CHARACTERISTIC K_FGR_NV_CFG "" VALUE 0x29C CONST_0 100.000000 F00013 0.000000 255.000000 FUNCTION_LIST FGR /end CHARACTERISTIC
/begin CHARACTERISTIC K_FGR_VERZ_KOEFF "" VALUE 0x29E CONST_2 100.000000 F00085 0.000000 2.000000 FUNCTION_LIST FGR /end CHARACTERISTIC
/begin CHARACTERISTIC K_FGR_P_FIL_TAU "" VALUE 0x2A0 CONST_0 100.000000 F00013 0.000000 255.000000 FUNCTION_LIST FGR /end CHARACTERISTIC
/begin CHARACTERISTIC K_FGR_DELTA_V_SBN "" VALUE 0x2A2 CONST_2 100.000000 F00081 0.000000 4095.000000 FUNCTION_LIST FGR /end CHARACTERISTIC
/begin CHARACTERISTIC K_FGR_DELTA_V_SV "" VALUE 0x2A4 CONST_2 100.000000 F00081 0.000000 4095.000000 FUNCTION_LIST FGR /end CHARACTERISTIC
/begin CHARACTERISTIC K_FGR_NMAX_OFFSET "" VALUE 0x2A6 CONST_2 100.000000 F00007 0.000000 10000.000000 FUNCTION_LIST FGR /end CHARACTERISTIC
/begin CHARACTERISTIC K_FGR_SB_FEST_S "" VALUE 0x2A8 CONST_2 100.000000 F00071 0.000000 102.000000 FUNCTION_LIST FGR /end CHARACTERISTIC
/begin CHARACTERISTIC K_FGR_P_MAX "" VALUE 0x2AA CONST_3 100.000000 F00071 -51.000000 51.000000 FUNCTION_LIST FGR /end CHARACTERISTIC
/begin CHARACTERISTIC K_FGR_P_MIN "" VALUE 0x2AC CONST_3 100.000000 F00071 -51.000000 51.000000 FUNCTION_LIST FGR /end CHARACTERISTIC
/begin CHARACTERISTIC K_FGR_SB_FEST "" VALUE 0x2AE CONST_2 100.000000 F00071 0.000000 102.000000 FUNCTION_LIST FGR /end CHARACTERISTIC
/begin CHARACTERISTIC K_FGR_ABF_DELTA "" VALUE 0x2B0 CONST_1 100.000000 F00081 -7.000000 7.000000 FUNCTION_LIST FGR /end CHARACTERISTIC
/begin CHARACTERISTIC K_FGR_REG_TIPTOL "" VALUE 0x2B2 CONST_3 100.000000 F00079 -2048.000000 2047.000000 FUNCTION_LIST FGR /end CHARACTERISTIC
/begin CHARACTERISTIC K_FGR_REG_TOL_NEG "" VALUE 0x2B4 CONST_3 100.000000 F00079 -2048.000000 2047.000000 FUNCTION_LIST FGR /end CHARACTERISTIC
/begin CHARACTERISTIC K_FGR_UEBERFAHR_TIME "" VALUE 0x2B6 CONST_2 100.000000 F00082 0.000000 1310.000000 FUNCTION_LIST FGR /end CHARACTERISTIC
/begin CHARACTERISTIC K_FGR_TOGGLETIME "" VALUE 0x2B8 CONST_0 100.000000 F00082 0.000000 5.000000 FUNCTION_LIST FGR /end CHARACTERISTIC
/begin CHARACTERISTIC K_FGR_WA_CONST_TOL "" VALUE 0x2BA CONST_2 100.000000 F00079 0.000000 4096.000000 FUNCTION_LIST FGR /end CHARACTERISTIC
/begin CHARACTERISTIC K_FGR_REG_POS_ERROR_TIME "" VALUE 0x2BC CONST_2 100.000000 F00082 0.000000 1310.000000 FUNCTION_LIST FGR /end CHARACTERISTIC
/begin CHARACTERISTIC K_FGR_REG_NEG_ERROR_TIME "" VALUE 0x2BE CONST_2 100.000000 F00082 0.000000 1310.000000 FUNCTION_LIST FGR /end CHARACTERISTIC
/begin CHARACTERISTIC K_FGR_SB_ABR_WERT "" VALUE 0x2C0 CONST_2 100.000000 F00071 0.000000 102.000000 FUNCTION_LIST FGR /end CHARACTERISTIC
/begin CHARACTERISTIC K_FGR_SB_ABR_TAU "" VALUE 0x368 CONST_0 100.000000 F00082 0.000000 5.000000 FUNCTION_LIST FGR /end CHARACTERISTIC
/begin CHARACTERISTIC K_FGR_SA_VERZ "" VALUE 0x369 CONST_1 100.000000 F00081 -7.000000 7.000000 FUNCTION_LIST FGR /end CHARACTERISTIC
/begin CHARACTERISTIC K_FGR_A_MAX "" VALUE 0x36A CONST_0 100.000000 F00086 0.000000 1.000000 FUNCTION_LIST FGR /end CHARACTERISTIC
/begin CHARACTERISTIC K_FGR_UEBER_HYST "" VALUE 0x36C CONST_2 100.000000 F00087 0.000000 100.000000 FUNCTION_LIST FGR /end CHARACTERISTIC
/begin CHARACTERISTIC K_FGR_KD_KOE "" VALUE 0x36E CONST_2 100.000000 F00071 0.000000 0.000000 FUNCTION_LIST FGR /end CHARACTERISTIC
/begin CHARACTERISTIC K_FGR_SV_FEST "" VALUE 0x370 CONST_2 100.000000 F00071 0.000000 102.000000 FUNCTION_LIST FGR /end CHARACTERISTIC
/begin CHARACTERISTIC K_MFL_UB "" VALUE 0x372 CONST_0 100.000000 F00018 0.000000 20.000000 FUNCTION_LIST FGR /end CHARACTERISTIC
/begin CHARACTERISTIC K_MFL_T_OFFSET "" VALUE 0x373 CONST_1 100.000000 F00088 -10.000000 10.000000 FUNCTION_LIST FGR /end CHARACTERISTIC
/begin CHARACTERISTIC K_FGR_V_MAX "" VALUE 0x374 CONST_2 100.000000 F00004 0.000000 360.000000 FUNCTION_LIST FGR /end CHARACTERISTIC
/begin CHARACTERISTIC K_FGR_RAMPE_DV "" VALUE 0x376 CONST_2 100.000000 F00079 0.000000 360.000000 FUNCTION_LIST FGR /end CHARACTERISTIC
/begin CHARACTERISTIC K_FGR_AQU_CNT "" VALUE 0x378 CONST_2 100.000000 F00082 0.000000 1310.000000 FUNCTION_LIST FGR /end CHARACTERISTIC
/begin CHARACTERISTIC K_FGR_ASCAUS_CNT "" VALUE 0x37A CONST_2 100.000000 F00082 0.000000 1310.000000 FUNCTION_LIST FGR /end CHARACTERISTIC
/begin CHARACTERISTIC K_FST_ABWEICHUNG "" VALUE 0x1D20 CONST_0 100.000000 F00091 0.000000 255.000000 FUNCTION_LIST Messwerte /end CHARACTERISTIC
/begin CHARACTERISTIC K_FST_VERBRAUCH "" VALUE 0x1D21 CONST_0 100.000000 F00091 0.000000 255.000000 FUNCTION_LIST Messwerte /end CHARACTERISTIC
/begin CHARACTERISTIC K_FST_NACHTANK "" VALUE 0x1D22 CONST_0 100.000000 F00091 0.000000 255.000000 FUNCTION_LIST Messwerte /end CHARACTERISTIC
/begin CHARACTERISTIC K_FST_VOLL "" VALUE 0x1D23 CONST_0 100.000000 F00091 0.000000 255.000000 FUNCTION_LIST Messwerte /end CHARACTERISTIC
/begin CHARACTERISTIC K_FST_VERBRAUCH_VOLL "" VALUE 0x1D24 CONST_0 100.000000 F00091 0.000000 255.000000 FUNCTION_LIST Messwerte /end CHARACTERISTIC
/begin CHARACTERISTIC K_GANG_GRENZE1_2 "" VALUE 0x362E CONST_0 100.000000 F00092 0.000000 127.000000 FUNCTION_LIST Gangerkennung /end CHARACTERISTIC
/begin CHARACTERISTIC K_GANG_GRENZE2_3 "" VALUE 0x362F CONST_0 100.000000 F00092 0.000000 127.000000 FUNCTION_LIST Gangerkennung /end CHARACTERISTIC
/begin CHARACTERISTIC K_GANG_GRENZE3_4 "" VALUE 0x3630 CONST_0 100.000000 F00092 0.000000 127.000000 FUNCTION_LIST Gangerkennung /end CHARACTERISTIC
/begin CHARACTERISTIC K_GANG_GRENZE4_5 "" VALUE 0x3631 CONST_0 100.000000 F00092 0.000000 127.000000 FUNCTION_LIST Gangerkennung /end CHARACTERISTIC
/begin CHARACTERISTIC K_GANG_GRENZE5_6 "" VALUE 0x3632 CONST_0 100.000000 F00092 0.000000 127.000000 FUNCTION_LIST Gangerkennung /end CHARACTERISTIC
/begin CHARACTERISTIC K_NOISE_PWG_SOLL "" VALUE 0x3633 CONST_0 100.000000 F00093 50.000000 100.000000 FUNCTION_LIST Gangerkennung /end CHARACTERISTIC
/begin CHARACTERISTIC K_NOISE_V_MIN1 "" VALUE 0x3634 CONST_2 100.000000 F00004 0.000000 360.000000 FUNCTION_LIST Gangerkennung /end CHARACTERISTIC
/begin CHARACTERISTIC K_NOISE_V_MAX1 "" VALUE 0x3636 CONST_2 100.000000 F00004 0.000000 360.000000 FUNCTION_LIST Gangerkennung /end CHARACTERISTIC
/begin CHARACTERISTIC K_NOISE_V_MIN2 "" VALUE 0x3638 CONST_2 100.000000 F00004 0.000000 360.000000 FUNCTION_LIST Gangerkennung /end CHARACTERISTIC
/begin CHARACTERISTIC K_NOISE_V_MAX2 "" VALUE 0x363A CONST_2 100.000000 F00004 0.000000 360.000000 FUNCTION_LIST Gangerkennung /end CHARACTERISTIC
/begin CHARACTERISTIC K_NOISE_V_MIN3 "" VALUE 0x363C CONST_2 100.000000 F00004 40.000000 60.000000 FUNCTION_LIST Gangerkennung /end CHARACTERISTIC
/begin CHARACTERISTIC K_NOISE_V_MAX3 "" VALUE 0x363E CONST_2 100.000000 F00004 40.000000 60.000000 FUNCTION_LIST Gangerkennung /end CHARACTERISTIC
/begin CHARACTERISTIC K_NOISE_T3 "" VALUE 0x3640 CONST_0 100.000000 F00017 0.000000 255.000000 FUNCTION_LIST Gangerkennung /end CHARACTERISTIC
/begin CHARACTERISTIC K_NOISE_CFG "" VALUE 0x3641 CONST_0 100.000000 F00094 0.000000 3.000000 FUNCTION_LIST Gangerkennung /end CHARACTERISTIC
/begin CHARACTERISTIC K_HFM_ML_INIT "" VALUE 0x200C CONST_0 100.000000 F00095 0.000000 60.000000 FUNCTION_LIST Lasterfassung /end CHARACTERISTIC
/begin CHARACTERISTIC K_HFM_RF_FILTER_D_ML "" VALUE 0x200E CONST_2 100.000000 F00096 0.000000 1400.000000 FUNCTION_LIST Lasterfassung /end CHARACTERISTIC
/begin CHARACTERISTIC K_HFM_ML_SEG_MIN "" VALUE 0x2010 CONST_2 100.000000 F00095 0.000000 1400.000000 FUNCTION_LIST Lasterfassung /end CHARACTERISTIC
/begin CHARACTERISTIC K_HFM_RF_FILTER_LL_V "" VALUE 0x2012 CONST_0 100.000000 F00004 0.000000 255.000000 FUNCTION_LIST Lasterfassung /end CHARACTERISTIC
/begin CHARACTERISTIC K_RF_DYN_TAU "" VALUE 0x2013 CONST_0 100.000000 F00024 5.000000 0.000000 FUNCTION_LIST Lasterfassung /end CHARACTERISTIC
/begin CHARACTERISTIC K_HFM_SAMPLE "" VALUE 0x2014 CONST_0 100.000000 F00031 0.000000 255.000000 FUNCTION_LIST Lasterfassung /end CHARACTERISTIC
/begin CHARACTERISTIC K_HFM_SEGMENTE "" VALUE 0x2015 CONST_0 100.000000 F00031 0.000000 255.000000 FUNCTION_LIST Lasterfassung /end CHARACTERISTIC
/begin CHARACTERISTIC K_HFM_RF_FILTER_BA "" VALUE 0x2016 CONST_2 100.000000 F00097 0.000000 2.000000 FUNCTION_LIST Lasterfassung /end CHARACTERISTIC
/begin CHARACTERISTIC K_HFM_TI_RATE "" VALUE 0x2018 CONST_2 100.000000 F00098 250.000000 0.000000 FUNCTION_LIST Lasterfassung /end CHARACTERISTIC
/begin CHARACTERISTIC K_HFM_ML_ERSATZ "" VALUE 0x201A CONST_2 100.000000 F00095 0.000000 1400.000000 FUNCTION_LIST Lasterfassung /end CHARACTERISTIC
/begin CHARACTERISTIC K_HFM_DIAG_ML_MAX "" VALUE 0x201C CONST_3 100.000000 F00095 -50.000000 1400.000000 FUNCTION_LIST Lasterfassung /end CHARACTERISTIC
/begin CHARACTERISTIC K_HFM_DIAG_ML_MIN "" VALUE 0x201E CONST_3 100.000000 F00095 -50.000000 1400.000000 FUNCTION_LIST Lasterfassung /end CHARACTERISTIC
/begin CHARACTERISTIC K_HFM_DIAG_OFFSET "" VALUE 0x2020 CONST_2 100.000000 F00095 0.000000 1400.000000 FUNCTION_LIST Lasterfassung /end CHARACTERISTIC
/begin CHARACTERISTIC K_HFM_DIAG_N_MIN "" VALUE 0x2022 CONST_2 100.000000 F00007 0.000000 10000.000000 FUNCTION_LIST Lasterfassung /end CHARACTERISTIC
/begin CHARACTERISTIC K_HFM_DIAG_N_MAX "" VALUE 0x2024 CONST_2 100.000000 F00007 0.000000 10000.000000 FUNCTION_LIST Lasterfassung /end CHARACTERISTIC
/begin CHARACTERISTIC K_HFM_DIAG_TMOT_MIN "" VALUE 0x2026 CONST_0 100.000000 F00014 -48.000000 207.000000 FUNCTION_LIST Lasterfassung /end CHARACTERISTIC
/begin CHARACTERISTIC K_HFM_DIAG_FAKTOR "" VALUE 0x2027 CONST_0 100.000000 F00099 0.000000 1.000000 FUNCTION_LIST Lasterfassung /end CHARACTERISTIC
/begin CHARACTERISTIC K_HFM_DIAG_F_IO "" VALUE 0x2028 CONST_0 100.000000 F00099 0.000000 1.000000 FUNCTION_LIST Lasterfassung /end CHARACTERISTIC
/begin CHARACTERISTIC K_HFM_DIAG_LA_MIN "" VALUE 0x202A CONST_2 100.000000 F00100 0.000000 2.000000 FUNCTION_LIST Lasterfassung /end CHARACTERISTIC
/begin CHARACTERISTIC K_HFM_DIAG_LA_MAX "" VALUE 0x202C CONST_2 100.000000 F00100 0.000000 2.000000 FUNCTION_LIST Lasterfassung /end CHARACTERISTIC
/begin CHARACTERISTIC K_HFM_DIAG_SPERRZEIT "" VALUE 0x202E CONST_0 100.000000 F00028 0.000000 25.000000 FUNCTION_LIST Lasterfassung /end CHARACTERISTIC
/begin CHARACTERISTIC K_HFM_ML_RUECK "" VALUE 0x2030 CONST_3 100.000000 F00095 -50.000000 1400.000000 FUNCTION_LIST Lasterfassung /end CHARACTERISTIC
/begin CHARACTERISTIC K_HFM_ML_RUECK_HYS "" VALUE 0x2032 CONST_2 100.000000 F00095 0.000000 1400.000000 FUNCTION_LIST Lasterfassung /end CHARACTERISTIC
/begin CHARACTERISTIC K_HFM_ML_DK_ZU "" VALUE 0x2034 CONST_2 100.000000 F00095 0.000000 1400.000000 FUNCTION_LIST Lasterfassung /end CHARACTERISTIC
/begin CHARACTERISTIC K_HFM_RF_START "" VALUE 0x2036 CONST_2 100.000000 F00068 0.000000 2.000000 FUNCTION_LIST Lasterfassung /end CHARACTERISTIC
/begin CHARACTERISTIC K_RF_DYN_DELTA_SLP "" VALUE 0x2038 CONST_2 100.000000 F00068 0.000000 2.000000 FUNCTION_LIST Lasterfassung /end CHARACTERISTIC
/begin CHARACTERISTIC K_RF_DYN_T_SLP "" VALUE 0x203A CONST_2 100.000000 F00082 0.000000 1310.000000 FUNCTION_LIST Lasterfassung /end CHARACTERISTIC
/begin CHARACTERISTIC K_RF_DYN_DELTA_TEFC "" VALUE 0x203C CONST_2 100.000000 F00068 0.000000 2.000000 FUNCTION_LIST Lasterfassung /end CHARACTERISTIC
/begin CHARACTERISTIC K_RF_DYN_T_TEFC "" VALUE 0x203E CONST_2 100.000000 F00082 0.000000 1310.000000 FUNCTION_LIST Lasterfassung /end CHARACTERISTIC
/begin CHARACTERISTIC K_RF_DYN_DELTA_KAT "" VALUE 0x2040 CONST_2 100.000000 F00068 0.000000 2.000000 FUNCTION_LIST Lasterfassung /end CHARACTERISTIC
/begin CHARACTERISTIC K_RF_DYN_T_KAT "" VALUE 0x2042 CONST_2 100.000000 F00082 0.000000 1310.000000 FUNCTION_LIST Lasterfassung /end CHARACTERISTIC
/begin CHARACTERISTIC K_RF_DYN_DELTA_LA "" VALUE 0x2044 CONST_2 100.000000 F00068 0.000000 2.000000 FUNCTION_LIST Lasterfassung /end CHARACTERISTIC
/begin CHARACTERISTIC K_RF_DYN_T_LA "" VALUE 0x2046 CONST_2 100.000000 F00082 0.000000 1310.000000 FUNCTION_LIST Lasterfassung /end CHARACTERISTIC
/begin CHARACTERISTIC K_RF_HUBVOLUMEN "" VALUE 0x2048 CONST_2 100.000000 F00101 0.000000 65.000000 FUNCTION_LIST Lasterfassung /end CHARACTERISTIC
/begin CHARACTERISTIC K_RF_LUFTDICHTE "" VALUE 0x204A CONST_2 100.000000 F00102 0.000000 65.000000 FUNCTION_LIST Lasterfassung /end CHARACTERISTIC
/begin CHARACTERISTIC K_KATH_NMAX "" VALUE 0x1AF4 CONST_2 100.000000 F00007 0.000000 10000.000000 FUNCTION_LIST Katheiz_Funktion /end CHARACTERISTIC
/begin CHARACTERISTIC K_KATH_RFMAX "" VALUE 0x1AF6 CONST_2 100.000000 F00068 0.000000 2.000000 FUNCTION_LIST Katheiz_Funktion /end CHARACTERISTIC
/begin CHARACTERISTIC K_KATH_VMAX "" VALUE 0x1AF8 CONST_2 100.000000 F00004 0.000000 360.000000 FUNCTION_LIST Katheiz_Funktion /end CHARACTERISTIC
/begin CHARACTERISTIC K_KATH_PWGMAX "" VALUE 0x1AFA CONST_2 100.000000 F00048 0.000000 100.000000 FUNCTION_LIST Katheiz_Funktion /end CHARACTERISTIC
/begin CHARACTERISTIC K_KATH_TKAT_ANSPRING "" VALUE 0x1AFC CONST_3 100.000000 F00015 -50.000000 1250.000000 FUNCTION_LIST Katheiz_Funktion /end CHARACTERISTIC
/begin CHARACTERISTIC K_KATH_TUMG_MIN "" VALUE 0x1AFE CONST_0 100.000000 F00014 -48.000000 207.000000 FUNCTION_LIST Katheiz_Funktion /end CHARACTERISTIC
/begin CHARACTERISTIC K_KATS_FST_MAX "" VALUE 0x1FEE CONST_0 100.000000 F00091 0.000000 255.000000 FUNCTION_LIST Katschutz /end CHARACTERISTIC
/begin CHARACTERISTIC K_KATS_FST_TI_ON_MAX "" VALUE 0x1FEF CONST_0 100.000000 F00091 0.000000 255.000000 FUNCTION_LIST Katschutz /end CHARACTERISTIC
/begin CHARACTERISTIC K_KATS_FETT_RAMPE "" VALUE 0x1FF0 CONST_0 100.000000 F00105 32.000000 0.000000 FUNCTION_LIST Katschutz /end CHARACTERISTIC
/begin CHARACTERISTIC K_KATS_TABG_MIN "" VALUE 0x1FF2 CONST_3 100.000000 F00015 -50.000000 1250.000000 FUNCTION_LIST Katschutz /end CHARACTERISTIC
/begin CHARACTERISTIC K_KATS_TMOT_MIN "" VALUE 0x1FF4 CONST_0 100.000000 F00014 -48.000000 207.000000 FUNCTION_LIST Katschutz /end CHARACTERISTIC
/begin CHARACTERISTIC K_KATS_NMAX_DELTA "" VALUE 0x1FF6 CONST_3 100.000000 F00007 -10000.000000 10000.000000 FUNCTION_LIST Katschutz /end CHARACTERISTIC
/begin CHARACTERISTIC K_KA_BEGRENZ "" VALUE 0x1130 CONST_0 100.000000 F00110 0.000000 1.000000 FUNCTION_LIST Klopfen /end CHARACTERISTIC
/begin CHARACTERISTIC K_KA_TREPP_FAK "" VALUE 0x1131 CONST_0 100.000000 F00003 0.000000 1.000000 FUNCTION_LIST Klopfen /end CHARACTERISTIC
/begin CHARACTERISTIC K_KA_FILT_KK_KKA "" VALUE 0x1134 CONST_2 100.000000 F00111 0.000000 1.000000 FUNCTION_LIST Klopfen /end CHARACTERISTIC
/begin CHARACTERISTIC K_KA_FILT_KK_KA "" VALUE 0x1136 CONST_2 100.000000 F00111 0.000000 1.000000 FUNCTION_LIST Klopfen /end CHARACTERISTIC
/begin CHARACTERISTIC K_KA_FILT_LK "" VALUE 0x1138 CONST_2 100.000000 F00111 0.000000 1.000000 FUNCTION_LIST Klopfen /end CHARACTERISTIC
/begin CHARACTERISTIC K_KA_FILT_SK "" VALUE 0x113A CONST_2 100.000000 F00111 0.000000 1.000000 FUNCTION_LIST Klopfen /end CHARACTERISTIC
/begin CHARACTERISTIC K_KA_TZ_KS "" VALUE 0x113C CONST_0 100.000000 F00045 0.000000 25.000000 FUNCTION_LIST Klopfen /end CHARACTERISTIC
/begin CHARACTERISTIC K_KA_ADAP_MIN "" VALUE 0x113D CONST_0 100.000000 F00112 0.000000 -25.000000 FUNCTION_LIST Klopfen /end CHARACTERISTIC
/begin CHARACTERISTIC K_KA_ADAP_MAX "" VALUE 0x113E CONST_0 100.000000 F00039 0.000000 25.000000 FUNCTION_LIST Klopfen /end CHARACTERISTIC
/begin CHARACTERISTIC K_KA_DA_AUS "" VALUE 0x113F CONST_0 100.000000 F00113 0.000000 255.000000 FUNCTION_LIST Klopfen /end CHARACTERISTIC
/begin CHARACTERISTIC K_KA_DA_SHFT "" VALUE 0x1140 CONST_0 100.000000 F00013 0.000000 8.000000 FUNCTION_LIST Klopfen /end CHARACTERISTIC
/begin CHARACTERISTIC K_KA_CAN_AUS "" VALUE 0x1141 CONST_0 100.000000 F00114 0.000000 255.000000 FUNCTION_LIST Klopfen /end CHARACTERISTIC
/begin CHARACTERISTIC K_KD_KWICHT_DYN "" VALUE 0xBEA CONST_0 100.000000 F00003 0.000000 3.000000 FUNCTION_LIST Klopfen /end CHARACTERISTIC
/begin CHARACTERISTIC K_KD_QUELLE "" VALUE 0xBEB CONST_0 100.000000 F00118 0.000000 4.000000 FUNCTION_LIST Klopfen /end CHARACTERISTIC
/begin CHARACTERISTIC K_KD_CFG_STAT "" VALUE 0xBEC CONST_0 100.000000 F00013 0.000000 1.000000 FUNCTION_LIST Klopfen /end CHARACTERISTIC
/begin CHARACTERISTIC K_KKOS_ELU_TMOT "" VALUE 0x34C2 CONST_0 100.000000 F00014 -48.000000 207.000000 FUNCTION_LIST Klimaanlage /end CHARACTERISTIC
/begin CHARACTERISTIC K_KKOS_TMOT_MAX "" VALUE 0x34C3 CONST_0 100.000000 F00014 -48.000000 207.000000 FUNCTION_LIST Klimaanlage /end CHARACTERISTIC
/begin CHARACTERISTIC K_KKOS_TMOT_HYS "" VALUE 0x34C4 CONST_0 100.000000 F00015 0.000000 255.000000 FUNCTION_LIST Klimaanlage /end CHARACTERISTIC
/begin CHARACTERISTIC K_KKOS_N_MAX "" VALUE 0x34C6 CONST_2 100.000000 F00007 0.000000 10000.000000 FUNCTION_LIST Klimaanlage /end CHARACTERISTIC
/begin CHARACTERISTIC K_KKOS_N_MAX_HYS "" VALUE 0x34C8 CONST_2 100.000000 F00007 0.000000 10000.000000 FUNCTION_LIST Klimaanlage /end CHARACTERISTIC
/begin CHARACTERISTIC K_KKOS_BEREIT "" VALUE 0x34CA CONST_0 100.000000 F00017 0.000000 255.000000 FUNCTION_LIST Klimaanlage /end CHARACTERISTIC
/begin CHARACTERISTIC K_KKOS_T_ERKENN "" VALUE 0x34CB CONST_0 100.000000 F00028 0.000000 25.000000 FUNCTION_LIST Klimaanlage /end CHARACTERISTIC
/begin CHARACTERISTIC K_KKOS_TIME_BA_VL_TRIGGER "" VALUE 0x34CC CONST_0 100.000000 F00017 0.000000 255.000000 FUNCTION_LIST Klimaanlage /end CHARACTERISTIC
/begin CHARACTERISTIC K_KKOS_TIME_BA_VL "" VALUE 0x34CD CONST_0 100.000000 F00017 0.000000 255.000000 FUNCTION_LIST Klimaanlage /end CHARACTERISTIC
/begin CHARACTERISTIC K_KKOS_VL_V "" VALUE 0x34CE CONST_0 100.000000 F00004 0.000000 255.000000 FUNCTION_LIST Klimaanlage /end CHARACTERISTIC
/begin CHARACTERISTIC K_KKOS_BA_V "" VALUE 0x34CF CONST_0 100.000000 F00004 0.000000 255.000000 FUNCTION_LIST Klimaanlage /end CHARACTERISTIC
/begin CHARACTERISTIC K_KKOS_DTL "" VALUE 0x34D0 CONST_0 100.000000 F00119 0.000000 2.000000 FUNCTION_LIST Klimaanlage /end CHARACTERISTIC
/begin CHARACTERISTIC K_KKOS_N "" VALUE 0x34D1 CONST_0 100.000000 F00109 0.000000 10000.000000 FUNCTION_LIST Klimaanlage /end CHARACTERISTIC
/begin CHARACTERISTIC K_KM_FEN_VIRT_ENABLE "" VALUE 0xA68 CONST_0 100.000000 F00121 0.000000 1.000000 FUNCTION_LIST Klopfen /end CHARACTERISTIC
/begin CHARACTERISTIC K_KM_DWDK_MIN "" VALUE 0xA69 CONST_0 100.000000 F00040 0.000000 1275.000000 FUNCTION_LIST Klopfen /end CHARACTERISTIC
/begin CHARACTERISTIC K_KM_N_MAX "" VALUE 0xA6A CONST_2 100.000000 F00007 0.000000 10000.000000 FUNCTION_LIST Klopfen /end CHARACTERISTIC
/begin CHARACTERISTIC K_KM_AVAN_HYS_OFFSET "" VALUE 0xA6C CONST_0 100.000000 F00006 0.000000 25.000000 FUNCTION_LIST Klopfen /end CHARACTERISTIC
/begin CHARACTERISTIC K_KM_RF_FEN_SCHIEB "" VALUE 0xA6E CONST_2 100.000000 F00068 0.000000 2.000000 FUNCTION_LIST Klopfen /end CHARACTERISTIC
/begin CHARACTERISTIC K_KM_N_FEN_SCHIEB "" VALUE 0xA70 CONST_2 100.000000 F00007 0.000000 10000.000000 FUNCTION_LIST Klopfen /end CHARACTERISTIC
/begin CHARACTERISTIC K_KM_N_FEN_HYS_SCHIEB "" VALUE 0xA72 CONST_2 100.000000 F00007 0.000000 10000.000000 FUNCTION_LIST Klopfen /end CHARACTERISTIC
/begin CHARACTERISTIC K_KM_UMIN_HIP "" VALUE 0xA74 CONST_0 100.000000 F00122 0.000000 4.000000 FUNCTION_LIST Klopfen /end CHARACTERISTIC
/begin CHARACTERISTIC K_KM_UMAX_HIP "" VALUE 0xA75 CONST_0 100.000000 F00122 0.000000 4.000000 FUNCTION_LIST Klopfen /end CHARACTERISTIC
/begin CHARACTERISTIC K_KM_AD_OFFSET "" VALUE 0xA76 CONST_0 100.000000 F00123 0.000000 1.000000 FUNCTION_LIST Klopfen /end CHARACTERISTIC
/begin CHARACTERISTIC K_KM_CFG_STAT "" VALUE 0xA77 CONST_0 100.000000 F00013 0.000000 1.000000 FUNCTION_LIST Klopfen /end CHARACTERISTIC
/begin CHARACTERISTIC K_KM_START_DELAY "" VALUE 0xA78 CONST_0 100.000000 F00124 1.000000 40.000000 FUNCTION_LIST Klopfen /end CHARACTERISTIC
/begin CHARACTERISTIC K_KM_FHIP_INIT "" VALUE 0xA79 CONST_0 100.000000 F00125 1.000000 18.000000 FUNCTION_LIST Klopfen /end CHARACTERISTIC
/begin CHARACTERISTIC K_KM_IHIP_INIT "" VALUE 0xA7A CONST_0 100.000000 F00126 41.000000 561.000000 FUNCTION_LIST Klopfen /end CHARACTERISTIC
/begin CHARACTERISTIC K_KM_FHIP_DIAG "" VALUE 0xA7B CONST_0 100.000000 F00125 1.000000 18.000000 FUNCTION_LIST Klopfen /end CHARACTERISTIC
/begin CHARACTERISTIC K_KM_GHIP_DIAG "" VALUE 0xA7C CONST_0 100.000000 F00127 1.000000 0.000000 FUNCTION_LIST Klopfen /end CHARACTERISTIC
/begin CHARACTERISTIC K_KM_FENSTER_A_FAK "" VALUE 0xA7D CONST_0 100.000000 F00085 0.000000 0.000000 FUNCTION_LIST Klopfen /end CHARACTERISTIC
/begin CHARACTERISTIC K_KM_DIAG_MIN "" VALUE 0xA7E CONST_2 100.000000 F00031 0.000000 1023.000000 FUNCTION_LIST Klopfen /end CHARACTERISTIC
/begin CHARACTERISTIC K_KM_DIAG_MAX "" VALUE 0xA80 CONST_2 100.000000 F00031 0.000000 1023.000000 FUNCTION_LIST Klopfen /end CHARACTERISTIC
/begin CHARACTERISTIC K_KM_DIAG_NMIN "" VALUE 0xA82 CONST_2 100.000000 F00007 600.000000 10000.000000 FUNCTION_LIST Klopfen /end CHARACTERISTIC
/begin CHARACTERISTIC K_KM_DIAG_RFMIN "" VALUE 0xA84 CONST_2 100.000000 F00068 0.000000 2.000000 FUNCTION_LIST Klopfen /end CHARACTERISTIC
/begin CHARACTERISTIC K_KM_DIAG_INTER "" VALUE 0xA86 CONST_0 100.000000 F00028 0.000000 10.000000 FUNCTION_LIST Klopfen /end CHARACTERISTIC
/begin CHARACTERISTIC K_KM_DREH_HYST "" VALUE 0xA87 CONST_0 100.000000 F00128 0.000000 800.000000 FUNCTION_LIST Klopfen /end CHARACTERISTIC
/begin CHARACTERISTIC K_KM_DIAG_TMOT "" VALUE 0xA88 CONST_0 100.000000 F00014 -48.000000 207.000000 FUNCTION_LIST Klopfen /end CHARACTERISTIC
/begin CHARACTERISTIC K_KM_FDSP[1of4] "" VALUE 0xA8A CONST_0 100.000000 F00129 0.000000 49.000000 FUNCTION_LIST Klopfen /end CHARACTERISTIC
/begin CHARACTERISTIC K_KM_FDSP[2of4] "" VALUE 0xA8B CONST_0 100.000000 F00129 0.000000 49.000000 FUNCTION_LIST Klopfen /end CHARACTERISTIC
/begin CHARACTERISTIC K_KM_FDSP[3of4] "" VALUE 0xA8C CONST_0 100.000000 F00129 0.000000 49.000000 FUNCTION_LIST Klopfen /end CHARACTERISTIC
/begin CHARACTERISTIC K_KM_FDSP[4of4] "" VALUE 0xA8D CONST_0 100.000000 F00129 0.000000 49.000000 FUNCTION_LIST Klopfen /end CHARACTERISTIC
/begin CHARACTERISTIC K_KM_SIM_KG[1of8] "" VALUE 0xA8E CONST_0 100.000000 F00045 0.000000 25.000000 FUNCTION_LIST Klopfen /end CHARACTERISTIC
/begin CHARACTERISTIC K_KM_SIM_KG[2of8] "" VALUE 0xA8F CONST_0 100.000000 F00045 0.000000 25.000000 FUNCTION_LIST Klopfen /end CHARACTERISTIC
/begin CHARACTERISTIC K_KM_SIM_KG[3of8] "" VALUE 0xA90 CONST_0 100.000000 F00045 0.000000 25.000000 FUNCTION_LIST Klopfen /end CHARACTERISTIC
/begin CHARACTERISTIC K_KM_SIM_KG[4of8] "" VALUE 0xA91 CONST_0 100.000000 F00045 0.000000 25.000000 FUNCTION_LIST Klopfen /end CHARACTERISTIC
/begin CHARACTERISTIC K_KM_SIM_KG[5of8] "" VALUE 0xA92 CONST_0 100.000000 F00045 0.000000 25.000000 FUNCTION_LIST Klopfen /end CHARACTERISTIC
/begin CHARACTERISTIC K_KM_SIM_KG[6of8] "" VALUE 0xA93 CONST_0 100.000000 F00045 0.000000 25.000000 FUNCTION_LIST Klopfen /end CHARACTERISTIC
/begin CHARACTERISTIC K_KM_SIM_KG[7of8] "" VALUE 0xA94 CONST_0 100.000000 F00045 0.000000 25.000000 FUNCTION_LIST Klopfen /end CHARACTERISTIC
/begin CHARACTERISTIC K_KM_SIM_KG[8of8] "" VALUE 0xA95 CONST_0 100.000000 F00045 0.000000 25.000000 FUNCTION_LIST Klopfen /end CHARACTERISTIC
/begin CHARACTERISTIC K_KM_SIM_KW "" VALUE 0xA96 CONST_0 100.000000 F00130 0.000000 100.000000 FUNCTION_LIST Klopfen /end CHARACTERISTIC
/begin CHARACTERISTIC K_KR_TMOT_MIN "" VALUE 0x106A CONST_0 100.000000 F00014 -48.000000 207.000000 FUNCTION_LIST Klopfen /end CHARACTERISTIC
/begin CHARACTERISTIC K_KR_FILT "" VALUE 0x106B CONST_0 100.000000 F00133 1.000000 0.000000 FUNCTION_LIST Klopfen /end CHARACTERISTIC
/begin CHARACTERISTIC K_KR_APPL_PER "" VALUE 0x106C CONST_0 100.000000 F00013 0.000000 255.000000 FUNCTION_LIST Klopfen /end CHARACTERISTIC
/begin CHARACTERISTIC K_KR_APPL_NUM[1of8] "" VALUE 0x106E CONST_0 100.000000 F00013 0.000000 255.000000 FUNCTION_LIST Klopfen /end CHARACTERISTIC
/begin CHARACTERISTIC K_KR_APPL_NUM[2of8] "" VALUE 0x106F CONST_0 100.000000 F00013 0.000000 255.000000 FUNCTION_LIST Klopfen /end CHARACTERISTIC
/begin CHARACTERISTIC K_KR_APPL_NUM[3of8] "" VALUE 0x1070 CONST_0 100.000000 F00013 0.000000 255.000000 FUNCTION_LIST Klopfen /end CHARACTERISTIC
/begin CHARACTERISTIC K_KR_APPL_NUM[4of8] "" VALUE 0x1071 CONST_0 100.000000 F00013 0.000000 255.000000 FUNCTION_LIST Klopfen /end CHARACTERISTIC
/begin CHARACTERISTIC K_KR_APPL_NUM[5of8] "" VALUE 0x1072 CONST_0 100.000000 F00013 0.000000 255.000000 FUNCTION_LIST Klopfen /end CHARACTERISTIC
/begin CHARACTERISTIC K_KR_APPL_NUM[6of8] "" VALUE 0x1073 CONST_0 100.000000 F00013 0.000000 255.000000 FUNCTION_LIST Klopfen /end CHARACTERISTIC
/begin CHARACTERISTIC K_KR_APPL_NUM[7of8] "" VALUE 0x1074 CONST_0 100.000000 F00013 0.000000 255.000000 FUNCTION_LIST Klopfen /end CHARACTERISTIC
/begin CHARACTERISTIC K_KR_APPL_NUM[8of8] "" VALUE 0x1075 CONST_0 100.000000 F00013 0.000000 255.000000 FUNCTION_LIST Klopfen /end CHARACTERISTIC
/begin CHARACTERISTIC K_KR_APPL_DTZ[1of8] "" VALUE 0x1076 CONST_0 100.000000 F00045 0.000000 25.000000 FUNCTION_LIST Klopfen /end CHARACTERISTIC
/begin CHARACTERISTIC K_KR_APPL_DTZ[2of8] "" VALUE 0x1077 CONST_0 100.000000 F00045 0.000000 25.000000 FUNCTION_LIST Klopfen /end CHARACTERISTIC
/begin CHARACTERISTIC K_KR_APPL_DTZ[3of8] "" VALUE 0x1078 CONST_0 100.000000 F00045 0.000000 25.000000 FUNCTION_LIST Klopfen /end CHARACTERISTIC
/begin CHARACTERISTIC K_KR_APPL_DTZ[4of8] "" VALUE 0x1079 CONST_0 100.000000 F00045 0.000000 25.000000 FUNCTION_LIST Klopfen /end CHARACTERISTIC
/begin CHARACTERISTIC K_KR_APPL_DTZ[5of8] "" VALUE 0x107A CONST_0 100.000000 F00045 0.000000 25.000000 FUNCTION_LIST Klopfen /end CHARACTERISTIC
/begin CHARACTERISTIC K_KR_APPL_DTZ[6of8] "" VALUE 0x107B CONST_0 100.000000 F00045 0.000000 25.000000 FUNCTION_LIST Klopfen /end CHARACTERISTIC
/begin CHARACTERISTIC K_KR_APPL_DTZ[7of8] "" VALUE 0x107C CONST_0 100.000000 F00045 0.000000 25.000000 FUNCTION_LIST Klopfen /end CHARACTERISTIC
/begin CHARACTERISTIC K_KR_APPL_DTZ[8of8] "" VALUE 0x107D CONST_0 100.000000 F00045 0.000000 25.000000 FUNCTION_LIST Klopfen /end CHARACTERISTIC
/begin CHARACTERISTIC K_KR_APPL_ENABLE "" VALUE 0x107E CONST_0 100.000000 F00013 0.000000 1.000000 FUNCTION_LIST Klopfen /end CHARACTERISTIC
/begin CHARACTERISTIC K_KR_DTZ_MAX "" VALUE 0x107F CONST_0 100.000000 F00045 0.000000 25.000000 FUNCTION_LIST Klopfen /end CHARACTERISTIC
/begin CHARACTERISTIC K_KR_DTZ_MAX_DYN "" VALUE 0x1080 CONST_0 100.000000 F00045 0.000000 25.000000 FUNCTION_LIST Klopfen /end CHARACTERISTIC
/begin CHARACTERISTIC K_LDPH_CFG "" VALUE 0x352A CONST_0 100.000000 F00135 0.000000 255.000000 FUNCTION_LIST Tankleckdiagnose /end CHARACTERISTIC
/begin CHARACTERISTIC K_LFR_NSOLL_SK "" VALUE 0x390 CONST_2 100.000000 F00007 0.000000 10000.000000 FUNCTION_LIST LEERLAUFREGLER /end CHARACTERISTIC
/begin CHARACTERISTIC K_LFR_NSOLL_AC "" VALUE 0x3C6 CONST_2 100.000000 F00007 0.000000 10000.000000 FUNCTION_LIST LEERLAUFREGLER /end CHARACTERISTIC
/begin CHARACTERISTIC K_LFR_TAU_IA2_KS "" VALUE 0x3CA CONST_0 100.000000 F00136 5.000000 0.000000 FUNCTION_LIST LEERLAUFREGLER /end CHARACTERISTIC
/begin CHARACTERISTIC K_LFR_DN_EINGEREGELT "" VALUE 0x3CB CONST_0 100.000000 F00007 0.000000 255.000000 FUNCTION_LIST LEERLAUFREGLER /end CHARACTERISTIC
/begin CHARACTERISTIC K_LFR_DELTA_N_ZYKLUS "" VALUE 0x3CC CONST_2 100.000000 F00137 0.000000 5000.000000 FUNCTION_LIST LEERLAUFREGLER /end CHARACTERISTIC
/begin CHARACTERISTIC K_LFR_T_SEIT_START "" VALUE 0x3CE CONST_2 100.000000 F00028 0.000000 6553.000000 FUNCTION_LIST LEERLAUFREGLER /end CHARACTERISTIC
/begin CHARACTERISTIC K_LFR_V_MAX "" VALUE 0x414 CONST_0 100.000000 F00076 0.000000 255.000000 FUNCTION_LIST LEERLAUFREGLER /end CHARACTERISTIC
/begin CHARACTERISTIC K_LFR_T_FBR "" VALUE 0x415 CONST_0 100.000000 F00138 0.000000 5.000000 FUNCTION_LIST LEERLAUFREGLER /end CHARACTERISTIC
/begin CHARACTERISTIC K_LFR_MDREG_MIN "" VALUE 0x416 CONST_3 100.000000 F00139 -100.000000 0.000000 FUNCTION_LIST LEERLAUFREGLER /end CHARACTERISTIC
/begin CHARACTERISTIC K_LFR_MDREG_MAX "" VALUE 0x418 CONST_3 100.000000 F00139 0.000000 100.000000 FUNCTION_LIST LEERLAUFREGLER /end CHARACTERISTIC
/begin CHARACTERISTIC K_LFR_TAU_IA1 "" VALUE 0x41A CONST_0 100.000000 F00136 5.000000 0.000000 FUNCTION_LIST LEERLAUFREGLER /end CHARACTERISTIC
/begin CHARACTERISTIC K_LFR_TAU_IA2_KKS "" VALUE 0x41B CONST_0 100.000000 F00136 5.000000 0.000000 FUNCTION_LIST LEERLAUFREGLER /end CHARACTERISTIC
/begin CHARACTERISTIC K_LFR_NDIFF_RESET "" VALUE 0x41C CONST_2 100.000000 F00007 0.000000 10000.000000 FUNCTION_LIST LEERLAUFREGLER /end CHARACTERISTIC
/begin CHARACTERISTIC K_LFR_NDIFF_POS "" VALUE 0x41E CONST_2 100.000000 F00007 0.000000 10000.000000 FUNCTION_LIST LEERLAUFREGLER /end CHARACTERISTIC
/begin CHARACTERISTIC K_LFR_UEW_MAX "" VALUE 0x432 CONST_3 100.000000 F00140 0.000000 50.000000 FUNCTION_LIST LEERLAUFREGLER /end CHARACTERISTIC
/begin CHARACTERISTIC K_LFR_EGAS_ABW "" VALUE 0x434 CONST_3 100.000000 F00048 0.000000 100.000000 FUNCTION_LIST LEERLAUFREGLER /end CHARACTERISTIC
/begin CHARACTERISTIC K_LFR_CONTROL "" VALUE 0x436 CONST_0 100.000000 F00141 0.000000 255.000000 FUNCTION_LIST LEERLAUFREGLER /end CHARACTERISTIC
/begin CHARACTERISTIC K_LFR_DN_HYS "" VALUE 0x6B4 CONST_3 100.000000 F00142 -10000.000000 10000.000000 FUNCTION_LIST LEERLAUFREGLER /end CHARACTERISTIC
/begin CHARACTERISTIC K_LFR_DIAFR_ABR "" VALUE 0x6B6 CONST_3 100.000000 F00139 0.000000 100.000000 FUNCTION_LIST LEERLAUFREGLER /end CHARACTERISTIC
/begin CHARACTERISTIC K_LFR_NDIFF_AUF "" VALUE 0x6B8 CONST_0 100.000000 F00007 0.000000 255.000000 FUNCTION_LIST LEERLAUFREGLER /end CHARACTERISTIC
/begin CHARACTERISTIC K_LFR_MDADAPT_OFFSET "" VALUE 0x6BA CONST_3 100.000000 F00143 -50.000000 50.000000 FUNCTION_LIST LEERLAUFREGLER /end CHARACTERISTIC
/begin CHARACTERISTIC K_LFR_TAU_ADAPT "" VALUE 0x6BC CONST_2 100.000000 F00144 1310.000000 0.000000 FUNCTION_LIST LEERLAUFREGLER /end CHARACTERISTIC
/begin CHARACTERISTIC K_LFR_DMDADAPT_MAX "" VALUE 0x6BE CONST_3 100.000000 F00143 -10.000000 10.000000 FUNCTION_LIST LEERLAUFREGLER /end CHARACTERISTIC
/begin CHARACTERISTIC K_LFR_T_ADAPT "" VALUE 0x6C0 CONST_2 100.000000 F00138 0.000000 1310.000000 FUNCTION_LIST LEERLAUFREGLER /end CHARACTERISTIC
/begin CHARACTERISTIC K_LFR_MDADAPT_MAX "" VALUE 0x6C2 CONST_3 100.000000 F00143 0.000000 50.000000 FUNCTION_LIST LEERLAUFREGLER /end CHARACTERISTIC
/begin CHARACTERISTIC K_LFR_MDADAPT_MIN "" VALUE 0x6C4 CONST_3 100.000000 F00143 -50.000000 0.000000 FUNCTION_LIST LEERLAUFREGLER /end CHARACTERISTIC
/begin CHARACTERISTIC K_LFR_MDADAPT_KO_MAX "" VALUE 0x6C6 CONST_3 100.000000 F00143 0.000000 50.000000 FUNCTION_LIST LEERLAUFREGLER /end CHARACTERISTIC
/begin CHARACTERISTIC K_LFR_MDADAPT_KO_MIN "" VALUE 0x6C8 CONST_3 100.000000 F00143 -50.000000 0.000000 FUNCTION_LIST LEERLAUFREGLER /end CHARACTERISTIC
/begin CHARACTERISTIC K_LFR_TMOT_ADAPT "" VALUE 0x6CA CONST_0 100.000000 F00014 -48.000000 207.000000 FUNCTION_LIST LEERLAUFREGLER /end CHARACTERISTIC
/begin CHARACTERISTIC K_LFR_ED_MDREG_MIN "" VALUE 0x6CC CONST_3 100.000000 F00139 -100.000000 0.000000 FUNCTION_LIST LEERLAUFREGLER /end CHARACTERISTIC
/begin CHARACTERISTIC K_LFR_ED_MDREG_MAX "" VALUE 0x6CE CONST_3 100.000000 F00139 0.000000 100.000000 FUNCTION_LIST LEERLAUFREGLER /end CHARACTERISTIC
/begin CHARACTERISTIC K_LFR_MD_TZ_MIN "" VALUE 0x6D0 CONST_2 100.000000 F00145 0.000000 100.000000 FUNCTION_LIST LEERLAUFREGLER /end CHARACTERISTIC
/begin CHARACTERISTIC K_LFROBD_MX_FILTER "" VALUE 0x6E0 CONST_2 100.000000 F00082 0.000000 1310.000000 FUNCTION_LIST LEERLAUFREGLER /end CHARACTERISTIC
/begin CHARACTERISTIC K_LFROBD_MN_FILTER "" VALUE 0x6E2 CONST_2 100.000000 F00082 0.000000 1310.000000 FUNCTION_LIST LEERLAUFREGLER /end CHARACTERISTIC
/begin CHARACTERISTIC K_LFROBD_DMO "" VALUE 0x6E4 CONST_3 100.000000 F00145 -1000.000000 1000.000000 FUNCTION_LIST LEERLAUFREGLER /end CHARACTERISTIC
/begin CHARACTERISTIC K_LFROBD_DMU "" VALUE 0x6E6 CONST_3 100.000000 F00145 -1000.000000 1000.000000 FUNCTION_LIST LEERLAUFREGLER /end CHARACTERISTIC
/begin CHARACTERISTIC K_LFROBD_DNO "" VALUE 0x6E8 CONST_3 100.000000 F00142 -10000.000000 10000.000000 FUNCTION_LIST LEERLAUFREGLER /end CHARACTERISTIC
/begin CHARACTERISTIC K_LFROBD_DNU "" VALUE 0x6EA CONST_3 100.000000 F00142 -10000.000000 10000.000000 FUNCTION_LIST LEERLAUFREGLER /end CHARACTERISTIC
/begin CHARACTERISTIC K_LFROBD_RF "" VALUE 0x6EC CONST_2 100.000000 F00068 0.000000 2.000000 FUNCTION_LIST LEERLAUFREGLER /end CHARACTERISTIC
/begin CHARACTERISTIC K_LFROBD_DASA "" VALUE 0x6EE CONST_0 100.000000 F00013 0.000000 255.000000 FUNCTION_LIST LEERLAUFREGLER /end CHARACTERISTIC
/begin CHARACTERISTIC K_LFROBD_TMIN "" VALUE 0x6EF CONST_0 100.000000 F00014 -48.000000 207.000000 FUNCTION_LIST LEERLAUFREGLER /end CHARACTERISTIC
/begin CHARACTERISTIC K_LFROBD_TMAX "" VALUE 0x6F0 CONST_0 100.000000 F00014 -48.000000 207.000000 FUNCTION_LIST LEERLAUFREGLER /end CHARACTERISTIC
/begin CHARACTERISTIC K_LFR_MD_REG_MIN "" VALUE 0x6F2 CONST_3 100.000000 F00143 -250.000000 0.000000 FUNCTION_LIST LEERLAUFREGLER /end CHARACTERISTIC
/begin CHARACTERISTIC K_LFR_MD_REG_MAX "" VALUE 0x6F4 CONST_3 100.000000 F00143 0.000000 250.000000 FUNCTION_LIST LEERLAUFREGLER /end CHARACTERISTIC
/begin CHARACTERISTIC K_LFR_MDAFR_MAX "" VALUE 0x6F6 CONST_3 100.000000 F00139 0.000000 100.000000 FUNCTION_LIST LEERLAUFREGLER /end CHARACTERISTIC
/begin CHARACTERISTIC K_LFR_LM_SCHWELLE "" VALUE 0x6F8 CONST_2 100.000000 F00007 0.000000 10000.000000 FUNCTION_LIST LEERLAUFREGLER /end CHARACTERISTIC
/begin CHARACTERISTIC K_LFR_NSOLL_LM_OFFSET "" VALUE 0x6FA CONST_2 100.000000 F00007 0.000000 10000.000000 FUNCTION_LIST LEERLAUFREGLER /end CHARACTERISTIC
/begin CHARACTERISTIC K_LLR_Q_MCS "" VALUE 0x9E2 CONST_0 100.000000 F00157 0.000000 127.000000 FUNCTION_LIST Leerlaufregelung /end CHARACTERISTIC
/begin CHARACTERISTIC K_LLR_V_MAX "" VALUE 0x9E4 CONST_2 100.000000 F00004 0.000000 360.000000 FUNCTION_LIST Leerlaufregelung /end CHARACTERISTIC
/begin CHARACTERISTIC K_LLR_TAU_VS_AUFREG "" VALUE 0xA32 CONST_0 100.000000 F00024 5.000000 0.000000 FUNCTION_LIST Leerlaufregelung /end CHARACTERISTIC
/begin CHARACTERISTIC K_LLR_QSOLL_MIN "" VALUE 0xA48 CONST_2 100.000000 F00158 0.000000 256.000000 FUNCTION_LIST Leerlaufregelung /end CHARACTERISTIC
/begin CHARACTERISTIC K_LLS_TV_MAX "" VALUE 0x712 CONST_2 100.000000 F00159 0.000000 100.000000 FUNCTION_LIST Leerlaufsteller /end CHARACTERISTIC
/begin CHARACTERISTIC K_LLS_TV_MIN "" VALUE 0x714 CONST_2 100.000000 F00159 0.000000 100.000000 FUNCTION_LIST Leerlaufsteller /end CHARACTERISTIC
/begin CHARACTERISTIC K_LLS_TV_NOTLAUF_MAX "" VALUE 0x716 CONST_2 100.000000 F00159 0.000000 100.000000 FUNCTION_LIST Leerlaufsteller /end CHARACTERISTIC
/begin CHARACTERISTIC K_LLS_TV_NOTLAUF_MIN "" VALUE 0x718 CONST_2 100.000000 F00159 0.000000 100.000000 FUNCTION_LIST Leerlaufsteller /end CHARACTERISTIC
/begin CHARACTERISTIC K_LLS_TV_AQ_NOTLAUF "" VALUE 0x71A CONST_2 100.000000 F00159 0.000000 100.000000 FUNCTION_LIST Leerlaufsteller /end CHARACTERISTIC
/begin CHARACTERISTIC K_LLS_TV_DREHPUNKT "" VALUE 0x71C CONST_2 100.000000 F00159 0.000000 100.000000 FUNCTION_LIST Leerlaufsteller /end CHARACTERISTIC
/begin CHARACTERISTIC K_LLS_NFILTER "" VALUE 0x71E CONST_3 100.000000 F00007 -10000.000000 0.000000 FUNCTION_LIST Leerlaufsteller /end CHARACTERISTIC
/begin CHARACTERISTIC K_LLS_TAU1 "" VALUE 0x720 CONST_0 100.000000 F00013 0.000000 255.000000 FUNCTION_LIST Leerlaufsteller /end CHARACTERISTIC
/begin CHARACTERISTIC K_LLS_TAU2 "" VALUE 0x721 CONST_0 100.000000 F00013 0.000000 255.000000 FUNCTION_LIST Leerlaufsteller /end CHARACTERISTIC
/begin CHARACTERISTIC K_LLS_TAU_START "" VALUE 0x722 CONST_0 100.000000 F00013 0.000000 255.000000 FUNCTION_LIST Leerlaufsteller /end CHARACTERISTIC
/begin CHARACTERISTIC K_MCSFLA_CONTROL_M "" VALUE 0x360A CONST_0 100.000000 F00160 0.000000 255.000000 FUNCTION_LIST NO_FUNCTION /end CHARACTERISTIC
/begin CHARACTERISTIC K_MD_MIN_VERH_KRAFTS "" VALUE 0x27BA CONST_0 100.000000 F00056 0.000000 1.000000 FUNCTION_LIST Momentenmanager /end CHARACTERISTIC
/begin CHARACTERISTIC K_MD_MIN_VERH_NO_KRAFTS "" VALUE 0x27BB CONST_0 100.000000 F00056 0.000000 1.000000 FUNCTION_LIST Momentenmanager /end CHARACTERISTIC
/begin CHARACTERISTIC K_MD_LLRA_N0 "" VALUE 0x27BC CONST_2 100.000000 F00007 0.000000 10000.000000 FUNCTION_LIST Momentenmanager /end CHARACTERISTIC
/begin CHARACTERISTIC K_MD_LLRA_N1 "" VALUE 0x27BE CONST_2 100.000000 F00007 0.000000 10000.000000 FUNCTION_LIST Momentenmanager /end CHARACTERISTIC
/begin CHARACTERISTIC K_MD_MIN_START_FILTER "" VALUE 0x27C0 CONST_0 100.000000 F00161 0.000000 255.000000 FUNCTION_LIST Momentenmanager /end CHARACTERISTIC
/begin CHARACTERISTIC K_MD_MIN_START_KATH "" VALUE 0x27C1 CONST_0 100.000000 F00161 0.000000 255.000000 FUNCTION_LIST Momentenmanager /end CHARACTERISTIC
/begin CHARACTERISTIC K_MD_MIN_KKOS_FILTER "" VALUE 0x27C2 CONST_0 100.000000 F00161 0.000000 255.000000 FUNCTION_LIST Momentenmanager /end CHARACTERISTIC
/begin CHARACTERISTIC K_MD_MIN_KKOS_AUS_FILTER "" VALUE 0x27C3 CONST_0 100.000000 F00161 0.000000 255.000000 FUNCTION_LIST Momentenmanager /end CHARACTERISTIC
/begin CHARACTERISTIC K_MD_MIN_KKOS_START "" VALUE 0x27C4 CONST_0 100.000000 F00161 0.000000 255.000000 FUNCTION_LIST Momentenmanager /end CHARACTERISTIC
/begin CHARACTERISTIC K_MD_MIN_VERH_START "" VALUE 0x27C5 CONST_0 100.000000 F00056 0.000000 1.000000 FUNCTION_LIST Momentenmanager /end CHARACTERISTIC
/begin CHARACTERISTIC K_MD_NORM "" VALUE 0x2DD4 CONST_0 100.000000 F00162 0.000000 1008.000000 FUNCTION_LIST Momentenmanager /end CHARACTERISTIC
/begin CHARACTERISTIC K_MD_ASC_CONTROL "" VALUE 0x2DD5 CONST_0 100.000000 F00163 0.000000 255.000000 FUNCTION_LIST Momentenmanager /end CHARACTERISTIC
/begin CHARACTERISTIC K_MD_RF_CONTROL "" VALUE 0x2DD6 CONST_0 100.000000 F00164 0.000000 255.000000 FUNCTION_LIST Momentenmanager /end CHARACTERISTIC
/begin CHARACTERISTIC K_MD_ETA_MCS "" VALUE 0x2DD7 CONST_0 100.000000 F00031 0.000000 255.000000 FUNCTION_LIST Momentenmanager /end CHARACTERISTIC
/begin CHARACTERISTIC K_MD_LS_CONFIG "" VALUE 0x2DD8 CONST_0 100.000000 F00165 0.000000 255.000000 FUNCTION_LIST Momentenmanager /end CHARACTERISTIC
/begin CHARACTERISTIC K_MD_ETA_LAMBDA_MAX "" VALUE 0x2DD9 CONST_0 100.000000 F00166 0.000000 100.000000 FUNCTION_LIST Momentenmanager /end CHARACTERISTIC
/begin CHARACTERISTIC K_MD_DF_W_HARD "" VALUE 0x2DDA CONST_0 100.000000 F00167 0.000000 15.000000 FUNCTION_LIST Momentenmanager /end CHARACTERISTIC
/begin CHARACTERISTIC K_MD_DELTA_SA_SOFT "" VALUE 0x2DDC CONST_2 100.000000 F00168 0.000000 6553.000000 FUNCTION_LIST Momentenmanager /end CHARACTERISTIC
/begin CHARACTERISTIC K_MD_DELTA_SA_HARD "" VALUE 0x2DDE CONST_2 100.000000 F00168 0.000000 6553.000000 FUNCTION_LIST Momentenmanager /end CHARACTERISTIC
/begin CHARACTERISTIC K_MD_DF_NMIN "" VALUE 0x2DE0 CONST_2 100.000000 F00007 0.000000 10000.000000 FUNCTION_LIST Momentenmanager /end CHARACTERISTIC
/begin CHARACTERISTIC K_MD_DF_VMIN "" VALUE 0x2DE2 CONST_2 100.000000 F00004 0.000000 360.000000 FUNCTION_LIST Momentenmanager /end CHARACTERISTIC
/begin CHARACTERISTIC K_MD_MSR_BEGR "" VALUE 0x2DE4 CONST_2 100.000000 F00145 0.000000 1000.000000 FUNCTION_LIST Momentenmanager /end CHARACTERISTIC
/begin CHARACTERISTIC K_MD_RF_MCS "" VALUE 0x2DE6 CONST_2 100.000000 F00060 0.000000 2.000000 FUNCTION_LIST Momentenmanager /end CHARACTERISTIC
/begin CHARACTERISTIC K_MD_J_MOTOR "" VALUE 0x3150 CONST_2 100.000000 F00169 0.000000 244.000000 FUNCTION_LIST Momentenmanager /end CHARACTERISTIC
/begin CHARACTERISTIC K_MD_BEGR_T "" VALUE 0x3152 CONST_0 100.000000 F00082 0.000000 5.000000 FUNCTION_LIST Momentenmanager /end CHARACTERISTIC
/begin CHARACTERISTIC K_MD_BEGR_RAMPE "" VALUE 0x3153 CONST_0 100.000000 F00170 0.000000 1275.000000 FUNCTION_LIST Momentenmanager /end CHARACTERISTIC
/begin CHARACTERISTIC K_MD_BEGR_DELTA "" VALUE 0x3154 CONST_0 100.000000 F00170 0.000000 1275.000000 FUNCTION_LIST Momentenmanager /end CHARACTERISTIC
/begin CHARACTERISTIC K_MD_P_MAX "" VALUE 0x3156 CONST_3 100.000000 F00171 0.000000 300.000000 FUNCTION_LIST Momentenmanager /end CHARACTERISTIC
/begin CHARACTERISTIC K_MD_NBEGR_ABSTAND "" VALUE 0x319E CONST_3 100.000000 F00007 0.000000 500.000000 FUNCTION_LIST Momentenmanager /end CHARACTERISTIC
/begin CHARACTERISTIC K_MD_NBEGR_T "" VALUE 0x31A0 CONST_3 100.000000 F00172 0.000000 10.000000 FUNCTION_LIST Momentenmanager /end CHARACTERISTIC
/begin CHARACTERISTIC K_MD_NBEGR_HYS "" VALUE 0x31A2 CONST_3 100.000000 F00007 0.000000 500.000000 FUNCTION_LIST Momentenmanager /end CHARACTERISTIC
/begin CHARACTERISTIC K_MD_BEGR_AUSS_ABREG "" VALUE 0x31DE CONST_2 100.000000 F00173 0.000000 1000.000000 FUNCTION_LIST Momentenmanager /end CHARACTERISTIC
/begin CHARACTERISTIC K_MD_BEGR_AUSS_TIME "" VALUE 0x31E0 CONST_0 100.000000 F00028 0.000000 25.000000 FUNCTION_LIST Momentenmanager /end CHARACTERISTIC
/begin CHARACTERISTIC K_V_MAX_HYS "" VALUE 0x31E2 CONST_2 100.000000 F00079 0.000000 360.000000 FUNCTION_LIST Momentenmanager /end CHARACTERISTIC
/begin CHARACTERISTIC K_MD_I_VMAX "" VALUE 0x31E4 CONST_2 100.000000 F00174 0.000000 65535.000000 FUNCTION_LIST Momentenmanager /end CHARACTERISTIC
/begin CHARACTERISTIC K_MD_VMAX_MIN "" VALUE 0x31E6 CONST_2 100.000000 F00145 0.000000 1000.000000 FUNCTION_LIST Momentenmanager /end CHARACTERISTIC
/begin CHARACTERISTIC K_MD_VMAX_MAX "" VALUE 0x31E8 CONST_2 100.000000 F00145 0.000000 1000.000000 FUNCTION_LIST Momentenmanager /end CHARACTERISTIC
/begin CHARACTERISTIC K_MD_J_FZ "" VALUE 0x31EA CONST_2 100.000000 F00175 0.000000 255.000000 FUNCTION_LIST Momentenmanager /end CHARACTERISTIC
/begin CHARACTERISTIC K_MD_STAT_ASC "" VALUE 0x31EC CONST_0 100.000000 F00176 0.000000 255.000000 FUNCTION_LIST Momentenmanager /end CHARACTERISTIC
/begin CHARACTERISTIC K_MD_SK_MAX "" VALUE 0x31EE CONST_2 100.000000 F00145 0.000000 1000.000000 FUNCTION_LIST Momentenmanager /end CHARACTERISTIC
/begin CHARACTERISTIC K_MD_SK_LLR_MAX "" VALUE 0x31F0 CONST_2 100.000000 F00145 0.000000 1000.000000 FUNCTION_LIST Momentenmanager /end CHARACTERISTIC
/begin CHARACTERISTIC K_MD_SK_RFMAX "" VALUE 0x31F2 CONST_2 100.000000 F00060 0.000000 2.000000 FUNCTION_LIST Momentenmanager /end CHARACTERISTIC
/begin CHARACTERISTIC K_MD_SK_ETA_MIN "" VALUE 0x31F4 CONST_2 100.000000 F00177 0.000000 100.000000 FUNCTION_LIST Momentenmanager /end CHARACTERISTIC
/begin CHARACTERISTIC K_MD_ASC_BEGR "" VALUE 0x31F6 CONST_2 100.000000 F00145 0.000000 1000.000000 FUNCTION_LIST Momentenmanager /end CHARACTERISTIC
/begin CHARACTERISTIC K_MD_ETA_KR_MIN "" VALUE 0x31F8 CONST_2 100.000000 F00177 0.000000 100.000000 FUNCTION_LIST Momentenmanager /end CHARACTERISTIC
/begin CHARACTERISTIC K_MD_RES_CONTROL "" VALUE 0x3226 CONST_0 100.000000 F00178 0.000000 255.000000 BIT_MASK 0xFF FUNCTION_LIST Momentenmanager /end CHARACTERISTIC
/begin CHARACTERISTIC K_MD_RES_RF_CONTROL "" VALUE 0x3227 CONST_0 100.000000 F00179 0.000000 255.000000 FUNCTION_LIST Momentenmanager /end CHARACTERISTIC
/begin CHARACTERISTIC K_MD_RES_KATH_START "" VALUE 0x3228 CONST_2 100.000000 F00100 0.000000 2.000000 FUNCTION_LIST Momentenmanager /end CHARACTERISTIC
/begin CHARACTERISTIC K_MD_RES_KATH_T_AUFREG "" VALUE 0x322A CONST_2 100.000000 F00180 0.000000 9999.000000 FUNCTION_LIST Momentenmanager /end CHARACTERISTIC
/begin CHARACTERISTIC K_MD_RES_KATH_T_ABREG "" VALUE 0x322C CONST_2 100.000000 F00180 0.000000 9999.000000 FUNCTION_LIST Momentenmanager /end CHARACTERISTIC
/begin CHARACTERISTIC K_MD_RES_KATH_LL "" VALUE 0x322E CONST_2 100.000000 F00145 0.000000 1000.000000 FUNCTION_LIST Momentenmanager /end CHARACTERISTIC
/begin CHARACTERISTIC K_MD_RES_LRW_V "" VALUE 0x33A0 CONST_2 100.000000 F00004 0.000000 360.000000 FUNCTION_LIST Momentenmanager /end CHARACTERISTIC
/begin CHARACTERISTIC K_MD_RES_LRW_VHYS "" VALUE 0x33A2 CONST_2 100.000000 F00004 0.000000 360.000000 FUNCTION_LIST Momentenmanager /end CHARACTERISTIC
/begin CHARACTERISTIC K_MD_RES_LRW_DELTA "" VALUE 0x33A4 CONST_2 100.000000 F00181 0.000000 10000.000000 FUNCTION_LIST Momentenmanager /end CHARACTERISTIC
/begin CHARACTERISTIC K_NMAX_PROFIL_I_MAX "" VALUE 0x33CE CONST_3 100.000000 F00013 -32768.000000 32767.000000 FUNCTION_LIST Momentenmanager /end CHARACTERISTIC
/begin CHARACTERISTIC K_NMAX_PROFIL_ROLLE "" VALUE 0x33D0 CONST_3 100.000000 F00013 -32768.000000 32767.000000 FUNCTION_LIST Momentenmanager /end CHARACTERISTIC
/begin CHARACTERISTIC K_NMAX_PROFIL_AKTIV "" VALUE 0x33D2 CONST_3 100.000000 F00013 -32768.000000 32767.000000 FUNCTION_LIST Momentenmanager /end CHARACTERISTIC
/begin CHARACTERISTIC K_NMAX_PROFIL_HYS "" VALUE 0x33D4 CONST_3 100.000000 F00013 -32768.000000 32767.000000 FUNCTION_LIST Momentenmanager /end CHARACTERISTIC
/begin CHARACTERISTIC K_NMAX_DAUER "" VALUE 0x33D6 CONST_2 100.000000 F00007 0.000000 10000.000000 FUNCTION_LIST Momentenmanager /end CHARACTERISTIC
/begin CHARACTERISTIC K_NMAX_DAUER_RAMPE "" VALUE 0x33D8 CONST_2 100.000000 F00182 0.000000 10000.000000 FUNCTION_LIST Momentenmanager /end CHARACTERISTIC
/begin CHARACTERISTIC K_MD_NMAX_MIN "" VALUE 0x33DA CONST_2 100.000000 F00145 0.000000 1000.000000 FUNCTION_LIST Momentenmanager /end CHARACTERISTIC
/begin CHARACTERISTIC K_MD_NMAX_MAX "" VALUE 0x33DC CONST_2 100.000000 F00145 0.000000 1000.000000 FUNCTION_LIST Momentenmanager /end CHARACTERISTIC
/begin CHARACTERISTIC K_MD_NMAX_BEGR_I "" VALUE 0x33DE CONST_2 100.000000 F00183 0.000000 639.000000 FUNCTION_LIST Momentenmanager /end CHARACTERISTIC
/begin CHARACTERISTIC K_MD_SK_AX_IMIN "" VALUE 0x33E0 CONST_3 100.000000 F00145 -1000.000000 1000.000000 FUNCTION_LIST SK-Momentenmanager /end CHARACTERISTIC
/begin CHARACTERISTIC K_MD_SK_MIN "" VALUE 0x33E2 CONST_3 100.000000 F00145 -1000.000000 1000.000000 FUNCTION_LIST SK-Momentenmanager /end CHARACTERISTIC
/begin CHARACTERISTIC K_MD_SK_TIMER "" VALUE 0x33E4 CONST_0 100.000000 F00082 0.000000 5.000000 FUNCTION_LIST SK-Momentenmanager /end CHARACTERISTIC
/begin CHARACTERISTIC K_MD_SK_TIMER_MD "" VALUE 0x33E5 CONST_0 100.000000 F00082 0.000000 5.000000 FUNCTION_LIST SK-Momentenmanager /end CHARACTERISTIC
/begin CHARACTERISTIC K_MD_SK_OFFSET "" VALUE 0x33E6 CONST_2 100.000000 F00145 0.000000 1000.000000 FUNCTION_LIST SK-Momentenmanager /end CHARACTERISTIC
/begin CHARACTERISTIC K_MD_SK_GEWICHTUNG "" VALUE 0x33E8 CONST_2 100.000000 F00192 0.000000 64.000000 FUNCTION_LIST SK-Momentenmanager /end CHARACTERISTIC
/begin CHARACTERISTIC K_MD_SK_N_MDMIN "" VALUE 0x33EA CONST_2 100.000000 F00007 0.000000 10000.000000 FUNCTION_LIST SK-Momentenmanager /end CHARACTERISTIC
/begin CHARACTERISTIC K_MD_SK_MAX_MDMIN "" VALUE 0x33EC CONST_2 100.000000 F00145 0.000000 1000.000000 FUNCTION_LIST SK-Momentenmanager /end CHARACTERISTIC
/begin CHARACTERISTIC K_MD_SK_FWMAX "" VALUE 0x33EE CONST_2 100.000000 F00048 0.000000 100.000000 FUNCTION_LIST SK-Momentenmanager /end CHARACTERISTIC
/begin CHARACTERISTIC K_MD_SK_NHYS "" VALUE 0x33F0 CONST_2 100.000000 F00007 0.000000 10000.000000 FUNCTION_LIST SK-Momentenmanager /end CHARACTERISTIC
/begin CHARACTERISTIC K_MD_SK_PWGMIN "" VALUE 0x33F2 CONST_2 100.000000 F00048 0.000000 100.000000 FUNCTION_LIST SK-Momentenmanager /end CHARACTERISTIC
/begin CHARACTERISTIC K_N_UMSCHALTUNG "" VALUE 0x1CCA CONST_2 100.000000 F00007 0.000000 10000.000000 FUNCTION_LIST NO_FUNCTION /end CHARACTERISTIC
/begin CHARACTERISTIC K_N_TBEGR "" VALUE 0x1CCC CONST_2 100.000000 F00007 0.000000 10000.000000 FUNCTION_LIST NO_FUNCTION /end CHARACTERISTIC
/begin CHARACTERISTIC K_N_HYST "" VALUE 0x1CCE CONST_2 100.000000 F00007 0.000000 10000.000000 FUNCTION_LIST NO_FUNCTION /end CHARACTERISTIC
/begin CHARACTERISTIC K_N_DELTA_DYN "" VALUE 0x1CD0 CONST_2 100.000000 F00007 0.000000 10000.000000 FUNCTION_LIST NO_FUNCTION /end CHARACTERISTIC
/begin CHARACTERISTIC K_N_T_DYN "" VALUE 0x1CD2 CONST_2 100.000000 F00027 0.000000 655.000000 FUNCTION_LIST NO_FUNCTION /end CHARACTERISTIC
/begin CHARACTERISTIC K_N_TAU_GRAD "" VALUE 0x1CD4 CONST_0 100.000000 F00195 25.000000 0.000000 FUNCTION_LIST NO_FUNCTION /end CHARACTERISTIC
/begin CHARACTERISTIC K_N_TAU_DYN "" VALUE 0x1CD5 CONST_0 100.000000 F00196 2.000000 0.000000 FUNCTION_LIST NO_FUNCTION /end CHARACTERISTIC
/begin CHARACTERISTIC K_N_FILTER_SEGMENTE "" VALUE 0x1CD6 CONST_0 100.000000 F00197 1.000000 8.000000 FUNCTION_LIST NO_FUNCTION /end CHARACTERISTIC
/begin CHARACTERISTIC K_N_TAU_DN "" VALUE 0x1CD7 CONST_0 100.000000 F00196 2.000000 0.000000 FUNCTION_LIST NO_FUNCTION /end CHARACTERISTIC
/begin CHARACTERISTIC K_OEK_T_NL "" VALUE 0x351E CONST_0 100.000000 F00198 0.000000 25.000000 FUNCTION_LIST OEK /end CHARACTERISTIC
/begin CHARACTERISTIC K_OEK_AUF "" VALUE 0x351F CONST_1 100.000000 F00193 -12.000000 12.000000 FUNCTION_LIST OEK /end CHARACTERISTIC
/begin CHARACTERISTIC K_OEK_ZU "" VALUE 0x3520 CONST_1 100.000000 F00193 -12.000000 12.000000 FUNCTION_LIST OEK /end CHARACTERISTIC
/begin CHARACTERISTIC K_OEK_N40 "" VALUE 0x3521 CONST_0 100.000000 F00109 0.000000 10000.000000 FUNCTION_LIST OEK /end CHARACTERISTIC
/begin CHARACTERISTIC K_OEK_TV_AUS "" VALUE 0x3522 CONST_2 100.000000 F00199 100.000000 0.000000 FUNCTION_LIST OEK /end CHARACTERISTIC
/begin CHARACTERISTIC K_OEK_TV_MIN "" VALUE 0x3524 CONST_2 100.000000 F00199 100.000000 0.000000 FUNCTION_LIST OEK /end CHARACTERISTIC
/begin CHARACTERISTIC K_OEK_TV_MAX "" VALUE 0x3526 CONST_2 100.000000 F00199 100.000000 0.000000 FUNCTION_LIST OEK /end CHARACTERISTIC
/begin CHARACTERISTIC K_OEK_T "" VALUE 0x3528 CONST_0 100.000000 F00198 0.000000 25.000000 FUNCTION_LIST OEK /end CHARACTERISTIC
/begin CHARACTERISTIC K_OEK_TOEL "" VALUE 0x3529 CONST_0 100.000000 F00014 -48.000000 207.000000 FUNCTION_LIST OEK /end CHARACTERISTIC
/begin CHARACTERISTIC K_PDR_T_START "" VALUE 0x37E0 CONST_0 100.000000 F00200 0.000000 510.000000 FUNCTION_LIST PDR /end CHARACTERISTIC
/begin CHARACTERISTIC K_PDR_T_PHASE1 "" VALUE 0x37E1 CONST_0 100.000000 F00200 0.000000 510.000000 FUNCTION_LIST PDR /end CHARACTERISTIC
/begin CHARACTERISTIC K_PDR_T_PHASE2 "" VALUE 0x37E2 CONST_0 100.000000 F00200 0.000000 510.000000 FUNCTION_LIST PDR /end CHARACTERISTIC
/begin CHARACTERISTIC K_PDR_T_PHASE3 "" VALUE 0x37E3 CONST_0 100.000000 F00200 0.000000 510.000000 FUNCTION_LIST PDR /end CHARACTERISTIC
/begin CHARACTERISTIC K_PDR_A0_TIMEOUT "" VALUE 0x37E4 CONST_0 100.000000 F00200 0.000000 510.000000 FUNCTION_LIST PDR /end CHARACTERISTIC
/begin CHARACTERISTIC K_PDR_SOLL_EDK "" VALUE 0x37E6 CONST_3 100.000000 F00048 -20.000000 120.000000 FUNCTION_LIST PDR /end CHARACTERISTIC
/begin CHARACTERISTIC K_PDR_EDK_DMAX "" VALUE 0x37E8 CONST_3 100.000000 F00048 -10.000000 10.000000 FUNCTION_LIST PDR /end CHARACTERISTIC
/begin CHARACTERISTIC K_PDR_DKM0 "" VALUE 0x37EA CONST_3 100.000000 F00048 -10.000000 10.000000 FUNCTION_LIST PDR /end CHARACTERISTIC
/begin CHARACTERISTIC K_PDR_EGAS_TV "" VALUE 0x37EC CONST_3 100.000000 F00055 -100.000000 100.000000 FUNCTION_LIST PDR /end CHARACTERISTIC
/begin CHARACTERISTIC K_PDR_T_WDK2 "" VALUE 0x37EE CONST_0 100.000000 F00200 0.000000 510.000000 FUNCTION_LIST PDR /end CHARACTERISTIC
/begin CHARACTERISTIC K_PDR_SOLL_WDK2 "" VALUE 0x37F0 CONST_3 100.000000 F00048 -20.000000 120.000000 FUNCTION_LIST PDR /end CHARACTERISTIC
/begin CHARACTERISTIC K_P_UMG_WETTER "" VALUE 0x1D26 CONST_2 100.000000 F00201 900.000000 1100.000000 FUNCTION_LIST Messwerte /end CHARACTERISTIC
/begin CHARACTERISTIC K_P_UMG_DIAG_MIN "" VALUE 0x1D28 CONST_2 100.000000 F00202 400.000000 1150.000000 FUNCTION_LIST Messwerte /end CHARACTERISTIC
/begin CHARACTERISTIC K_P_UMG_DIAG_MAX "" VALUE 0x1D2A CONST_2 100.000000 F00202 400.000000 1150.000000 FUNCTION_LIST Messwerte /end CHARACTERISTIC
/begin CHARACTERISTIC K_P_UMG_ERSATZ "" VALUE 0x1D2C CONST_2 100.000000 F00202 400.000000 1150.000000 FUNCTION_LIST Messwerte /end CHARACTERISTIC
/begin CHARACTERISTIC K_P_UMG_STEIGUNG "" VALUE 0x1D2E CONST_2 100.000000 F00203 2502.000000 0.000000 FUNCTION_LIST Messwerte /end CHARACTERISTIC
/begin CHARACTERISTIC K_P_UMG_OFFSET "" VALUE 0x1D30 CONST_2 100.000000 F00204 0.000000 0.000000 FUNCTION_LIST Messwerte /end CHARACTERISTIC
/begin CHARACTERISTIC K_P_UMG_TAU "" VALUE 0x1D32 CONST_0 100.000000 F00195 25.000000 0.000000 FUNCTION_LIST Messwerte /end CHARACTERISTIC
/begin CHARACTERISTIC K_PWG1_NORM "" VALUE 0x120 CONST_2 100.000000 F00206 0.000000 654.000000 FUNCTION_LIST Messwerte /end CHARACTERISTIC
/begin CHARACTERISTIC K_PWG1_MIN "" VALUE 0x122 CONST_2 100.000000 F00207 0.000000 2.000000 FUNCTION_LIST Messwerte /end CHARACTERISTIC
/begin CHARACTERISTIC K_PWG1_MAX "" VALUE 0x124 CONST_2 100.000000 F00207 2.000000 5.000000 FUNCTION_LIST Messwerte /end CHARACTERISTIC
/begin CHARACTERISTIC K_PWG1_A0_MIN "" VALUE 0x126 CONST_2 100.000000 F00207 0.000000 2.000000 FUNCTION_LIST Messwerte /end CHARACTERISTIC
/begin CHARACTERISTIC K_PWG1_A0_MAX "" VALUE 0x128 CONST_2 100.000000 F00207 0.000000 2.000000 FUNCTION_LIST Messwerte /end CHARACTERISTIC
/begin CHARACTERISTIC K_PWG_TAU_NORM_UP "" VALUE 0x12A CONST_0 100.000000 F00196 2.000000 0.000000 FUNCTION_LIST Messwerte /end CHARACTERISTIC
/begin CHARACTERISTIC K_PWG_TAU_FEHLER "" VALUE 0x12B CONST_0 100.000000 F00196 2.000000 0.000000 FUNCTION_LIST Messwerte /end CHARACTERISTIC
/begin CHARACTERISTIC K_PWG_A0_TAU "" VALUE 0x12C CONST_0 100.000000 F00195 25.000000 0.000000 FUNCTION_LIST Messwerte /end CHARACTERISTIC
/begin CHARACTERISTIC K_PWG1_INC_A0_ADAPT "" VALUE 0x12D CONST_0 100.000000 F00207 0.000000 1.000000 FUNCTION_LIST Messwerte /end CHARACTERISTIC
/begin CHARACTERISTIC K_PWG_A0_ZAEHLER "" VALUE 0x12E CONST_0 100.000000 F00208 2.000000 0.000000 FUNCTION_LIST Messwerte /end CHARACTERISTIC
/begin CHARACTERISTIC K_PWG1_A0_INITINC "" VALUE 0x12F CONST_0 100.000000 F00207 0.000000 1.000000 FUNCTION_LIST Messwerte /end CHARACTERISTIC
/begin CHARACTERISTIC K_PWG_AB_RAMPE "" VALUE 0x130 CONST_2 100.000000 F00209 600.000000 0.000000 FUNCTION_LIST Messwerte /end CHARACTERISTIC
/begin CHARACTERISTIC K_PWG1_SK_NULLAGE "" VALUE 0x132 CONST_2 100.000000 F00048 0.000000 100.000000 FUNCTION_LIST Messwerte /end CHARACTERISTIC
/begin CHARACTERISTIC K_PWG_KD "" VALUE 0x134 CONST_2 100.000000 F00048 0.000000 120.000000 FUNCTION_LIST Messwerte /end CHARACTERISTIC
/begin CHARACTERISTIC K_PWG_SOLL_ANF_2_FAK "" VALUE 0x136 CONST_0 100.000000 F00056 0.000000 1.000000 FUNCTION_LIST Messwerte /end CHARACTERISTIC
/begin CHARACTERISTIC K_PWG_SOLL_ANF_2_MAX "" VALUE 0x138 CONST_2 100.000000 F00048 0.000000 100.000000 FUNCTION_LIST Messwerte /end CHARACTERISTIC
/begin CHARACTERISTIC K_S_BLS_ED_FILTER "" VALUE 0x1FDE CONST_0 100.000000 F00210 0.000000 5100.000000 FUNCTION_LIST Messwerte /end CHARACTERISTIC
/begin CHARACTERISTIC K_S_BLS_TIME_LA_DELTA "" VALUE 0x1FE0 CONST_2 100.000000 F00057 0.000000 655350.000000 FUNCTION_LIST Messwerte /end CHARACTERISTIC
/begin CHARACTERISTIC K_S_BLS_TIME_LA_OK "" VALUE 0x1FE2 CONST_2 100.000000 F00057 0.000000 655350.000000 FUNCTION_LIST Messwerte /end CHARACTERISTIC
/begin CHARACTERISTIC K_S_BLS_TIME_LA_MAX "" VALUE 0x1FE4 CONST_2 100.000000 F00057 0.000000 655350.000000 FUNCTION_LIST Messwerte /end CHARACTERISTIC
/begin CHARACTERISTIC K_S_BLS_CFG "" VALUE 0x1FE6 CONST_0 100.000000 F00211 0.000000 3.000000 FUNCTION_LIST Messwerte /end CHARACTERISTIC
/begin CHARACTERISTIC K_S_BLS_TIME_BTS_E36_7 "" VALUE 0x1FE8 CONST_2 100.000000 F00210 0.000000 1310700.000000 FUNCTION_LIST Messwerte /end CHARACTERISTIC
/begin CHARACTERISTIC K_S_BLS_EPZI_BTS_E36_7 "" VALUE 0x1FEA CONST_0 100.000000 F00013 0.000000 255.000000 FUNCTION_LIST Messwerte /end CHARACTERISTIC
/begin CHARACTERISTIC K_S_BLS_EPZO_BTS_E36_7 "" VALUE 0x1FEB CONST_0 100.000000 F00013 0.000000 255.000000 FUNCTION_LIST Messwerte /end CHARACTERISTIC
/begin CHARACTERISTIC K_S_BLS_EPZ_BLS_E36_7 "" VALUE 0x1FEC CONST_0 100.000000 F00013 0.000000 255.000000 FUNCTION_LIST Messwerte /end CHARACTERISTIC
/begin CHARACTERISTIC K_S_BLS_EPZ_BLS_INC_E36_7 "" VALUE 0x1FED CONST_0 100.000000 F00013 0.000000 255.000000 FUNCTION_LIST Messwerte /end CHARACTERISTIC
/begin CHARACTERISTIC K_SERVO_STROM_ERSATZ "" VALUE 0x3F10 CONST_2 100.000000 F00212 0.000000 801.000000 FUNCTION_LIST Servotronic /end CHARACTERISTIC
/begin CHARACTERISTIC K_SERVO_KP "" VALUE 0x3F12 CONST_2 100.000000 F00213 0.000000 65535.000000 FUNCTION_LIST Servotronic /end CHARACTERISTIC
/begin CHARACTERISTIC K_SERVO_KD "" VALUE 0x3F14 CONST_2 100.000000 F00214 0.000000 1310700.000000 FUNCTION_LIST Servotronic /end CHARACTERISTIC
/begin CHARACTERISTIC K_SERVO_SOLL_FILT "" VALUE 0x3F16 CONST_0 100.000000 F00083 0.000000 5100.000000 FUNCTION_LIST Servotronic /end CHARACTERISTIC
/begin CHARACTERISTIC K_SERVO_SCHALT "" VALUE 0x3F17 CONST_0 100.000000 F00215 20480.000000 80.000000 FUNCTION_LIST Servotronic /end CHARACTERISTIC
/begin CHARACTERISTIC K_SERVO_ED_CYCLE "" VALUE 0x3F18 CONST_0 100.000000 F00216 0.000000 255.000000 FUNCTION_LIST Servotronic /end CHARACTERISTIC
/begin CHARACTERISTIC K_SERVO_ED_I_OL "" VALUE 0x3F1A CONST_2 100.000000 F00212 0.000000 910.000000 FUNCTION_LIST Servotronic /end CHARACTERISTIC
/begin CHARACTERISTIC K_SERVO_ED_I_KS_UB "" VALUE 0x3F1C CONST_2 100.000000 F00212 0.000000 910.000000 FUNCTION_LIST Servotronic /end CHARACTERISTIC
/begin CHARACTERISTIC K_SERVO_ED_IMIN_TAST "" VALUE 0x3F1E CONST_0 100.000000 F00217 0.000000 255.000000 FUNCTION_LIST Servotronic /end CHARACTERISTIC
/begin CHARACTERISTIC K_SERVO_ED_IMIN_OFFSET "" VALUE 0x3F20 CONST_2 100.000000 F00212 0.000000 910.000000 FUNCTION_LIST Servotronic /end CHARACTERISTIC
/begin CHARACTERISTIC K_SERVO_ED_IMAX_TAST "" VALUE 0x3F22 CONST_0 100.000000 F00217 0.000000 255.000000 FUNCTION_LIST Servotronic /end CHARACTERISTIC
/begin CHARACTERISTIC K_SERVO_ED_IMAX_OFFSET "" VALUE 0x3F24 CONST_2 100.000000 F00212 0.000000 910.000000 FUNCTION_LIST Servotronic /end CHARACTERISTIC
/begin CHARACTERISTIC K_SERVO_CTRL "" VALUE 0x3F26 CONST_0 100.000000 F00218 0.000000 255.000000 FUNCTION_LIST Servotronic /end CHARACTERISTIC
/begin CHARACTERISTIC K_SK_CONTROL "" VALUE 0x2230 CONST_0 100.000000 F00219 0.000000 255.000000 FUNCTION_LIST Sicherheitskonzept /end CHARACTERISTIC
/begin CHARACTERISTIC K_SK_UEBERGANG2 "" VALUE 0x2231 CONST_0 100.000000 F00082 0.000000 5.000000 FUNCTION_LIST Sicherheitskonzept /end CHARACTERISTIC
/begin CHARACTERISTIC K_SK_UEBERGANG3 "" VALUE 0x2232 CONST_0 100.000000 F00082 0.000000 5.000000 FUNCTION_LIST Sicherheitskonzept /end CHARACTERISTIC
/begin CHARACTERISTIC K_SK_UEBERGANG4 "" VALUE 0x2233 CONST_0 100.000000 F00082 0.000000 5.000000 FUNCTION_LIST Sicherheitskonzept /end CHARACTERISTIC
/begin CHARACTERISTIC K_SK_ZEIT_DK_OFFEN "" VALUE 0x2234 CONST_0 100.000000 F00082 0.000000 5.000000 FUNCTION_LIST Sicherheitskonzept /end CHARACTERISTIC
/begin CHARACTERISTIC K_SKM_IPK_TIMEOUT "" VALUE 0x2235 CONST_0 100.000000 F00028 0.000000 25.000000 FUNCTION_LIST Sicherheitskonzept /end CHARACTERISTIC
/begin CHARACTERISTIC K_SK_TR_MANIPULATION "" VALUE 0x2236 CONST_0 100.000000 F00013 0.000000 255.000000 FUNCTION_LIST Sicherheitskonzept /end CHARACTERISTIC
/begin CHARACTERISTIC K_SK_TR_TEST "" VALUE 0x2237 CONST_0 100.000000 F00013 0.000000 255.000000 FUNCTION_LIST Sicherheitskonzept /end CHARACTERISTIC
/begin CHARACTERISTIC K_SLS_RF "" VALUE 0x35B6 CONST_2 100.000000 F00068 0.000000 10.000000 FUNCTION_LIST Sekundaerluftsystem /end CHARACTERISTIC
/begin CHARACTERISTIC K_SLS_N "" VALUE 0x35B8 CONST_2 100.000000 F00007 0.000000 9000.000000 FUNCTION_LIST Sekundaerluftsystem /end CHARACTERISTIC
/begin CHARACTERISTIC K_SLS_DIAG_RF_MAX "" VALUE 0x35BA CONST_2 100.000000 F00068 0.000000 10.000000 FUNCTION_LIST Sekundaerluftsystem /end CHARACTERISTIC
/begin CHARACTERISTIC K_SLS_DIAG_N_MAX "" VALUE 0x35BC CONST_2 100.000000 F00007 0.000000 9000.000000 FUNCTION_LIST Sekundaerluftsystem /end CHARACTERISTIC
/begin CHARACTERISTIC K_SLS_DIAG_ML_MAX "" VALUE 0x35BE CONST_2 100.000000 F00095 0.000000 1400.000000 FUNCTION_LIST Sekundaerluftsystem /end CHARACTERISTIC
/begin CHARACTERISTIC K_SLS_DIAG_RF_MIN "" VALUE 0x35C0 CONST_2 100.000000 F00068 0.000000 10.000000 FUNCTION_LIST Sekundaerluftsystem /end CHARACTERISTIC
/begin CHARACTERISTIC K_SLS_DIAG_N_MIN "" VALUE 0x35C2 CONST_2 100.000000 F00007 0.000000 9000.000000 FUNCTION_LIST Sekundaerluftsystem /end CHARACTERISTIC
/begin CHARACTERISTIC K_SLS_DIAG_ML_MIN "" VALUE 0x35C4 CONST_2 100.000000 F00095 0.000000 1400.000000 FUNCTION_LIST Sekundaerluftsystem /end CHARACTERISTIC
/begin CHARACTERISTIC K_SLS_OBD "" VALUE 0x35C6 CONST_0 100.000000 F00110 0.000000 1.000000 FUNCTION_LIST Sekundaerluftsystem /end CHARACTERISTIC
/begin CHARACTERISTIC K_SLS_ML "" VALUE 0x35C8 CONST_2 100.000000 F00095 0.000000 1400.000000 FUNCTION_LIST Sekundaerluftsystem /end CHARACTERISTIC
/begin CHARACTERISTIC K_SLS_UB_MIN "" VALUE 0x35CA CONST_0 100.000000 F00018 0.000000 20.000000 FUNCTION_LIST Sekundaerluftsystem /end CHARACTERISTIC
/begin CHARACTERISTIC K_SLS_UB_MAX "" VALUE 0x35CB CONST_0 100.000000 F00018 0.000000 20.000000 FUNCTION_LIST Sekundaerluftsystem /end CHARACTERISTIC
/begin CHARACTERISTIC K_SLS_TIME_A "" VALUE 0x35CC CONST_2 100.000000 F00016 0.000000 63.000000 FUNCTION_LIST Sekundaerluftsystem /end CHARACTERISTIC
/begin CHARACTERISTIC K_SLS_TIME_D "" VALUE 0x35CE CONST_2 100.000000 F00016 0.000000 63.000000 FUNCTION_LIST Sekundaerluftsystem /end CHARACTERISTIC
/begin CHARACTERISTIC K_SLS_TIME_K "" VALUE 0x35D0 CONST_2 100.000000 F00016 0.000000 63.000000 FUNCTION_LIST Sekundaerluftsystem /end CHARACTERISTIC
/begin CHARACTERISTIC K_SLS_TIME_BANDENDE "" VALUE 0x35D2 CONST_2 100.000000 F00016 0.000000 63.000000 FUNCTION_LIST Sekundaerluftsystem /end CHARACTERISTIC
/begin CHARACTERISTIC K_SLS_LA_SP_OK "" VALUE 0x35D4 CONST_0 100.000000 F00013 0.000000 255.000000 FUNCTION_LIST Sekundaerluftsystem /end CHARACTERISTIC
/begin CHARACTERISTIC K_SLS_TI_FETT_ON "" VALUE 0x35D5 CONST_0 100.000000 F00017 0.000000 255.000000 FUNCTION_LIST Sekundaerluftsystem /end CHARACTERISTIC
/begin CHARACTERISTIC K_SLS_TI_FETT_OFF "" VALUE 0x35D6 CONST_0 100.000000 F00017 0.000000 255.000000 FUNCTION_LIST Sekundaerluftsystem /end CHARACTERISTIC
/begin CHARACTERISTIC K_SLS_BA_TI "" VALUE 0x35D8 CONST_2 100.000000 F00085 0.000000 12.000000 FUNCTION_LIST Sekundaerluftsystem /end CHARACTERISTIC
/begin CHARACTERISTIC K_SLS_DIAG_D "" VALUE 0x35DA CONST_2 100.000000 F00013 0.000000 65535.000000 FUNCTION_LIST Sekundaerluftsystem /end CHARACTERISTIC
/begin CHARACTERISTIC K_SLS_DIAG_USV1 "" VALUE 0x35DC CONST_2 100.000000 F00013 0.000000 65535.000000 FUNCTION_LIST Sekundaerluftsystem /end CHARACTERISTIC
/begin CHARACTERISTIC K_SLS_DIAG_USV2 "" VALUE 0x35DE CONST_2 100.000000 F00013 0.000000 65535.000000 FUNCTION_LIST Sekundaerluftsystem /end CHARACTERISTIC
/begin CHARACTERISTIC K_SLS_D_USV1 "" VALUE 0x35E0 CONST_2 100.000000 F00222 0.000000 1200.000000 FUNCTION_LIST Sekundaerluftsystem /end CHARACTERISTIC
/begin CHARACTERISTIC K_SLS_D_USV2 "" VALUE 0x35E2 CONST_2 100.000000 F00222 0.000000 1200.000000 FUNCTION_LIST Sekundaerluftsystem /end CHARACTERISTIC
/begin CHARACTERISTIC K_SLS_K_USV1 "" VALUE 0x35E4 CONST_2 100.000000 F00222 0.000000 1200.000000 FUNCTION_LIST Sekundaerluftsystem /end CHARACTERISTIC
/begin CHARACTERISTIC K_SLS_K_USV2 "" VALUE 0x35E6 CONST_2 100.000000 F00222 0.000000 1200.000000 FUNCTION_LIST Sekundaerluftsystem /end CHARACTERISTIC
/begin CHARACTERISTIC K_SLS_DIAG_MLVERH "" VALUE 0x35E8 CONST_2 100.000000 F00085 0.000000 64.000000 FUNCTION_LIST Sekundaerluftsystem /end CHARACTERISTIC
/begin CHARACTERISTIC K_SLS_DIAG_TI_F_MAX "" VALUE 0x35EA CONST_2 100.000000 F00085 0.000000 2.000000 FUNCTION_LIST Sekundaerluftsystem /end CHARACTERISTIC
/begin CHARACTERISTIC K_SLV_START2_T_UMG "" VALUE 0x354E CONST_0 100.000000 F00014 -48.000000 207.000000 FUNCTION_LIST Sekundaerluftsystem /end CHARACTERISTIC
/begin CHARACTERISTIC K_SLV_START_2 "" VALUE 0x354F CONST_0 100.000000 F00017 0.000000 255.000000 FUNCTION_LIST Sekundaerluftsystem /end CHARACTERISTIC
/begin CHARACTERISTIC K_SLV_STAND_MIN "" VALUE 0x3550 CONST_0 100.000000 F00223 0.000000 255.000000 FUNCTION_LIST Sekundaerluftsystem /end CHARACTERISTIC
/begin CHARACTERISTIC K_SLV_ZYKLUS1_MIN "" VALUE 0x3551 CONST_0 100.000000 F00014 -48.000000 207.000000 FUNCTION_LIST Sekundaerluftsystem /end CHARACTERISTIC
/begin CHARACTERISTIC K_SLV_ZYKLUS1_MAX "" VALUE 0x3552 CONST_0 100.000000 F00014 -48.000000 207.000000 FUNCTION_LIST Sekundaerluftsystem /end CHARACTERISTIC
/begin CHARACTERISTIC K_SLV_ZYKLUS2_MIN "" VALUE 0x3553 CONST_0 100.000000 F00014 -48.000000 207.000000 FUNCTION_LIST Sekundaerluftsystem /end CHARACTERISTIC
/begin CHARACTERISTIC K_SLV_ZYKLUS2_MAX "" VALUE 0x3554 CONST_0 100.000000 F00014 -48.000000 207.000000 FUNCTION_LIST Sekundaerluftsystem /end CHARACTERISTIC
/begin CHARACTERISTIC K_SLV_ZYKLUS3_MIN "" VALUE 0x3555 CONST_0 100.000000 F00014 -48.000000 207.000000 FUNCTION_LIST Sekundaerluftsystem /end CHARACTERISTIC
/begin CHARACTERISTIC K_SLV_ZYKLUS3_MAX "" VALUE 0x3556 CONST_0 100.000000 F00014 -48.000000 207.000000 FUNCTION_LIST Sekundaerluftsystem /end CHARACTERISTIC
/begin CHARACTERISTIC K_SLV_ZYKLUS4_MIN "" VALUE 0x3557 CONST_0 100.000000 F00014 -48.000000 207.000000 FUNCTION_LIST Sekundaerluftsystem /end CHARACTERISTIC
/begin CHARACTERISTIC K_SLV_ZYKLUS4_MAX "" VALUE 0x3558 CONST_0 100.000000 F00014 -48.000000 207.000000 FUNCTION_LIST Sekundaerluftsystem /end CHARACTERISTIC
/begin CHARACTERISTIC K_SLV_ZYKLUS5_MIN "" VALUE 0x3559 CONST_0 100.000000 F00014 -48.000000 207.000000 FUNCTION_LIST Sekundaerluftsystem /end CHARACTERISTIC
/begin CHARACTERISTIC K_SLV_ZYKLUS5_MAX "" VALUE 0x355A CONST_0 100.000000 F00014 -48.000000 207.000000 FUNCTION_LIST Sekundaerluftsystem /end CHARACTERISTIC
/begin CHARACTERISTIC K_SSP_DIAG_TIME_WAIT "" VALUE 0x360C CONST_2 100.000000 F00016 0.000000 63.000000 FUNCTION_LIST Saugstrahlpumpe /end CHARACTERISTIC
/begin CHARACTERISTIC K_SSP_DIAG_TIME_MAX "" VALUE 0x360E CONST_2 100.000000 F00016 0.000000 63.000000 FUNCTION_LIST Saugstrahlpumpe /end CHARACTERISTIC
/begin CHARACTERISTIC K_SSP_DIAG_LLS_DELTA_MAX "" VALUE 0x3610 CONST_2 100.000000 F00159 0.000000 100.000000 FUNCTION_LIST Saugstrahlpumpe /end CHARACTERISTIC
/begin CHARACTERISTIC K_SSP_DIAG_DML_MIN "" VALUE 0x3612 CONST_2 100.000000 F00095 0.000000 1400.000000 FUNCTION_LIST Saugstrahlpumpe /end CHARACTERISTIC
/begin CHARACTERISTIC K_SSP_DIAG_DML_MAX "" VALUE 0x3614 CONST_2 100.000000 F00095 0.000000 1400.000000 FUNCTION_LIST Saugstrahlpumpe /end CHARACTERISTIC
/begin CHARACTERISTIC K_SSP_DIAG_ML_MAX "" VALUE 0x3616 CONST_2 100.000000 F00095 0.000000 1400.000000 FUNCTION_LIST Saugstrahlpumpe /end CHARACTERISTIC
/begin CHARACTERISTIC K_SSP_CONTROL "" VALUE 0x3618 CONST_0 100.000000 F00224 0.000000 3.000000 FUNCTION_LIST Saugstrahlpumpe /end CHARACTERISTIC
/begin CHARACTERISTIC K_START_SGANG "" VALUE 0x34A4 CONST_0 100.000000 F00110 0.000000 1.000000 FUNCTION_LIST Startrelais /end CHARACTERISTIC
/begin CHARACTERISTIC K_START_BEGINN "" VALUE 0x34A6 CONST_2 100.000000 F00007 0.000000 10000.000000 FUNCTION_LIST Startrelais /end CHARACTERISTIC
/begin CHARACTERISTIC K_SWE_VSWMX "" VALUE 0xA4A CONST_2 100.000000 F00004 0.000000 360.000000 FUNCTION_LIST Schlechtweg-Erkennung /end CHARACTERISTIC
/begin CHARACTERISTIC K_RESET_CONTROL "" VALUE 0x1E CONST_0 100.000000 F00031 0.000000 255.000000 FUNCTION_LIST System_Kontrolle /end CHARACTERISTIC
/begin CHARACTERISTIC K_PCNTRL_MAX_RESET_M "" VALUE 0x1F CONST_0 100.000000 F00031 0.000000 255.000000 FUNCTION_LIST System_Kontrolle /end CHARACTERISTIC
/begin CHARACTERISTIC K_PCNTRL_TIMEOUT_M "" VALUE 0x20 CONST_0 100.000000 F00210 0.000000 5100.000000 FUNCTION_LIST System_Kontrolle /end CHARACTERISTIC
/begin CHARACTERISTIC K_PCNTRL_ZEIT_M "" VALUE 0x21 CONST_0 100.000000 F00057 0.000000 2550.000000 FUNCTION_LIST System_Kontrolle /end CHARACTERISTIC
/begin CHARACTERISTIC K_PCNTRL_BITMSK_M "" VALUE 0x22 CONST_2 100.000000 F00031 0.000000 65535.000000 FUNCTION_LIST System_Kontrolle /end CHARACTERISTIC
/begin CHARACTERISTIC K_FDYN_CONTROL "" VALUE 0x24 CONST_0 100.000000 F00226 0.000000 255.000000 FUNCTION_LIST System_Kontrolle /end CHARACTERISTIC
/begin CHARACTERISTIC K_ED_UBMIN_M "" VALUE 0x25 CONST_0 100.000000 F00018 0.000000 25.000000 FUNCTION_LIST System_Kontrolle /end CHARACTERISTIC
/begin CHARACTERISTIC K_DEBUG_CONTROL "" VALUE 0x26 CONST_0 100.000000 F00031 0.000000 255.000000 FUNCTION_LIST System_Kontrolle /end CHARACTERISTIC
/begin CHARACTERISTIC K_OEK_CONTROL "" VALUE 0x27 CONST_0 100.000000 F00227 0.000000 255.000000 FUNCTION_LIST System_Kontrolle /end CHARACTERISTIC
/begin CHARACTERISTIC K_SKRAFTS_CONTROL "" VALUE 0x28 CONST_0 100.000000 F00228 0.000000 255.000000 FUNCTION_LIST System_Kontrolle /end CHARACTERISTIC
/begin CHARACTERISTIC K_DA_M1 "" VALUE 0x2A CONST_0 100.000000 F00229 0.000000 255.000000 FUNCTION_LIST D/A_Konfiguration /end CHARACTERISTIC
/begin CHARACTERISTIC K_DA_M2 "" VALUE 0x2B CONST_0 100.000000 F00229 0.000000 255.000000 FUNCTION_LIST D/A_Konfiguration /end CHARACTERISTIC
/begin CHARACTERISTIC K_DA_M3 "" VALUE 0x2C CONST_0 100.000000 F00229 0.000000 255.000000 FUNCTION_LIST D/A_Konfiguration /end CHARACTERISTIC
/begin CHARACTERISTIC K_DA_M4 "" VALUE 0x2D CONST_0 100.000000 F00229 0.000000 255.000000 FUNCTION_LIST D/A_Konfiguration /end CHARACTERISTIC
/begin CHARACTERISTIC K_DA_M5 "" VALUE 0x2E CONST_0 100.000000 F00229 0.000000 255.000000 FUNCTION_LIST D/A_Konfiguration /end CHARACTERISTIC
/begin CHARACTERISTIC K_DA_M6 "" VALUE 0x2F CONST_0 100.000000 F00229 0.000000 255.000000 FUNCTION_LIST D/A_Konfiguration /end CHARACTERISTIC
/begin CHARACTERISTIC K_DA_SEITE_M "" VALUE 0x30 CONST_0 100.000000 F00230 0.000000 255.000000 FUNCTION_LIST D/A_Konfiguration /end CHARACTERISTIC
/begin CHARACTERISTIC K_DA_CONTROL "" VALUE 0x31 CONST_0 100.000000 F00231 0.000000 255.000000 FUNCTION_LIST D/A_Konfiguration /end CHARACTERISTIC
/begin CHARACTERISTIC K_MIL_MODE_M "" VALUE 0x32 CONST_0 100.000000 F00232 0.000000 255.000000 FUNCTION_LIST Eigendiagnose /end CHARACTERISTIC
/begin CHARACTERISTIC K_MIL_MIN_ERR_CNT_M "" VALUE 0x33 CONST_0 100.000000 F00031 0.000000 255.000000 FUNCTION_LIST Eigendiagnose /end CHARACTERISTIC
/begin CHARACTERISTIC K_TABG_CFG "" VALUE 0x1E42 CONST_0 100.000000 F00233 0.000000 1.000000 FUNCTION_LIST Messwerte /end CHARACTERISTIC
/begin CHARACTERISTIC K_TABG_ERSATZ_OFFSET "" VALUE 0x1E43 CONST_0 100.000000 F00234 0.000000 1.000000 FUNCTION_LIST Messwerte /end CHARACTERISTIC
/begin CHARACTERISTIC K_TABG_ERSATZ_START "" VALUE 0x1E44 CONST_0 100.000000 F00017 1.000000 255.000000 FUNCTION_LIST Messwerte /end CHARACTERISTIC
/begin CHARACTERISTIC K_TABG_ERSATZ_TMOT_OFFSET "" VALUE 0x1E45 CONST_0 100.000000 F00015 0.000000 255.000000 FUNCTION_LIST Messwerte /end CHARACTERISTIC
/begin CHARACTERISTIC K_TABG_DIAG_MIN "" VALUE 0x1E46 CONST_3 100.000000 F00015 -50.000000 1250.000000 FUNCTION_LIST Messwerte /end CHARACTERISTIC
/begin CHARACTERISTIC K_TABG_DIAG_MAX "" VALUE 0x1E48 CONST_3 100.000000 F00015 -50.000000 1250.000000 FUNCTION_LIST Messwerte /end CHARACTERISTIC
/begin CHARACTERISTIC K_TABG_DIAG_SCHWELLE "" VALUE 0x1E4A CONST_3 100.000000 F00235 -50.000000 1250.000000 FUNCTION_LIST Messwerte /end CHARACTERISTIC
/begin CHARACTERISTIC K_TABG_DIAG_OBERHALB "" VALUE 0x1E4C CONST_2 100.000000 F00015 0.000000 1250.000000 FUNCTION_LIST Messwerte /end CHARACTERISTIC
/begin CHARACTERISTIC K_TABG_DIAG_UNTERHALB "" VALUE 0x1E4E CONST_2 100.000000 F00015 0.000000 1250.000000 FUNCTION_LIST Messwerte /end CHARACTERISTIC
/begin CHARACTERISTIC K_TABG_DIAG_TIME "" VALUE 0x1E50 CONST_2 100.000000 F00028 0.000000 6554.000000 FUNCTION_LIST Messwerte /end CHARACTERISTIC
/begin CHARACTERISTIC K_TABG_TAU "" VALUE 0x1E52 CONST_0 100.000000 F00195 25.000000 0.000000 FUNCTION_LIST Messwerte /end CHARACTERISTIC
/begin CHARACTERISTIC K_TABG_ERSATZ_TAU_F_SLP "" VALUE 0x1E53 CONST_0 100.000000 F00167 0.000000 15.000000 FUNCTION_LIST Messwerte /end CHARACTERISTIC
/begin CHARACTERISTIC K_TABG_ERSATZ_T_F_SLP "" VALUE 0x1E54 CONST_0 100.000000 F00003 0.000000 3.000000 FUNCTION_LIST Messwerte /end CHARACTERISTIC
/begin CHARACTERISTIC K_TAN_DIAG_MIN "" VALUE 0x1D7E CONST_0 100.000000 F00014 -48.000000 207.000000 FUNCTION_LIST Messwerte /end CHARACTERISTIC
/begin CHARACTERISTIC K_TAN_DIAG_MAX "" VALUE 0x1D7F CONST_0 100.000000 F00014 -48.000000 207.000000 FUNCTION_LIST Messwerte /end CHARACTERISTIC
/begin CHARACTERISTIC K_TAN_DIAG_T_UMG "" VALUE 0x1D80 CONST_0 100.000000 F00014 -48.000000 207.000000 FUNCTION_LIST Messwerte /end CHARACTERISTIC
/begin CHARACTERISTIC K_TAN_DIAG_V "" VALUE 0x1D82 CONST_2 100.000000 F00004 0.000000 360.000000 FUNCTION_LIST Messwerte /end CHARACTERISTIC
/begin CHARACTERISTIC K_TAN_DIAG_ML "" VALUE 0x1D84 CONST_2 100.000000 F00095 0.000000 1400.000000 FUNCTION_LIST Messwerte /end CHARACTERISTIC
/begin CHARACTERISTIC K_TAN_DIAG_TIME "" VALUE 0x1D86 CONST_2 100.000000 F00028 0.000000 6554.000000 FUNCTION_LIST Messwerte /end CHARACTERISTIC
/begin CHARACTERISTIC K_TAN_DIAG_SCHWELLE "" VALUE 0x1D88 CONST_0 100.000000 F00014 -48.000000 207.000000 FUNCTION_LIST Messwerte /end CHARACTERISTIC
/begin CHARACTERISTIC K_TAN_DIAG_DELTA "" VALUE 0x1D89 CONST_0 100.000000 F00015 0.000000 255.000000 FUNCTION_LIST Messwerte /end CHARACTERISTIC
/begin CHARACTERISTIC K_TAN_ERSATZ "" VALUE 0x1D8A CONST_0 100.000000 F00014 -48.000000 207.000000 FUNCTION_LIST Messwerte /end CHARACTERISTIC
/begin CHARACTERISTIC K_TAN_TAU "" VALUE 0x1D8B CONST_0 100.000000 F00019 0.000000 25500.000000 FUNCTION_LIST Messwerte /end CHARACTERISTIC
/begin CHARACTERISTIC K_TAN_DIAG_B_LL_TIME "" VALUE 0x1D8C CONST_0 100.000000 F00017 0.000000 255.000000 FUNCTION_LIST Messwerte /end CHARACTERISTIC
/begin CHARACTERISTIC K_TAN_DIAG_WARM_UP "" VALUE 0x1D8D CONST_0 100.000000 F00017 0.000000 255.000000 FUNCTION_LIST Messwerte /end CHARACTERISTIC
/begin CHARACTERISTIC K_TKATM_ANSPRING "" VALUE 0x1F74 CONST_3 100.000000 F00015 -50.000000 1250.000000 FUNCTION_LIST Messwerte /end CHARACTERISTIC
/begin CHARACTERISTIC K_TKATM_AUS_HYS "" VALUE 0x1F76 CONST_0 100.000000 F00015 0.000000 255.000000 FUNCTION_LIST Messwerte /end CHARACTERISTIC
/begin CHARACTERISTIC K_TKATM_EXOTHERM_MAX "" VALUE 0x1F77 CONST_0 100.000000 F00015 0.000000 255.000000 FUNCTION_LIST Messwerte /end CHARACTERISTIC
/begin CHARACTERISTIC K_TKATM_EXO_DELT_AUF "" VALUE 0x1F78 CONST_2 100.000000 F00237 0.000000 599.000000 FUNCTION_LIST Messwerte /end CHARACTERISTIC
/begin CHARACTERISTIC K_TKATM_EXO_DELT_AB "" VALUE 0x1F7A CONST_2 100.000000 F00237 0.000000 599.000000 FUNCTION_LIST Messwerte /end CHARACTERISTIC
/begin CHARACTERISTIC K_TDME_DIAG_MIN "" VALUE 0x1F20 CONST_0 100.000000 F00014 -48.000000 140.000000 FUNCTION_LIST Messwerte /end CHARACTERISTIC
/begin CHARACTERISTIC K_TDME_SCHWELLE_ZAEHLER "" VALUE 0x1F21 CONST_0 100.000000 F00014 -48.000000 140.000000 FUNCTION_LIST Messwerte /end CHARACTERISTIC
/begin CHARACTERISTIC K_TDME_ANSTIEG "" VALUE 0x1F22 CONST_0 100.000000 F00013 0.000000 254.000000 FUNCTION_LIST Messwerte /end CHARACTERISTIC
/begin CHARACTERISTIC K_TDME_ABFALL "" VALUE 0x1F23 CONST_0 100.000000 F00013 0.000000 254.000000 FUNCTION_LIST Messwerte /end CHARACTERISTIC
/begin CHARACTERISTIC K_TDME_DIAG_TIME_MIN "" VALUE 0x1F24 CONST_2 100.000000 F00017 0.000000 65535.000000 FUNCTION_LIST Messwerte /end CHARACTERISTIC
/begin CHARACTERISTIC K_TDME_RDKS "" VALUE 0x1F26 CONST_2 100.000000 F00239 0.000000 65535.000000 FUNCTION_LIST Messwerte /end CHARACTERISTIC
/begin CHARACTERISTIC K_TDME_RDKS_ZAEHLER "" VALUE 0x1F28 CONST_0 100.000000 F00013 0.000000 255.000000 FUNCTION_LIST Messwerte /end CHARACTERISTIC
/begin CHARACTERISTIC K_TMOT_STA "" VALUE 0x1DB0 CONST_0 100.000000 F00014 -48.000000 207.000000 FUNCTION_LIST Messwerte /end CHARACTERISTIC
/begin CHARACTERISTIC K_TMOT_STA_HYS "" VALUE 0x1DB1 CONST_0 100.000000 F00015 0.000000 20.000000 FUNCTION_LIST Messwerte /end CHARACTERISTIC
/begin CHARACTERISTIC K_TMOT_STA_TIME "" VALUE 0x1DB2 CONST_0 100.000000 F00017 0.000000 255.000000 FUNCTION_LIST Messwerte /end CHARACTERISTIC
/begin CHARACTERISTIC K_TMOT_OBD_START "" VALUE 0x1DB3 CONST_0 100.000000 F00014 -48.000000 207.000000 FUNCTION_LIST Messwerte /end CHARACTERISTIC
/begin CHARACTERISTIC K_TMOT_DIAG_WL "" VALUE 0x1DB4 CONST_0 100.000000 F00014 -48.000000 207.000000 FUNCTION_LIST Messwerte /end CHARACTERISTIC
/begin CHARACTERISTIC K_TMOT_DIAG_MIN "" VALUE 0x1DB5 CONST_0 100.000000 F00014 -48.000000 207.000000 FUNCTION_LIST Messwerte /end CHARACTERISTIC
/begin CHARACTERISTIC K_TMOT_DIAG_MAX "" VALUE 0x1DB6 CONST_0 100.000000 F00014 -48.000000 207.000000 FUNCTION_LIST Messwerte /end CHARACTERISTIC
/begin CHARACTERISTIC K_TMOT_DIAG_TAN "" VALUE 0x1DB7 CONST_0 100.000000 F00014 -48.000000 207.000000 FUNCTION_LIST Messwerte /end CHARACTERISTIC
/begin CHARACTERISTIC K_TMOT_DIAG_TKA "" VALUE 0x1DB8 CONST_0 100.000000 F00014 -48.000000 207.000000 FUNCTION_LIST Messwerte /end CHARACTERISTIC
/begin CHARACTERISTIC K_TMOT_THERMO_DELTA "" VALUE 0x1DB9 CONST_0 100.000000 F00015 0.000000 255.000000 FUNCTION_LIST Messwerte /end CHARACTERISTIC
/begin CHARACTERISTIC K_TMOT_TKA_DELTA "" VALUE 0x1DBA CONST_0 100.000000 F00015 0.000000 255.000000 FUNCTION_LIST Messwerte /end CHARACTERISTIC
/begin CHARACTERISTIC K_TMOT_BLOCKHEATER "" VALUE 0x1DBB CONST_0 100.000000 F00015 0.000000 255.000000 FUNCTION_LIST Messwerte /end CHARACTERISTIC
/begin CHARACTERISTIC K_TMOT_ERSATZ "" VALUE 0x1DBC CONST_0 100.000000 F00014 -48.000000 207.000000 FUNCTION_LIST Messwerte /end CHARACTERISTIC
/begin CHARACTERISTIC K_TMOT_TAU "" VALUE 0x1DBD CONST_0 100.000000 F00195 25.000000 0.000000 FUNCTION_LIST Messwerte /end CHARACTERISTIC
/begin CHARACTERISTIC K_TMOT_DIAG_TIME "" VALUE 0x1DBE CONST_0 100.000000 F00017 0.000000 255.000000 FUNCTION_LIST Messwerte /end CHARACTERISTIC
/begin CHARACTERISTIC K_TOG_ADAPT_STANDZEIT "" VALUE 0x1B60 CONST_2 100.000000 F00223 0.000000 65535.000000 FUNCTION_LIST Oelniveaugeber /end CHARACTERISTIC
/begin CHARACTERISTIC K_TOG_ADAPT_TMOT_MAX "" VALUE 0x1B62 CONST_0 100.000000 F00014 -48.000000 207.000000 FUNCTION_LIST Oelniveaugeber /end CHARACTERISTIC
/begin CHARACTERISTIC K_TOG_ADAPT_TMOT_MIN "" VALUE 0x1B63 CONST_0 100.000000 F00014 -48.000000 207.000000 FUNCTION_LIST Oelniveaugeber /end CHARACTERISTIC
/begin CHARACTERISTIC K_TOG_ADAPT_DIFF_MAX "" VALUE 0x1B64 CONST_1 100.000000 F00243 -128.000000 127.000000 FUNCTION_LIST Oelniveaugeber /end CHARACTERISTIC
/begin CHARACTERISTIC K_TOG_ADAPT_WARTEZEIT "" VALUE 0x1B65 CONST_0 100.000000 F00244 0.000000 25.000000 FUNCTION_LIST Oelniveaugeber /end CHARACTERISTIC
/begin CHARACTERISTIC K_TOG_ADAPT_ABREG "" VALUE 0x1B66 CONST_0 100.000000 F00245 0.000000 24.000000 FUNCTION_LIST Oelniveaugeber /end CHARACTERISTIC
/begin CHARACTERISTIC K_TOG_ADAPT_GEW_S "" VALUE 0x1B67 CONST_0 100.000000 F00246 0.000000 99.000000 FUNCTION_LIST Oelniveaugeber /end CHARACTERISTIC
/begin CHARACTERISTIC K_TOG_ADAPT_GEW_L "" VALUE 0x1B68 CONST_0 100.000000 F00246 0.000000 99.000000 FUNCTION_LIST Oelniveaugeber /end CHARACTERISTIC
/begin CHARACTERISTIC K_TOG_ADAPT_ANZ "" VALUE 0x1B69 CONST_0 100.000000 F00058 0.000000 255.000000 FUNCTION_LIST Oelniveaugeber /end CHARACTERISTIC
/begin CHARACTERISTIC K_TOG_ADAPT_TIMEOUT "" VALUE 0x1B6A CONST_2 100.000000 F00016 0.000000 64.000000 FUNCTION_LIST Oelniveaugeber /end CHARACTERISTIC
/begin CHARACTERISTIC K_TOG_ADAPT_OFFS_MAX "" VALUE 0x1B6C CONST_2 100.000000 F00247 0.000000 256.000000 FUNCTION_LIST Oelniveaugeber /end CHARACTERISTIC
/begin CHARACTERISTIC K_TOG_VL "" VALUE 0x1B6E CONST_0 100.000000 F00000 0.000000 255.000000 FUNCTION_LIST Oelniveaugeber /end CHARACTERISTIC
/begin CHARACTERISTIC K_TOG_VB1 "" VALUE 0x1B6F CONST_0 100.000000 F00000 0.000000 255.000000 FUNCTION_LIST Oelniveaugeber /end CHARACTERISTIC
/begin CHARACTERISTIC K_TOG_VB2 "" VALUE 0x1B70 CONST_0 100.000000 F00000 0.000000 255.000000 FUNCTION_LIST Oelniveaugeber /end CHARACTERISTIC
/begin CHARACTERISTIC K_TOG_TOEL "" VALUE 0x1B71 CONST_0 100.000000 F00014 -48.000000 180.000000 FUNCTION_LIST Oelniveaugeber /end CHARACTERISTIC
/begin CHARACTERISTIC K_TOG_IMP_MAX "" VALUE 0x1B72 CONST_2 100.000000 F00248 0.000000 5000.000000 FUNCTION_LIST Oelniveaugeber /end CHARACTERISTIC
/begin CHARACTERISTIC K_TOG_IMP_MIN "" VALUE 0x1B74 CONST_2 100.000000 F00248 0.000000 5000.000000 FUNCTION_LIST Oelniveaugeber /end CHARACTERISTIC
/begin CHARACTERISTIC K_TOG_HEIZ_MIN "" VALUE 0x1B76 CONST_2 100.000000 F00249 0.000000 800.000000 FUNCTION_LIST Oelniveaugeber /end CHARACTERISTIC
/begin CHARACTERISTIC K_TOG_HEIZ_MAX "" VALUE 0x1B78 CONST_2 100.000000 F00249 0.000000 838.000000 FUNCTION_LIST Oelniveaugeber /end CHARACTERISTIC
/begin CHARACTERISTIC K_TOG_OM_AUS "" VALUE 0x1B7A CONST_0 100.000000 F00013 0.000000 255.000000 FUNCTION_LIST Oelniveaugeber /end CHARACTERISTIC
/begin CHARACTERISTIC K_TOG_ED_T1 "" VALUE 0x1B7B CONST_0 100.000000 F00250 0.000000 180.000000 FUNCTION_LIST Oelniveaugeber /end CHARACTERISTIC
/begin CHARACTERISTIC K_TOG_P_COUNT "" VALUE 0x1B7C CONST_0 100.000000 F00013 0.000000 255.000000 FUNCTION_LIST Oelniveaugeber /end CHARACTERISTIC
/begin CHARACTERISTIC K_TOG_AL_ABS "" VALUE 0x1B7D CONST_0 100.000000 F00251 0.000000 10.000000 FUNCTION_LIST Oelniveaugeber /end CHARACTERISTIC
/begin CHARACTERISTIC K_TOG_TOEL_T_VER "" VALUE 0x1B7E CONST_2 100.000000 F00223 0.000000 65535.000000 FUNCTION_LIST Oelniveaugeber /end CHARACTERISTIC
/begin CHARACTERISTIC K_TOG_AQ_ABS "" VALUE 0x1B80 CONST_0 100.000000 F00251 0.000000 10.000000 FUNCTION_LIST Oelniveaugeber /end CHARACTERISTIC
/begin CHARACTERISTIC K_TOG_AQ_RECHTS "" VALUE 0x1B81 CONST_1 100.000000 F00193 -12.000000 12.000000 FUNCTION_LIST Oelniveaugeber /end CHARACTERISTIC
/begin CHARACTERISTIC K_TOG_VER_MWL "" VALUE 0x1B82 CONST_2 100.000000 F00250 0.000000 65535.000000 FUNCTION_LIST Oelniveaugeber /end CHARACTERISTIC
/begin CHARACTERISTIC K_TOG_A_SPERR_COUNT "" VALUE 0x1C5E CONST_2 100.000000 F00198 0.000000 6553.000000 FUNCTION_LIST Oelniveaugeber /end CHARACTERISTIC
/begin CHARACTERISTIC K_TOG_T_SEIT_START "" VALUE 0x1C60 CONST_2 100.000000 F00028 0.000000 6553.000000 FUNCTION_LIST Oelniveaugeber /end CHARACTERISTIC
/begin CHARACTERISTIC K_TOG_DTOEL "" VALUE 0x1C62 CONST_0 100.000000 F00252 0.000000 0.000000 FUNCTION_LIST Oelniveaugeber /end CHARACTERISTIC
/begin CHARACTERISTIC K_TOG_DTKA "" VALUE 0x1C63 CONST_0 100.000000 F00015 0.000000 10.000000 FUNCTION_LIST Oelniveaugeber /end CHARACTERISTIC
/begin CHARACTERISTIC K_TOG_TOEL_S "" VALUE 0x1C64 CONST_0 100.000000 F00014 -48.000000 180.000000 FUNCTION_LIST Oelniveaugeber /end CHARACTERISTIC
/begin CHARACTERISTIC K_TOG_TOEL_G "" VALUE 0x1C65 CONST_0 100.000000 F00014 -48.000000 180.000000 FUNCTION_LIST Oelniveaugeber /end CHARACTERISTIC
/begin CHARACTERISTIC K_TOG_MWL_KORR "" VALUE 0x1C66 CONST_1 100.000000 F00000 -6.000000 6.000000 FUNCTION_LIST Oelniveaugeber /end CHARACTERISTIC
/begin CHARACTERISTIC K_TOG_G_TKA "" VALUE 0x1C67 CONST_0 100.000000 F00099 0.000000 0.000000 FUNCTION_LIST Oelniveaugeber /end CHARACTERISTIC
/begin CHARACTERISTIC K_TOG_G_TOEL "" VALUE 0x1C68 CONST_0 100.000000 F00099 0.000000 0.000000 FUNCTION_LIST Oelniveaugeber /end CHARACTERISTIC
/begin CHARACTERISTIC K_TOG_TOEL_DIF "" VALUE 0x1C69 CONST_0 100.000000 F00253 0.000000 255.000000 FUNCTION_LIST Oelniveaugeber /end CHARACTERISTIC
/begin CHARACTERISTIC K_TOG_T_MOT_STEHT "" VALUE 0x1C8C CONST_2 100.000000 F00223 0.000000 65535.000000 FUNCTION_LIST Oelniveaugeber /end CHARACTERISTIC
/begin CHARACTERISTIC K_TOG_TOEL_ABREG "" VALUE 0x1CC2 CONST_0 100.000000 F00245 0.000000 24.000000 FUNCTION_LIST Oelniveaugeber /end CHARACTERISTIC
/begin CHARACTERISTIC K_TOG_UB_TOEL_ECK "" VALUE 0x1CC3 CONST_0 100.000000 F00014 -48.000000 207.000000 FUNCTION_LIST Oelniveaugeber /end CHARACTERISTIC
/begin CHARACTERISTIC K_NW_DETECT_M "" VALUE 0x34 CONST_0 100.000000 F00031 0.000000 255.000000 FUNCTION_LIST TPU_Synchronisation /end CHARACTERISTIC
/begin CHARACTERISTIC K_NW_MFMIN_M "" VALUE 0x35 CONST_0 100.000000 F00031 0.000000 255.000000 FUNCTION_LIST TPU_Synchronisation /end CHARACTERISTIC
/begin CHARACTERISTIC K_NW_MFMAX_M "" VALUE 0x36 CONST_0 100.000000 F00031 0.000000 255.000000 FUNCTION_LIST TPU_Synchronisation /end CHARACTERISTIC
/begin CHARACTERISTIC K_NW_MFERROR_M "" VALUE 0x37 CONST_0 100.000000 F00031 0.000000 255.000000 FUNCTION_LIST TPU_Synchronisation /end CHARACTERISTIC
/begin CHARACTERISTIC K_NW_MAX_FAIL_M "" VALUE 0x38 CONST_0 100.000000 F00031 0.000000 255.000000 FUNCTION_LIST TPU_Synchronisation /end CHARACTERISTIC
/begin CHARACTERISTIC K_TPU_N_TZ "" VALUE 0x3A CONST_2 100.000000 F00007 0.000000 10000.000000 FUNCTION_LIST TPU_Synchronisation /end CHARACTERISTIC
/begin CHARACTERISTIC K_TZ_ZYL_CONTROL "" VALUE 0x1470 CONST_0 100.000000 F00013 0.000000 255.000000 BIT_MASK 0xFF FUNCTION_LIST Zuendung /end CHARACTERISTIC
/begin CHARACTERISTIC K_TZ_MD_CONTROL "" VALUE 0x1471 CONST_0 100.000000 F00259 0.000000 255.000000 BIT_MASK 0xFF FUNCTION_LIST Zuendung /end CHARACTERISTIC
/begin CHARACTERISTIC K_TZ_KATH_CONTROL "" VALUE 0x1472 CONST_0 100.000000 F00260 0.000000 255.000000 BIT_MASK 0xFF FUNCTION_LIST Zuendung /end CHARACTERISTIC
/begin CHARACTERISTIC K_TZ_SZ_CONTROL "" VALUE 0x1473 CONST_0 100.000000 F00013 0.000000 255.000000 BIT_MASK 0xFF FUNCTION_LIST Zuendung /end CHARACTERISTIC
/begin CHARACTERISTIC K_TZ_SA_CONTROL "" VALUE 0x1474 CONST_0 100.000000 F00261 0.000000 255.000000 BIT_MASK 0xFF FUNCTION_LIST Zuendung /end CHARACTERISTIC
/begin CHARACTERISTIC K_TZ_KL15_NACHLAUF "" VALUE 0x1475 CONST_0 100.000000 F00262 0.000000 255.000000 FUNCTION_LIST Zuendung /end CHARACTERISTIC
/begin CHARACTERISTIC K_TZ_MAX "" VALUE 0x1476 CONST_3 100.000000 F00045 -50.000000 60.000000 FUNCTION_LIST Zuendung /end CHARACTERISTIC
/begin CHARACTERISTIC K_TZ_ZWB_B1 "" VALUE 0x1478 CONST_3 100.000000 F00263 0.000000 50.000000 FUNCTION_LIST Zuendung /end CHARACTERISTIC
/begin CHARACTERISTIC K_TZ_ZWB_B2 "" VALUE 0x147A CONST_3 100.000000 F00263 0.000000 50.000000 FUNCTION_LIST Zuendung /end CHARACTERISTIC
/begin CHARACTERISTIC K_TZ_ZWB_B3 "" VALUE 0x147C CONST_3 100.000000 F00263 0.000000 50.000000 FUNCTION_LIST Zuendung /end CHARACTERISTIC
/begin CHARACTERISTIC K_TZ_ZWB_DYN_KR "" VALUE 0x147E CONST_3 100.000000 F00263 0.000000 50.000000 FUNCTION_LIST Zuendung /end CHARACTERISTIC
/begin CHARACTERISTIC K_TZ_ZWB_DYN_DBGR "" VALUE 0x1480 CONST_3 100.000000 F00263 0.000000 50.000000 FUNCTION_LIST Zuendung /end CHARACTERISTIC
/begin CHARACTERISTIC K_TZ_DYN_KR_SEGM "" VALUE 0x1482 CONST_0 100.000000 F00262 0.000000 255.000000 FUNCTION_LIST Zuendung /end CHARACTERISTIC
/begin CHARACTERISTIC K_TZ_DYN_DBGR_SEGM "" VALUE 0x1483 CONST_0 100.000000 F00262 0.000000 255.000000 FUNCTION_LIST Zuendung /end CHARACTERISTIC
/begin CHARACTERISTIC K_TZ_RF_ZWB "" VALUE 0x1484 CONST_2 100.000000 F00068 0.000000 2.000000 FUNCTION_LIST Zuendung /end CHARACTERISTIC
/begin CHARACTERISTIC K_TZ_DN_ZWB "" VALUE 0x1486 CONST_2 100.000000 F00007 0.000000 10000.000000 FUNCTION_LIST Zuendung /end CHARACTERISTIC
/begin CHARACTERISTIC K_TZ_ZWB_WE_HARD "" VALUE 0x1488 CONST_3 100.000000 F00264 0.000000 100.000000 FUNCTION_LIST Zuendung /end CHARACTERISTIC
/begin CHARACTERISTIC K_TZ_WE_SEGM "" VALUE 0x148A CONST_0 100.000000 F00265 0.000000 255.000000 FUNCTION_LIST Zuendung /end CHARACTERISTIC
/begin CHARACTERISTIC K_TZ_MCS "" VALUE 0x14B0 CONST_3 100.000000 F00045 -50.000000 60.000000 FUNCTION_LIST Zuendung /end CHARACTERISTIC
/begin CHARACTERISTIC K_TZ_MCS_Z[1of8] "" VALUE 0x14B2 CONST_3 100.000000 F00045 -50.000000 60.000000 FUNCTION_LIST Zuendung /end CHARACTERISTIC
/begin CHARACTERISTIC K_TZ_MCS_Z[2of8] "" VALUE 0x14B4 CONST_3 100.000000 F00045 -50.000000 60.000000 FUNCTION_LIST Zuendung /end CHARACTERISTIC
/begin CHARACTERISTIC K_TZ_MCS_Z[3of8] "" VALUE 0x14B6 CONST_3 100.000000 F00045 -50.000000 60.000000 FUNCTION_LIST Zuendung /end CHARACTERISTIC
/begin CHARACTERISTIC K_TZ_MCS_Z[4of8] "" VALUE 0x14B8 CONST_3 100.000000 F00045 -50.000000 60.000000 FUNCTION_LIST Zuendung /end CHARACTERISTIC
/begin CHARACTERISTIC K_TZ_MCS_Z[5of8] "" VALUE 0x14BA CONST_3 100.000000 F00045 -50.000000 60.000000 FUNCTION_LIST Zuendung /end CHARACTERISTIC
/begin CHARACTERISTIC K_TZ_MCS_Z[6of8] "" VALUE 0x14BC CONST_3 100.000000 F00045 -50.000000 60.000000 FUNCTION_LIST Zuendung /end CHARACTERISTIC
/begin CHARACTERISTIC K_TZ_MCS_Z[7of8] "" VALUE 0x14BE CONST_3 100.000000 F00045 -50.000000 60.000000 FUNCTION_LIST Zuendung /end CHARACTERISTIC
/begin CHARACTERISTIC K_TZ_MCS_Z[8of8] "" VALUE 0x14C0 CONST_3 100.000000 F00045 -50.000000 60.000000 FUNCTION_LIST Zuendung /end CHARACTERISTIC
/begin CHARACTERISTIC K_TZ_NMIN_KL50ON "" VALUE 0x14C2 CONST_2 100.000000 F00007 0.000000 10000.000000 FUNCTION_LIST Zuendung /end CHARACTERISTIC
/begin CHARACTERISTIC K_TZ_NMIN_KL50OFF "" VALUE 0x14C4 CONST_2 100.000000 F00007 0.000000 10000.000000 FUNCTION_LIST Zuendung /end CHARACTERISTIC
/begin CHARACTERISTIC K_TZ_UB_ERSATZ "" VALUE 0x1898 CONST_0 100.000000 F00018 0.000000 20.000000 FUNCTION_LIST Zuendung /end CHARACTERISTIC
/begin CHARACTERISTIC K_TZ_KATH_START "" VALUE 0x192A CONST_2 100.000000 F00100 0.000000 2.000000 FUNCTION_LIST Zuendung /end CHARACTERISTIC
/begin CHARACTERISTIC K_TZ_KATH_T_AUFREG "" VALUE 0x192C CONST_2 100.000000 F00180 0.000000 9999.000000 FUNCTION_LIST Zuendung /end CHARACTERISTIC
/begin CHARACTERISTIC K_TZ_KATH_T_ABREG "" VALUE 0x192E CONST_2 100.000000 F00180 0.000000 9999.000000 FUNCTION_LIST Zuendung /end CHARACTERISTIC
/begin CHARACTERISTIC K_TZ_KATH_RF_CONTROL "" VALUE 0x1930 CONST_0 100.000000 F00266 0.000000 255.000000 FUNCTION_LIST Zuendung /end CHARACTERISTIC
/begin CHARACTERISTIC K_TZ_AUSS_BEREICH "" VALUE 0x1AF0 CONST_0 100.000000 F00031 0.000000 255.000000 FUNCTION_LIST Zuendung /end CHARACTERISTIC
/begin CHARACTERISTIC K_TZ_AUSS_ANZ "" VALUE 0x1AF1 CONST_0 100.000000 F00031 0.000000 255.000000 FUNCTION_LIST Zuendung /end CHARACTERISTIC
/begin CHARACTERISTIC K_TZ_AUSS_ZYL "" VALUE 0x1AF2 CONST_0 100.000000 F00031 0.000000 255.000000 FUNCTION_LIST Zuendung /end CHARACTERISTIC
/begin CHARACTERISTIC K_TZ_AUSS_CFG "" VALUE 0x1AF3 CONST_0 100.000000 F00267 0.000000 255.000000 FUNCTION_LIST Zuendung /end CHARACTERISTIC
/begin CHARACTERISTIC K_UEXTM_TAU "" VALUE 0x1FCA CONST_0 100.000000 F00196 2.000000 0.000000 FUNCTION_LIST Messwerte /end CHARACTERISTIC
/begin CHARACTERISTIC K_UEXTM_DIAG_MIN "" VALUE 0x1FCB CONST_0 100.000000 F00270 3.000000 4.000000 FUNCTION_LIST Messwerte /end CHARACTERISTIC
/begin CHARACTERISTIC K_UEXTM_DIAG_MAX "" VALUE 0x1FCC CONST_0 100.000000 F00270 5.000000 6.000000 FUNCTION_LIST Messwerte /end CHARACTERISTIC
/begin CHARACTERISTIC K_UEXTM_ERSATZ "" VALUE 0x1FCD CONST_0 100.000000 F00270 3.000000 6.000000 FUNCTION_LIST Messwerte /end CHARACTERISTIC
/begin CHARACTERISTIC K_V_WEGIMPULSZAHL "" VALUE 0x1FCE CONST_2 100.000000 F00031 0.000000 65535.000000 FUNCTION_LIST Fz_Geschwindigkeit /end CHARACTERISTIC
/begin CHARACTERISTIC K_V_TAU_GRAD "" VALUE 0x1FD0 CONST_0 100.000000 F00195 25.000000 0.000000 FUNCTION_LIST Fz_Geschwindigkeit /end CHARACTERISTIC
/begin CHARACTERISTIC K_VDIAG_VMAX "" VALUE 0x1FD2 CONST_2 100.000000 F00079 0.000000 360.000000 FUNCTION_LIST Fz_Geschwindigkeit /end CHARACTERISTIC
/begin CHARACTERISTIC K_VDIAG_OFFSET "" VALUE 0x1FD4 CONST_2 100.000000 F00079 0.000000 360.000000 FUNCTION_LIST Fz_Geschwindigkeit /end CHARACTERISTIC
/begin CHARACTERISTIC K_VDIAG_GRAD_MAX "" VALUE 0x1FD6 CONST_2 100.000000 F00271 0.000000 360.000000 FUNCTION_LIST Fz_Geschwindigkeit /end CHARACTERISTIC
/begin CHARACTERISTIC K_VDIAG_SA_OHNE_V "" VALUE 0x1FD8 CONST_2 100.000000 F00016 0.000000 64.000000 FUNCTION_LIST Fz_Geschwindigkeit /end CHARACTERISTIC
/begin CHARACTERISTIC K_VDIAG_DN_OHNE_V "" VALUE 0x1FDA CONST_3 100.000000 F00142 -10000.000000 10000.000000 FUNCTION_LIST Fz_Geschwindigkeit /end CHARACTERISTIC
/begin CHARACTERISTIC K_V_CONTROL "" VALUE 0x1FDC CONST_0 100.000000 F00272 0.000000 1.000000 FUNCTION_LIST Fz_Geschwindigkeit /end CHARACTERISTIC
/begin CHARACTERISTIC K_VERS_UP_M "" VALUE 0x0 CONST_0 100.000000 F00273 0.000000 255.000000 FUNCTION_LIST Versionskontrolle /end CHARACTERISTIC
/begin CHARACTERISTIC K_VERS_NAME_M "" VALUE 0x1 CONST_0 100.000000 F00274 0.000000 255.000000 FUNCTION_LIST Versionskontrolle /end CHARACTERISTIC
/begin CHARACTERISTIC K_VERS_PROGR_M "" VALUE 0x2 CONST_2 100.000000 F00031 0.000000 65535.000000 FUNCTION_LIST Versionskontrolle /end CHARACTERISTIC
/begin CHARACTERISTIC K_VERS_DATEN_M "" VALUE 0x4 CONST_2 100.000000 F00031 0.000000 65535.000000 FUNCTION_LIST Versionskontrolle /end CHARACTERISTIC
/begin CHARACTERISTIC K_WDK_SPRING_VERGESSEN "" VALUE 0x1CD8 CONST_0 100.000000 F00048 0.000000 1.000000 FUNCTION_LIST Messwerte /end CHARACTERISTIC
/begin CHARACTERISTIC K_WDK_SPRING_DELTA_MAX "" VALUE 0x1CDA CONST_2 100.000000 F00048 0.000000 6000.000000 FUNCTION_LIST Messwerte /end CHARACTERISTIC
/begin CHARACTERISTIC K_WDK_RF_IO_DIFF "" VALUE 0x1CDC CONST_0 100.000000 F00013 1.000000 16.000000 FUNCTION_LIST Messwerte /end CHARACTERISTIC
/begin CHARACTERISTIC K_WDK_WELLE_EGAS_SOLL "" VALUE 0x1CDD CONST_0 100.000000 F00048 0.000000 25.000000 FUNCTION_LIST Messwerte /end CHARACTERISTIC
/begin CHARACTERISTIC K_WDK_A0_DELTA_MAX "" VALUE 0x1CDE CONST_2 100.000000 F00207 0.000000 1.000000 FUNCTION_LIST Messwerte /end CHARACTERISTIC
/begin CHARACTERISTIC K_WDK2_A0_DELTA_MAX "" VALUE 0x1CE0 CONST_2 100.000000 F00207 0.000000 1.000000 FUNCTION_LIST Messwerte /end CHARACTERISTIC
/begin CHARACTERISTIC K_WDK_A100_DELTA_MAX "" VALUE 0x1CE2 CONST_2 100.000000 F00207 0.000000 1.000000 FUNCTION_LIST Messwerte /end CHARACTERISTIC
/begin CHARACTERISTIC K_WDK_MAX_DIFF_FAK "" VALUE 0x1CE4 CONST_0 100.000000 F00056 1.000000 1.000000 FUNCTION_LIST Messwerte /end CHARACTERISTIC
/begin CHARACTERISTIC K_WDK1_MIN "" VALUE 0x1CE6 CONST_2 100.000000 F00207 0.000000 5.000000 FUNCTION_LIST Messwerte /end CHARACTERISTIC
/begin CHARACTERISTIC K_WDK2_MIN "" VALUE 0x1CE8 CONST_2 100.000000 F00207 0.000000 5.000000 FUNCTION_LIST Messwerte /end CHARACTERISTIC
/begin CHARACTERISTIC K_WDK1_MAX "" VALUE 0x1CEA CONST_2 100.000000 F00207 0.000000 5.000000 FUNCTION_LIST Messwerte /end CHARACTERISTIC
/begin CHARACTERISTIC K_WDK2_MAX "" VALUE 0x1CEC CONST_2 100.000000 F00207 0.000000 5.000000 FUNCTION_LIST Messwerte /end CHARACTERISTIC
/begin CHARACTERISTIC K_WDK1_A0_MIN "" VALUE 0x1CEE CONST_2 100.000000 F00207 0.000000 5.000000 FUNCTION_LIST Messwerte /end CHARACTERISTIC
/begin CHARACTERISTIC K_WDK2_A0_MIN "" VALUE 0x1CF0 CONST_2 100.000000 F00207 0.000000 5.000000 FUNCTION_LIST Messwerte /end CHARACTERISTIC
/begin CHARACTERISTIC K_WDK1_A0_MAX "" VALUE 0x1CF2 CONST_2 100.000000 F00207 0.000000 5.000000 FUNCTION_LIST Messwerte /end CHARACTERISTIC
/begin CHARACTERISTIC K_WDK2_A0_MAX "" VALUE 0x1CF4 CONST_2 100.000000 F00207 0.000000 5.000000 FUNCTION_LIST Messwerte /end CHARACTERISTIC
/begin CHARACTERISTIC K_WDK1_NORM_MIN "" VALUE 0x1CF6 CONST_2 100.000000 F00206 0.000000 654.000000 FUNCTION_LIST Messwerte /end CHARACTERISTIC
/begin CHARACTERISTIC K_WDK2_NORM_MIN "" VALUE 0x1CF8 CONST_2 100.000000 F00206 0.000000 654.000000 FUNCTION_LIST Messwerte /end CHARACTERISTIC
/begin CHARACTERISTIC K_WDK1_NORM_MAX "" VALUE 0x1CFA CONST_2 100.000000 F00206 0.000000 654.000000 FUNCTION_LIST Messwerte /end CHARACTERISTIC
/begin CHARACTERISTIC K_WDK2_NORM_MAX "" VALUE 0x1CFC CONST_2 100.000000 F00206 0.000000 654.000000 FUNCTION_LIST Messwerte /end CHARACTERISTIC
/begin CHARACTERISTIC K_WDK_A0_TAU "" VALUE 0x1CFE CONST_0 100.000000 F00195 25.000000 0.000000 FUNCTION_LIST Messwerte /end CHARACTERISTIC
/begin CHARACTERISTIC K_WDK_WELLE_EDK_DELTA "" VALUE 0x1CFF CONST_0 100.000000 F00048 0.000000 25.000000 FUNCTION_LIST Messwerte /end CHARACTERISTIC
/begin CHARACTERISTIC K_WDK_ADAPT_A0_SPERRE "" VALUE 0x1D00 CONST_0 100.000000 F00028 0.000000 25.000000 FUNCTION_LIST Messwerte /end CHARACTERISTIC
/begin CHARACTERISTIC K_WDK_INC_A0_ADAPT "" VALUE 0x1D01 CONST_0 100.000000 F00207 0.000000 1.000000 FUNCTION_LIST Messwerte /end CHARACTERISTIC
/begin CHARACTERISTIC K_WDK_A0_ZAEHLER "" VALUE 0x1D02 CONST_0 100.000000 F00013 1.000000 255.000000 FUNCTION_LIST Messwerte /end CHARACTERISTIC
/begin CHARACTERISTIC K_WDK_A0_ANZAHL "" VALUE 0x1D03 CONST_0 100.000000 F00013 1.000000 255.000000 FUNCTION_LIST Messwerte /end CHARACTERISTIC
/begin CHARACTERISTIC K_WDK_A100_ANZAHL "" VALUE 0x1D04 CONST_0 100.000000 F00013 1.000000 255.000000 FUNCTION_LIST Messwerte /end CHARACTERISTIC
/begin CHARACTERISTIC K_WDK_DIAG_CYCL "" VALUE 0x1D05 CONST_0 100.000000 F00013 0.000000 255.000000 FUNCTION_LIST Messwerte /end CHARACTERISTIC
/begin CHARACTERISTIC K_WDK_A100_ADAPT "" VALUE 0x1D06 CONST_0 100.000000 F00110 0.000000 1.000000 FUNCTION_LIST Messwerte /end CHARACTERISTIC
/begin CHARACTERISTIC K_WDK1_A100_OFFSET "" VALUE 0x1D07 CONST_0 100.000000 F00207 0.000000 1.000000 FUNCTION_LIST Messwerte /end CHARACTERISTIC
/begin CHARACTERISTIC K_WDK2_A100_OFFSET "" VALUE 0x1D08 CONST_0 100.000000 F00207 0.000000 1.000000 FUNCTION_LIST Messwerte /end CHARACTERISTIC
/begin CHARACTERISTIC K_WDK_A100_ADAPT_TMOT "" VALUE 0x1D09 CONST_0 100.000000 F00014 -48.000000 207.000000 FUNCTION_LIST Messwerte /end CHARACTERISTIC
/begin CHARACTERISTIC K_WDK_RF_IO_OFF "" VALUE 0x1D0A CONST_2 100.000000 F00068 0.000000 2.000000 FUNCTION_LIST Messwerte /end CHARACTERISTIC
/begin CHARACTERISTIC K_WDK_RF_IO_FAK "" VALUE 0x1D0C CONST_0 100.000000 F00099 0.000000 0.000000 FUNCTION_LIST Messwerte /end CHARACTERISTIC
/begin CHARACTERISTIC K_WDK_RF_ED_CNT "" VALUE 0x1D0D CONST_0 100.000000 F00013 0.000000 255.000000 FUNCTION_LIST Messwerte /end CHARACTERISTIC
/begin CHARACTERISTIC K_WDK_NULLAGE "" VALUE 0x1D0E CONST_2 100.000000 F00048 0.000000 100.000000 FUNCTION_LIST Messwerte /end CHARACTERISTIC
/begin CHARACTERISTIC K_WDK2_INVERS "" VALUE 0x1D10 CONST_0 100.000000 F00275 0.000000 1.000000 FUNCTION_LIST Messwerte /end CHARACTERISTIC
/begin CHARACTERISTIC K_BZ_N_MIN_SYNC "" VALUE 0x13F0 CONST_2 100.000000 F00007 0.000000 500.000000 FUNCTION_LIST Betriebszustaende /end CHARACTERISTIC
/begin CHARACTERISTIC K_BZ_N_MIN_HYST "" VALUE 0x13F2 CONST_2 100.000000 F00007 0.000000 100.000000 FUNCTION_LIST Betriebszustaende /end CHARACTERISTIC
/begin CHARACTERISTIC K_BZ_WDK_LL_HYST "" VALUE 0x13F4 CONST_2 100.000000 F00048 0.000000 20.000000 FUNCTION_LIST Betriebszustaende /end CHARACTERISTIC
/begin CHARACTERISTIC K_BZ_WDK_VL_HYST "" VALUE 0x13F6 CONST_2 100.000000 F00048 0.000000 20.000000 FUNCTION_LIST Betriebszustaende /end CHARACTERISTIC
/begin CHARACTERISTIC K_BZ_MD_LL "" VALUE 0x13F8 CONST_2 100.000000 F00145 0.000000 1000.000000 FUNCTION_LIST Betriebszustaende /end CHARACTERISTIC
/begin CHARACTERISTIC K_BZ_MD_LL_HYST "" VALUE 0x13FA CONST_2 100.000000 F00145 0.000000 1000.000000 FUNCTION_LIST Betriebszustaende /end CHARACTERISTIC
/begin CHARACTERISTIC K_BZ_T_NL "" VALUE 0x13FC CONST_0 100.000000 F00043 0.000000 255.000000 FUNCTION_LIST Betriebszustaende /end CHARACTERISTIC
/begin CHARACTERISTIC K_BZ_DIAG_T_RELATIV "" VALUE 0x13FD CONST_0 100.000000 F00276 0.000000 255.000000 FUNCTION_LIST Betriebszustaende /end CHARACTERISTIC
/begin CHARACTERISTIC K_BZ_N_MIN_NL "" VALUE 0x13FE CONST_2 100.000000 F00007 0.000000 10000.000000 FUNCTION_LIST Betriebszustaende /end CHARACTERISTIC
/begin CHARACTERISTIC K_ED_CONTROL "" VALUE 0x3800 CONST_2 100.000000 F00031 0.000000 1.000000 FUNCTION_LIST Eigendiagnose /end CHARACTERISTIC
/begin CHARACTERISTIC K_FSP_CONCEPT "" VALUE 0x3802 CONST_0 100.000000 F00277 0.000000 1.000000 FUNCTION_LIST Eigendiagnose /end CHARACTERISTIC
/begin CHARACTERISTIC K_FSP_TIMER "" VALUE 0x3803 CONST_0 100.000000 F00278 0.000000 1.000000 FUNCTION_LIST Eigendiagnose /end CHARACTERISTIC
/begin CHARACTERISTIC K_DS2_VMAX "" VALUE 0x3804 CONST_0 100.000000 F00004 0.000000 255.000000 FUNCTION_LIST Eigendiagnose /end CHARACTERISTIC
/begin CHARACTERISTIC K_MIL_CONTROL "" VALUE 0x3F08 CONST_0 100.000000 F00031 0.000000 255.000000 FUNCTION_LIST NO_FUNCTION /end CHARACTERISTIC
/begin CHARACTERISTIC K_MIL_PERIODE "" VALUE 0x3F09 CONST_0 100.000000 F00019 0.000000 2500.000000 FUNCTION_LIST NO_FUNCTION /end CHARACTERISTIC
/begin CHARACTERISTIC K_DCY_N_MIN "" VALUE 0x3F0A CONST_2 100.000000 F00279 0.000000 1000.000000 FUNCTION_LIST NO_FUNCTION /end CHARACTERISTIC
/begin CHARACTERISTIC K_DCY_DELAY "" VALUE 0x3F0C CONST_0 100.000000 F00043 0.000000 5.000000 FUNCTION_LIST NO_FUNCTION /end CHARACTERISTIC
/begin CHARACTERISTIC K_TMOT_OBD_WARM "" VALUE 0x3F0D CONST_0 100.000000 F00280 -48.000000 207.000000 FUNCTION_LIST NO_FUNCTION /end CHARACTERISTIC
/begin CHARACTERISTIC K_ED_FIL_CTL[1] "" VALUE 0x3820 CONST_0 100.000000 F00058 0.000000 255.000000 FUNCTION_LIST Fehlerfilter Kontrolle /end CHARACTERISTIC
/begin CHARACTERISTIC K_ED_FIL_CTL[2] "" VALUE 0x382E CONST_0 100.000000 F00058 0.000000 255.000000 FUNCTION_LIST Fehlerfilter Kontrolle /end CHARACTERISTIC
/begin CHARACTERISTIC K_ED_FIL_CTL[3] "" VALUE 0x383C CONST_0 100.000000 F00058 0.000000 255.000000 FUNCTION_LIST Fehlerfilter Kontrolle /end CHARACTERISTIC
/begin CHARACTERISTIC K_ED_FIL_CTL[4] "" VALUE 0x384A CONST_0 100.000000 F00058 0.000000 255.000000 FUNCTION_LIST Fehlerfilter Kontrolle /end CHARACTERISTIC
/begin CHARACTERISTIC K_ED_FIL_CTL[5] "" VALUE 0x3858 CONST_0 100.000000 F00058 0.000000 255.000000 FUNCTION_LIST Fehlerfilter Kontrolle /end CHARACTERISTIC
/begin CHARACTERISTIC K_ED_FIL_CTL[6] "" VALUE 0x3866 CONST_0 100.000000 F00058 0.000000 255.000000 FUNCTION_LIST Fehlerfilter Kontrolle /end CHARACTERISTIC
/begin CHARACTERISTIC K_ED_FIL_CTL[7] "" VALUE 0x3874 CONST_0 100.000000 F00058 0.000000 255.000000 FUNCTION_LIST Fehlerfilter Kontrolle /end CHARACTERISTIC
/begin CHARACTERISTIC K_ED_FIL_CTL[8] "" VALUE 0x3882 CONST_0 100.000000 F00058 0.000000 255.000000 FUNCTION_LIST Fehlerfilter Kontrolle /end CHARACTERISTIC
/begin CHARACTERISTIC K_ED_FIL_CTL[9] "" VALUE 0x3890 CONST_0 100.000000 F00058 0.000000 255.000000 FUNCTION_LIST Fehlerfilter Kontrolle /end CHARACTERISTIC
/begin CHARACTERISTIC K_ED_FIL_CTL[10] "" VALUE 0x389E CONST_0 100.000000 F00058 0.000000 255.000000 FUNCTION_LIST Fehlerfilter Kontrolle /end CHARACTERISTIC
/begin CHARACTERISTIC K_ED_FIL_CTL[11] "" VALUE 0x38AC CONST_0 100.000000 F00058 0.000000 255.000000 FUNCTION_LIST Fehlerfilter Kontrolle /end CHARACTERISTIC
/begin CHARACTERISTIC K_ED_FIL_CTL[12] "" VALUE 0x38BA CONST_0 100.000000 F00058 0.000000 255.000000 FUNCTION_LIST Fehlerfilter Kontrolle /end CHARACTERISTIC
/begin CHARACTERISTIC K_ED_FIL_CTL[13] "" VALUE 0x38C8 CONST_0 100.000000 F00058 0.000000 255.000000 FUNCTION_LIST Fehlerfilter Kontrolle /end CHARACTERISTIC
/begin CHARACTERISTIC K_ED_FIL_CTL[14] "" VALUE 0x38D6 CONST_0 100.000000 F00058 0.000000 255.000000 FUNCTION_LIST Fehlerfilter Kontrolle /end CHARACTERISTIC
/begin CHARACTERISTIC K_ED_FIL_CTL[15] "" VALUE 0x38E4 CONST_0 100.000000 F00058 0.000000 255.000000 FUNCTION_LIST Fehlerfilter Kontrolle /end CHARACTERISTIC
/begin CHARACTERISTIC K_ED_FIL_CTL[16] "" VALUE 0x38F2 CONST_0 100.000000 F00058 0.000000 255.000000 FUNCTION_LIST Fehlerfilter Kontrolle /end CHARACTERISTIC
/begin CHARACTERISTIC K_ED_FIL_CTL[17] "" VALUE 0x3900 CONST_0 100.000000 F00058 0.000000 255.000000 FUNCTION_LIST Fehlerfilter Kontrolle /end CHARACTERISTIC
/begin CHARACTERISTIC K_ED_FIL_CTL[18] "" VALUE 0x390E CONST_0 100.000000 F00058 0.000000 255.000000 FUNCTION_LIST Fehlerfilter Kontrolle /end CHARACTERISTIC
/begin CHARACTERISTIC K_ED_FIL_CTL[19] "" VALUE 0x391C CONST_0 100.000000 F00058 0.000000 255.000000 FUNCTION_LIST Fehlerfilter Kontrolle /end CHARACTERISTIC
/begin CHARACTERISTIC K_ED_FIL_CTL[20] "" VALUE 0x392A CONST_0 100.000000 F00058 0.000000 255.000000 FUNCTION_LIST Fehlerfilter Kontrolle /end CHARACTERISTIC
/begin CHARACTERISTIC K_ED_FIL_CTL[21] "" VALUE 0x3938 CONST_0 100.000000 F00058 0.000000 255.000000 FUNCTION_LIST Fehlerfilter Kontrolle /end CHARACTERISTIC
/begin CHARACTERISTIC K_ED_FIL_CTL[22] "" VALUE 0x3946 CONST_0 100.000000 F00058 0.000000 255.000000 FUNCTION_LIST Fehlerfilter Kontrolle /end CHARACTERISTIC
/begin CHARACTERISTIC K_ED_FIL_CTL[23] "" VALUE 0x3954 CONST_0 100.000000 F00058 0.000000 255.000000 FUNCTION_LIST Fehlerfilter Kontrolle /end CHARACTERISTIC
/begin CHARACTERISTIC K_ED_FIL_CTL[24] "" VALUE 0x3962 CONST_0 100.000000 F00058 0.000000 255.000000 FUNCTION_LIST Fehlerfilter Kontrolle /end CHARACTERISTIC
/begin CHARACTERISTIC K_ED_FIL_CTL[25] "" VALUE 0x3970 CONST_0 100.000000 F00058 0.000000 255.000000 FUNCTION_LIST Fehlerfilter Kontrolle /end CHARACTERISTIC
/begin CHARACTERISTIC K_ED_FIL_CTL[26] "" VALUE 0x397E CONST_0 100.000000 F00058 0.000000 255.000000 FUNCTION_LIST Fehlerfilter Kontrolle /end CHARACTERISTIC
/begin CHARACTERISTIC K_ED_FIL_CTL[27] "" VALUE 0x398C CONST_0 100.000000 F00058 0.000000 255.000000 FUNCTION_LIST Fehlerfilter Kontrolle /end CHARACTERISTIC
/begin CHARACTERISTIC K_ED_FIL_CTL[28] "" VALUE 0x399A CONST_0 100.000000 F00058 0.000000 255.000000 FUNCTION_LIST Fehlerfilter Kontrolle /end CHARACTERISTIC
/begin CHARACTERISTIC K_ED_FIL_CTL[29] "" VALUE 0x39A8 CONST_0 100.000000 F00058 0.000000 255.000000 FUNCTION_LIST Fehlerfilter Kontrolle /end CHARACTERISTIC
/begin CHARACTERISTIC K_ED_FIL_CTL[30] "" VALUE 0x39B6 CONST_0 100.000000 F00058 0.000000 255.000000 FUNCTION_LIST Fehlerfilter Kontrolle /end CHARACTERISTIC
/begin CHARACTERISTIC K_ED_FIL_CTL[31] "" VALUE 0x39C4 CONST_0 100.000000 F00058 0.000000 255.000000 FUNCTION_LIST Fehlerfilter Kontrolle /end CHARACTERISTIC
/begin CHARACTERISTIC K_ED_FIL_CTL[32] "" VALUE 0x39D2 CONST_0 100.000000 F00058 0.000000 255.000000 FUNCTION_LIST Fehlerfilter Kontrolle /end CHARACTERISTIC
/begin CHARACTERISTIC K_ED_FIL_CTL[33] "" VALUE 0x39E0 CONST_0 100.000000 F00058 0.000000 255.000000 FUNCTION_LIST Fehlerfilter Kontrolle /end CHARACTERISTIC
/begin CHARACTERISTIC K_ED_FIL_CTL[34] "" VALUE 0x39EE CONST_0 100.000000 F00058 0.000000 255.000000 FUNCTION_LIST Fehlerfilter Kontrolle /end CHARACTERISTIC
/begin CHARACTERISTIC K_ED_FIL_CTL[35] "" VALUE 0x39FC CONST_0 100.000000 F00058 0.000000 255.000000 FUNCTION_LIST Fehlerfilter Kontrolle /end CHARACTERISTIC
/begin CHARACTERISTIC K_ED_FIL_CTL[36] "" VALUE 0x3A0A CONST_0 100.000000 F00058 0.000000 255.000000 FUNCTION_LIST Fehlerfilter Kontrolle /end CHARACTERISTIC
/begin CHARACTERISTIC K_ED_FIL_CTL[37] "" VALUE 0x3A18 CONST_0 100.000000 F00058 0.000000 255.000000 FUNCTION_LIST Fehlerfilter Kontrolle /end CHARACTERISTIC
/begin CHARACTERISTIC K_ED_FIL_CTL[38] "" VALUE 0x3A26 CONST_0 100.000000 F00058 0.000000 255.000000 FUNCTION_LIST Fehlerfilter Kontrolle /end CHARACTERISTIC
/begin CHARACTERISTIC K_ED_FIL_CTL[39] "" VALUE 0x3A34 CONST_0 100.000000 F00058 0.000000 255.000000 FUNCTION_LIST Fehlerfilter Kontrolle /end CHARACTERISTIC
/begin CHARACTERISTIC K_ED_FIL_CTL[40] "" VALUE 0x3A42 CONST_0 100.000000 F00058 0.000000 255.000000 FUNCTION_LIST Fehlerfilter Kontrolle /end CHARACTERISTIC
/begin CHARACTERISTIC K_ED_FIL_CTL[41] "" VALUE 0x3A50 CONST_0 100.000000 F00058 0.000000 255.000000 FUNCTION_LIST Fehlerfilter Kontrolle /end CHARACTERISTIC
/begin CHARACTERISTIC K_ED_FIL_CTL[42] "" VALUE 0x3A5E CONST_0 100.000000 F00058 0.000000 255.000000 FUNCTION_LIST Fehlerfilter Kontrolle /end CHARACTERISTIC
/begin CHARACTERISTIC K_ED_FIL_CTL[43] "" VALUE 0x3A6C CONST_0 100.000000 F00058 0.000000 255.000000 FUNCTION_LIST Fehlerfilter Kontrolle /end CHARACTERISTIC
/begin CHARACTERISTIC K_ED_FIL_CTL[44] "" VALUE 0x3A7A CONST_0 100.000000 F00058 0.000000 255.000000 FUNCTION_LIST Fehlerfilter Kontrolle /end CHARACTERISTIC
/begin CHARACTERISTIC K_ED_FIL_CTL[45] "" VALUE 0x3A88 CONST_0 100.000000 F00058 0.000000 255.000000 FUNCTION_LIST Fehlerfilter Kontrolle /end CHARACTERISTIC
/begin CHARACTERISTIC K_ED_FIL_CTL[46] "" VALUE 0x3A96 CONST_0 100.000000 F00058 0.000000 255.000000 FUNCTION_LIST Fehlerfilter Kontrolle /end CHARACTERISTIC
/begin CHARACTERISTIC K_ED_FIL_CTL[47] "" VALUE 0x3AA4 CONST_0 100.000000 F00058 0.000000 255.000000 FUNCTION_LIST Fehlerfilter Kontrolle /end CHARACTERISTIC
/begin CHARACTERISTIC K_ED_FIL_CTL[48] "" VALUE 0x3AB2 CONST_0 100.000000 F00058 0.000000 255.000000 FUNCTION_LIST Fehlerfilter Kontrolle /end CHARACTERISTIC
/begin CHARACTERISTIC K_ED_FIL_CTL[49] "" VALUE 0x3AC0 CONST_0 100.000000 F00058 0.000000 255.000000 FUNCTION_LIST Fehlerfilter Kontrolle /end CHARACTERISTIC
/begin CHARACTERISTIC K_ED_FIL_CTL[50] "" VALUE 0x3ACE CONST_0 100.000000 F00058 0.000000 255.000000 FUNCTION_LIST Fehlerfilter Kontrolle /end CHARACTERISTIC
/begin CHARACTERISTIC K_ED_FIL_CTL[51] "" VALUE 0x3ADC CONST_0 100.000000 F00058 0.000000 255.000000 FUNCTION_LIST Fehlerfilter Kontrolle /end CHARACTERISTIC
/begin CHARACTERISTIC K_ED_FIL_CTL[52] "" VALUE 0x3AEA CONST_0 100.000000 F00058 0.000000 255.000000 FUNCTION_LIST Fehlerfilter Kontrolle /end CHARACTERISTIC
/begin CHARACTERISTIC K_ED_FIL_CTL[53] "" VALUE 0x3AF8 CONST_0 100.000000 F00058 0.000000 255.000000 FUNCTION_LIST Fehlerfilter Kontrolle /end CHARACTERISTIC
/begin CHARACTERISTIC K_ED_FIL_CTL[54] "" VALUE 0x3B06 CONST_0 100.000000 F00058 0.000000 255.000000 FUNCTION_LIST Fehlerfilter Kontrolle /end CHARACTERISTIC
/begin CHARACTERISTIC K_ED_FIL_CTL[55] "" VALUE 0x3B14 CONST_0 100.000000 F00058 0.000000 255.000000 FUNCTION_LIST Fehlerfilter Kontrolle /end CHARACTERISTIC
/begin CHARACTERISTIC K_ED_FIL_CTL[56] "" VALUE 0x3B22 CONST_0 100.000000 F00058 0.000000 255.000000 FUNCTION_LIST Fehlerfilter Kontrolle /end CHARACTERISTIC
/begin CHARACTERISTIC K_ED_FIL_CTL[57] "" VALUE 0x3B30 CONST_0 100.000000 F00058 0.000000 255.000000 FUNCTION_LIST Fehlerfilter Kontrolle /end CHARACTERISTIC
/begin CHARACTERISTIC K_ED_FIL_CTL[58] "" VALUE 0x3B3E CONST_0 100.000000 F00058 0.000000 255.000000 FUNCTION_LIST Fehlerfilter Kontrolle /end CHARACTERISTIC
/begin CHARACTERISTIC K_ED_FIL_CTL[59] "" VALUE 0x3B4C CONST_0 100.000000 F00058 0.000000 255.000000 FUNCTION_LIST Fehlerfilter Kontrolle /end CHARACTERISTIC
/begin CHARACTERISTIC K_ED_FIL_CTL[60] "" VALUE 0x3B5A CONST_0 100.000000 F00058 0.000000 255.000000 FUNCTION_LIST Fehlerfilter Kontrolle /end CHARACTERISTIC
/begin CHARACTERISTIC K_ED_FIL_CTL[61] "" VALUE 0x3B68 CONST_0 100.000000 F00058 0.000000 255.000000 FUNCTION_LIST Fehlerfilter Kontrolle /end CHARACTERISTIC
/begin CHARACTERISTIC K_ED_FIL_CTL[62] "" VALUE 0x3B76 CONST_0 100.000000 F00058 0.000000 255.000000 FUNCTION_LIST Fehlerfilter Kontrolle /end CHARACTERISTIC
/begin CHARACTERISTIC K_ED_FIL_CTL[63] "" VALUE 0x3B84 CONST_0 100.000000 F00058 0.000000 255.000000 FUNCTION_LIST Fehlerfilter Kontrolle /end CHARACTERISTIC
/begin CHARACTERISTIC K_ED_FIL_CTL[64] "" VALUE 0x3B92 CONST_0 100.000000 F00058 0.000000 255.000000 FUNCTION_LIST Fehlerfilter Kontrolle /end CHARACTERISTIC
/begin CHARACTERISTIC K_ED_FIL_CTL[65] "" VALUE 0x3BA0 CONST_0 100.000000 F00058 0.000000 255.000000 FUNCTION_LIST Fehlerfilter Kontrolle /end CHARACTERISTIC
/begin CHARACTERISTIC K_ED_FIL_CTL[66] "" VALUE 0x3BAE CONST_0 100.000000 F00058 0.000000 255.000000 FUNCTION_LIST Fehlerfilter Kontrolle /end CHARACTERISTIC
/begin CHARACTERISTIC K_ED_FIL_CTL[67] "" VALUE 0x3BBC CONST_0 100.000000 F00058 0.000000 255.000000 FUNCTION_LIST Fehlerfilter Kontrolle /end CHARACTERISTIC
/begin CHARACTERISTIC K_ED_FIL_CTL[68] "" VALUE 0x3BCA CONST_0 100.000000 F00058 0.000000 255.000000 FUNCTION_LIST Fehlerfilter Kontrolle /end CHARACTERISTIC
/begin CHARACTERISTIC K_ED_FIL_CTL[69] "" VALUE 0x3BD8 CONST_0 100.000000 F00058 0.000000 255.000000 FUNCTION_LIST Fehlerfilter Kontrolle /end CHARACTERISTIC
/begin CHARACTERISTIC K_ED_FIL_CTL[70] "" VALUE 0x3BE6 CONST_0 100.000000 F00058 0.000000 255.000000 FUNCTION_LIST Fehlerfilter Kontrolle /end CHARACTERISTIC
/begin CHARACTERISTIC K_ED_FIL_CTL[71] "" VALUE 0x3BF4 CONST_0 100.000000 F00058 0.000000 255.000000 FUNCTION_LIST Fehlerfilter Kontrolle /end CHARACTERISTIC
/begin CHARACTERISTIC K_ED_FIL_CTL[72] "" VALUE 0x3C02 CONST_0 100.000000 F00058 0.000000 255.000000 FUNCTION_LIST Fehlerfilter Kontrolle /end CHARACTERISTIC
/begin CHARACTERISTIC K_ED_FIL_CTL[73] "" VALUE 0x3C10 CONST_0 100.000000 F00058 0.000000 255.000000 FUNCTION_LIST Fehlerfilter Kontrolle /end CHARACTERISTIC
/begin CHARACTERISTIC K_ED_FIL_CTL[74] "" VALUE 0x3C1E CONST_0 100.000000 F00058 0.000000 255.000000 FUNCTION_LIST Fehlerfilter Kontrolle /end CHARACTERISTIC
/begin CHARACTERISTIC K_ED_FIL_CTL[75] "" VALUE 0x3C2C CONST_0 100.000000 F00058 0.000000 255.000000 FUNCTION_LIST Fehlerfilter Kontrolle /end CHARACTERISTIC
/begin CHARACTERISTIC K_ED_FIL_CTL[76] "" VALUE 0x3C3A CONST_0 100.000000 F00058 0.000000 255.000000 FUNCTION_LIST Fehlerfilter Kontrolle /end CHARACTERISTIC
/begin CHARACTERISTIC K_ED_FIL_CTL[77] "" VALUE 0x3C48 CONST_0 100.000000 F00058 0.000000 255.000000 FUNCTION_LIST Fehlerfilter Kontrolle /end CHARACTERISTIC
/begin CHARACTERISTIC K_ED_FIL_CTL[78] "" VALUE 0x3C56 CONST_0 100.000000 F00058 0.000000 255.000000 FUNCTION_LIST Fehlerfilter Kontrolle /end CHARACTERISTIC
/begin CHARACTERISTIC K_ED_FIL_CTL[79] "" VALUE 0x3C64 CONST_0 100.000000 F00058 0.000000 255.000000 FUNCTION_LIST Fehlerfilter Kontrolle /end CHARACTERISTIC
/begin CHARACTERISTIC K_ED_FIL_CTL[80] "" VALUE 0x3C72 CONST_0 100.000000 F00058 0.000000 255.000000 FUNCTION_LIST Fehlerfilter Kontrolle /end CHARACTERISTIC
/begin CHARACTERISTIC K_ED_FIL_CTL[81] "" VALUE 0x3C80 CONST_0 100.000000 F00058 0.000000 255.000000 FUNCTION_LIST Fehlerfilter Kontrolle /end CHARACTERISTIC
/begin CHARACTERISTIC K_ED_FIL_CTL[82] "" VALUE 0x3C8E CONST_0 100.000000 F00058 0.000000 255.000000 FUNCTION_LIST Fehlerfilter Kontrolle /end CHARACTERISTIC
/begin COMPU_METHOD F00203 "-*-" FORM "%4.4" "V/bar" FORMULA "(((1/(x/512))/1023)*5)*1000)" /end COMPU_METHOD
/begin COMPU_METHOD F00208 "-*-" FORM "%1.4" "V/min" FORMULA "((3000/1023)/x)" /end COMPU_METHOD
/begin COMPU_METHOD F00206 "-*-" FORM "%3.3" "%/V" FORMULA "((x*1023)/102400)" /end COMPU_METHOD
/begin COMPU_METHOD F00270 "-*-" FORM "%1.2" "V" FORMULA "((x/1023)*40)" /end COMPU_METHOD
/begin COMPU_METHOD F00204 "-*-" FORM "%1.4" "V" FORMULA "((x/512)/1023)*5" /end COMPU_METHOD
/begin COMPU_METHOD F00062 "-*-" FORM "%1.2" "%/10ms" FORMULA "(x*100/32768)" /end COMPU_METHOD
/begin COMPU_METHOD F00119 "-*-" FORM "%1.3" "ms/Segm" FORMULA "(x*8)/1000" /end COMPU_METHOD
/begin COMPU_METHOD F00063 "-*-" FORM "%1.4" "-" FORMULA "(x/32768)" /end COMPU_METHOD
/begin COMPU_METHOD F00236 "-*-" FORM "%3.2" "øC" FORMULA "(x/4)-48" /end COMPU_METHOD
/begin COMPU_METHOD F00237 "-*-" FORM "%3.4" "øC/min" FORMULA "(x/65536)*600" /end COMPU_METHOD
/begin COMPU_METHOD F00112 "-*-" FORM "%2.1" "-" FORMULA "-x/10" /end COMPU_METHOD
/begin COMPU_METHOD F00129 "-*-" FORM "%2.2" "kHz" FORMULA "0.7812*x" /end COMPU_METHOD
/begin COMPU_METHOD F00061 "-*-" FORM "%1.4" "-" FORMULA "1+(x/32768)" /end COMPU_METHOD
/begin COMPU_METHOD F00125 "-*-" FORM "%2.2" "kHz" FORMULA "1.165e0*exp(x*4.426e-2)" /end COMPU_METHOD
/begin COMPU_METHOD F00127 "-*-" FORM "%1.2" "-" FORMULA "1.895*exp(-x*4.565e-2)" /end COMPU_METHOD
/begin COMPU_METHOD F00133 "-*-" FORM "%1.2" "Seg.laenge" FORMULA "1/x" /end COMPU_METHOD
/begin COMPU_METHOD F00130 "-*-" FORM "%2.0" "%" FORMULA "100*x/255" /end COMPU_METHOD
/begin COMPU_METHOD F00199 "-*-" FORM "%2.2" "%" FORMULA "100-(x/20)" /end COMPU_METHOD
/begin COMPU_METHOD F00144 "-*-" FORM "%4.2" "sec" FORMULA "1310/x" /end COMPU_METHOD
/begin COMPU_METHOD F00196 "-*-" FORM "%1.2" "s" FORMULA "2.56/x" /end COMPU_METHOD
/begin COMPU_METHOD F00215 "-*-" FORM "%5.2" "ms" FORMULA "20480/X" /end COMPU_METHOD
/begin COMPU_METHOD F00195 "-*-" FORM "%2.1" "s" FORMULA "25.6/x" /end COMPU_METHOD
/begin COMPU_METHOD F00098 "-*-" FORM "%3.4" "kg/h*min/ms" FORMULA "250/x" /end COMPU_METHOD
/begin COMPU_METHOD F00105 "-*-" FORM "%2.2" "s" FORMULA "32/x" /end COMPU_METHOD
/begin COMPU_METHOD F00126 "-*-" FORM "%3.0" "us" FORMULA "4.128e1*exp(x*1.74e-1)" /end COMPU_METHOD
/begin COMPU_METHOD F00128 "-*-" FORM "%3.0" "U/min" FORMULA "40*x" /end COMPU_METHOD
/begin COMPU_METHOD F00123 "-*-" FORM "%1.2" "V" FORMULA "5*x/1024" /end COMPU_METHOD
/begin COMPU_METHOD F00122 "-*-" FORM "%1.2" "V" FORMULA "5*x/256" /end COMPU_METHOD
/begin COMPU_METHOD F00024 "-*-" FORM "%1.2" "s" FORMULA "5.12/x" /end COMPU_METHOD
/begin COMPU_METHOD F00136 "-*-" FORM "%1.2" "sec" FORMULA "5.12/x" /end COMPU_METHOD
/begin COMPU_METHOD F00209 "-*-" FORM "%3.2" "s" FORMULA "600/x" /end COMPU_METHOD
/begin COMPU_METHOD F00417 "-*-" FORM "%3.0" "sec" FORMULA "655/(x+1)" /end COMPU_METHOD
/begin COMPU_METHOD F00065 "-*-" FORM "%3.2" "sec" FORMULA "655/x" /end COMPU_METHOD
/begin COMPU_METHOD F00229 "-*-" FORM "%3.0" "-" FORMULA "TXTEQ(x: da_m.equ)" /end COMPU_METHOD
/begin COMPU_METHOD F00274 "-*-" FORM "%3.2" "-" FORMULA "TXTEQ(x: name.equ )" /end COMPU_METHOD
/begin COMPU_METHOD F00118 "-*-" FORM "%1.2" "-" FORMULA "TXTEQ(x:: 0 -5 KD aus: 1 5 HIP: 2 5 HIP Komp: 3 6 DSP Eges: 4 6 DSP Eres)" /end COMPU_METHOD
/begin COMPU_METHOD F00110 "-*-" FORM "%1.0" "-" FORMULA "TXTEQ(x:: 0 6 aus : 1 -5 ein)" /end COMPU_METHOD
/begin COMPU_METHOD F00121 "-*-" FORM "%1.0" "-" FORMULA "TXTEQ(x:: 0 6 keine Ausgabe : 1 -5 Ausgabe)" /end COMPU_METHOD
/begin COMPU_METHOD F00233 "-*-" FORM "%1.0" "-" FORMULA "TXTEQ(x:: 0 6 mit Sensor : 1 -5 ohne Sensor)" /end COMPU_METHOD
/begin COMPU_METHOD F00234 "-*-" FORM "%1.0" "-" FORMULA "TXTEQ(x:: 0 6 tan : 1 -5 tmot)" /end COMPU_METHOD
/begin COMPU_METHOD F00135 "-*-" FORM "%3.2" "-" FORMULA "TXTEQ(x::$0 -1 Ohne LDPH :$1 1 LDPH ab Werk :$2 1 LDPH Nachruest:$3 1 LDPH immer ein :ELSE 3 undef. )" /end COMPU_METHOD
/begin COMPU_METHOD F00218 "-*-" FORM "%3.2" "-" FORMULA "TXTEQ(x::$0 -1 Ohne Servo :$1 1 V-Achse :$2 1 H-Achse :ELSE 1 undefiniert )" /end COMPU_METHOD
/begin COMPU_METHOD F00163 "-*-" FORM "%3.2" "-" FORMULA "TXTEQ(x::$0 1 ASC/MSR freigegeben :$1 1 ASC gesperrt :$2 1 MSR gesperrt :$3 1 ASC/MSR gesperrt)" /end COMPU_METHOD
/begin COMPU_METHOD F00036 "-*-" FORM "%3.2" "-" FORMULA "TXTEQ(x::$0 1 Fz-Betrieb :$01 1 Pruefstand :$02 1 Rolle )" /end COMPU_METHOD
/begin COMPU_METHOD F00266 "-*-" FORM "%3.2" "-" FORMULA "TXTEQ(x::$0 1 Kath aus rf-mess :$1 1 Kath aus rf-Ersatz)" /end COMPU_METHOD
/begin COMPU_METHOD F00034 "-*-" FORM "%3.2" "-" FORMULA "TXTEQ(x::$0 1 KR inaktiv :$40 1 KR HIP  :$80 1 KR DSP :ELSE 1 undefiniert )" /end COMPU_METHOD
/begin COMPU_METHOD F00084 "-*-" FORM "%3.0" "-" FORMULA "TXTEQ(x::$0 1 Lenkstock :ELSE i MFL )" /end COMPU_METHOD
/begin COMPU_METHOD F00164 "-*-" FORM "%3.2" "-" FORMULA "TXTEQ(x::$0 1 MCS-Vorgabe :$1 1 Normalbetrieb :ELSE 1 Normalbetrieb)" /end COMPU_METHOD
/begin COMPU_METHOD F00037 "-*-" FORM "%3.2" "-" FORMULA "TXTEQ(x::$0 1 Momentenmanager :$01 1 Baudenzug )" /end COMPU_METHOD
/begin COMPU_METHOD F00160 "-*-" FORM "%3.2" "-" FORMULA "TXTEQ(x::$0 1 nicht FLASHEN :$1 1 FLASHEN :else -1 error)" /end COMPU_METHOD
/begin COMPU_METHOD F00038 "-*-" FORM "%3.2" "-" FORMULA "TXTEQ(x::$0 1 Ohne DSV/mit VVDP  :$1 DSV Funktion aktiv :$2 DSV immer ein :ELSE -3 undef. )" /end COMPU_METHOD
/begin COMPU_METHOD F00012 "-*-" FORM "%3.2" "-" FORMULA "TXTEQ(x::$0 1 Regeln ab Druck  :$1 Regeln ab ML+KATH :ELSE -3 undef. )" /end COMPU_METHOD
/begin COMPU_METHOD F00033 "-*-" FORM "%3.2" "-" FORMULA "TXTEQ(x::$01 1 ECE  :$02 1 US  :$04 1 Golfstaaten )" /end COMPU_METHOD
/begin COMPU_METHOD F00029 "-*-" FORM "%3.2" "-" FORMULA "TXTEQ(x::$08 1 E36  :$10 1 E39  :$20 1 E46 :$40 1 E52 :$80 1 E59 :ELSE 1 undefiniert )" /end COMPU_METHOD
/begin COMPU_METHOD F00069 "-*-" FORM "%3.2" "-" FORMULA "TXTEQ(x::$1 1  FR-Adapt-aktiv.:$0 1  FR-Adapt-inaktiv.:ELSE i ERROR)" /end COMPU_METHOD
/begin COMPU_METHOD F00273 "-*-" FORM "%3.2" "-" FORMULA "TXTEQ(x::$1 1 Masterprozessor :$2 1 Slaveprozesor :ELSE 1 undefiniert)" /end COMPU_METHOD
/begin COMPU_METHOD F00030 "-*-" FORM "%3.2" "-" FORMULA "TXTEQ(x::$1 1 S40  :$4 1 S53 :$c 1 S54 :$20 1 S62B36 :$30 1 S62B50 :ELSE 1 undefiniert )" /end COMPU_METHOD
/begin COMPU_METHOD F00032 "-*-" FORM "%3.2" "-" FORMULA "TXTEQ(x::$10 1 CAN 10H  :$11 1 CAN 11H  :$27 1 CAN 27H :ELSE 1 undefiniert )" /end COMPU_METHOD
/begin COMPU_METHOD F00141 "-*-" FORM "%3.2" "-" FORMULA "TXTEQ(x::$3 1  PI-aktiv. :$7 1 PI+Adapt aktiv :$F 1 PID+Adapt.aktiv :$1F 1 PID+Adapt+TZ :ELSE i ERROR)" /end COMPU_METHOD
/begin COMPU_METHOD F00035 "-*-" FORM "%3.2" "-" FORMULA "TXTEQ(x::-124 1 Serienstand :$1 1 A-Muster :$2 1 B-Muster :$4 1 C-Muster :ELSE 1 undefiniert )" /end COMPU_METHOD
/begin COMPU_METHOD F00277 "-*-" FORM "%1.0" "-" FORMULA "TXTEQ(x::0 1 1 Satz Umw.Bed. :1 1 3 Saetze Umw.Bed. :ELSE 1 unzulaessige Maske)" /end COMPU_METHOD
/begin COMPU_METHOD F00020 "-*-" FORM "%3.0" "" FORMULA "TXTEQ(x::0 1 ASC OHNE Alive Zaehler :1 1 ASC MIT Alive Zaehler)" /end COMPU_METHOD
/begin COMPU_METHOD F00228 "-*-" FORM "%3.2" "-" FORMULA "TXTEQ(x::0 1 aus V-Fz :1 1 aus S_Gang :2 1 aus S_Kuppl )" /end COMPU_METHOD
/begin COMPU_METHOD F00278 "-*-" FORM "%1.0" "-" FORMULA "TXTEQ(x::0 1 Betriebsstunde :1 1 Kilometerstand :ELSE 1 unzulaessige Maske)" /end COMPU_METHOD
/begin COMPU_METHOD F00211 "-*-" FORM "%1.0" "-" FORMULA "TXTEQ(x::0 1 BLS+BLTS+DSC: 1 1 BLS+DSC: 2 1 BLS+BLTS: 3 1 BLS)" /end COMPU_METHOD
/begin COMPU_METHOD F00023 "-*-" FORM "%3.0" "" FORMULA "TXTEQ(x::0 1 Bosch DSC3 :1 1 Teves DSC3)" /end COMPU_METHOD
/begin COMPU_METHOD F00231 "-*-" FORM "%3.2" "-" FORMULA "TXTEQ(x::0 1 D/A abgeschaltet :1 1 D/A aktiv )" /end COMPU_METHOD
/begin COMPU_METHOD F00224 "-*-" FORM "%1.0" "-" FORMULA "TXTEQ(x::0 1 entspr. Funktion :1 1 Treiber aus [SSP an] :2 1 Treiber an [SSP aus] :3 1 keine SSP verbaut)" /end COMPU_METHOD
/begin COMPU_METHOD F00267 "-*-" FORM "%3.0" "-" FORMULA "TXTEQ(x::0 1 inaktiv :$35 1 statisch :$3a 1 sequentiell :$3f 1 zufaellig)" /end COMPU_METHOD
/begin COMPU_METHOD F00026 "-*-" FORM "%3.0" "-" FORMULA "TXTEQ(x::0 1 inaktiv :1 1 gelb an :3 1 blinkt :0x10 1 vom DSC)" /end COMPU_METHOD
/begin COMPU_METHOD F00114 "-*-" FORM "%3.0" "-" FORMULA "TXTEQ(X::0 1 kein CAN-Tel. :1 1  CAN-Tel normal :2 1  CAN-Tel multipl.)" /end COMPU_METHOD
/begin COMPU_METHOD F00094 "-*-" FORM "%1.0" "-" FORMULA "TXTEQ(x::0 1 Keine Auswirkung: 1 1 VANOS: 2 1 Moment: 3 1 VANOS+Moment)" /end COMPU_METHOD
/begin COMPU_METHOD F00113 "-*-" FORM "%3.0" "-" FORMULA "TXTEQ(X::0 1 KEINE DA-Ausgabe :255 1 DA-Ausgabe)" /end COMPU_METHOD
/begin COMPU_METHOD F00232 "-*-" FORM "%3.0" "-" FORMULA "TXTEQ(x::0 1 keine MIL-Ansteuerung :1 1 MIL bei BMW-Fehler  :2 1 MIL fuer OBD  :4 1 MIL bei OEK-Fehler  :8 1 MIL fuer Japan  :ELSE 1 unzulaessige Maske)" /end COMPU_METHOD
/begin COMPU_METHOD F00230 "-*-" FORM "%3.0" "-" FORMULA "TXTEQ(x::0 1 konfigurierbar :1 1 KR-Stat.  :2 1 KR-Dyn.)" /end COMPU_METHOD
/begin COMPU_METHOD F00165 "-*-" FORM "%3.0" "-" FORMULA "TXTEQ(x::0 1 LS MD-relativ :1 1 LS MD-absolut)" /end COMPU_METHOD
/begin COMPU_METHOD F00259 "-*-" FORM "%3.0" "-" FORMULA "TXTEQ(x::0 1 MD-Eingriff gesperrt :1 1 MD-Eingriff immer :2 1 auf Anforderung )" /end COMPU_METHOD
/begin COMPU_METHOD F00178 "-*-" FORM "%3.0" "-" FORMULA "TXTEQ(x::0 1 MD-Res disabled :1 1 MD-Res Kath enabled )" /end COMPU_METHOD
/begin COMPU_METHOD F00176 "-*-" FORM "%3.0" "-" FORMULA "TXTEQ(x::0 1 normale Funktion :1 1 kein ZW-Eingriff :2 1 kein Fuellungseingr. :3 1 alle Eingriffe abgelehnt)" /end COMPU_METHOD
/begin COMPU_METHOD F00227 "-*-" FORM "%3.2" "-" FORMULA "TXTEQ(x::0 1 OEK abgeschaltet :1 1 OEK freigegeben )" /end COMPU_METHOD
/begin COMPU_METHOD F00179 "-*-" FORM "%3.2" "-" FORMULA "TXTEQ(x::0 1 rf gemessen :$1 1 rf-Ersatz)" /end COMPU_METHOD
/begin COMPU_METHOD F00261 "-*-" FORM "%3.0" "-" FORMULA "TXTEQ(x::0 1 SA/WE-direkt gesperrt :1 1 SA/WE-direkt freigeg. )" /end COMPU_METHOD
/begin COMPU_METHOD F00219 "-*-" FORM "%3.0" "-" FORMULA "TXTEQ(x::0 1 SK-Egas abgeschaltet :1 1 SK-Egas aktiv )" /end COMPU_METHOD
/begin COMPU_METHOD F00022 "-*-" FORM "%3.0" "" FORMULA "TXTEQ(x::0 1 Stand <= 54 :1 1 Stand 55..60 : 2 Stand >= 61)" /end COMPU_METHOD
/begin COMPU_METHOD F00226 "-*-" FORM "%3.2" "-" FORMULA "TXTEQ(x::0 1 S_FDYN vom DSC :1 1 S_FDYN = Sport :2 1 S_FDYN = Komfort :3 1 S_FDYN vom Taster :4 1 S_FDYN Taster vorher)" /end COMPU_METHOD
/begin COMPU_METHOD F00260 "-*-" FORM "%3.0" "-" FORMULA "TXTEQ(x::0 1 TZ Kath disabled :1 1 TZ Kath enabled )" /end COMPU_METHOD
/begin COMPU_METHOD F00272 "-*-" FORM "%1.2" "-" FORMULA "TXTEQ(x::0 1 V direkt :2 1 V vom ASC :ELSE 1 undefiniert )" /end COMPU_METHOD
/begin COMPU_METHOD F00275 "-*-" FORM "%1.0" "-" FORMULA "TXTEQ(x::0 1 WDK2 inverse KL :1 1 WDK2 nicht invers)" /end COMPU_METHOD
/begin COMPU_METHOD F00058 "-*-" FORM "%3.2" "" FORMULA "x" /end COMPU_METHOD
/begin COMPU_METHOD F00093 "-*-" FORM "%2.0" "%" FORMULA "x" /end COMPU_METHOD
/begin COMPU_METHOD F00050 "-*-" FORM "%3.0" "%tv/%" FORMULA "x" /end COMPU_METHOD
/begin COMPU_METHOD F00013 "-*-" FORM "%5.0" "-" FORMULA "x" /end COMPU_METHOD
/begin COMPU_METHOD F00161 "-*-" FORM "%3.0" "1" FORMULA "x" /end COMPU_METHOD
/begin COMPU_METHOD F00253 "-*-" FORM "%3.0" "dec" FORMULA "x" /end COMPU_METHOD
/begin COMPU_METHOD F00239 "-*-" FORM "%5.0" "digit" FORMULA "x" /end COMPU_METHOD
/begin COMPU_METHOD F00004 "-*-" FORM "%3.0" "km/h" FORMULA "x" /end COMPU_METHOD
/begin COMPU_METHOD F00091 "-*-" FORM "%3.0" "l" FORMULA "x" /end COMPU_METHOD
/begin COMPU_METHOD F00201 "-*-" FORM "%4.0" "mbar" FORMULA "x" /end COMPU_METHOD
/begin COMPU_METHOD F00223 "-*-" FORM "%3.0" "min" FORMULA "x" /end COMPU_METHOD
/begin COMPU_METHOD F00000 "-*-" FORM "%4.0" "mm" FORMULA "x" /end COMPU_METHOD
/begin COMPU_METHOD F00047 "-*-" FORM "%3.2" "ms" FORMULA "x" /end COMPU_METHOD
/begin COMPU_METHOD F00248 "-*-" FORM "%4.0" "msec" FORMULA "x" /end COMPU_METHOD
/begin COMPU_METHOD F00222 "-*-" FORM "%4.0" "mV" FORMULA "x" /end COMPU_METHOD
/begin COMPU_METHOD F00174 "-*-" FORM "%5.0" "N/(s*kmh)" FORMULA "x" /end COMPU_METHOD
/begin COMPU_METHOD F00173 "-*-" FORM "%3.0" "Nm/s" FORMULA "x" /end COMPU_METHOD
/begin COMPU_METHOD F00124 "-*-" FORM "%2.0" "NW-U" FORMULA "x" /end COMPU_METHOD
/begin COMPU_METHOD F00017 "-*-" FORM "%3.0" "s" FORMULA "x" /end COMPU_METHOD
/begin COMPU_METHOD F00250 "-*-" FORM "%3.0" "sec" FORMULA "x" /end COMPU_METHOD
/begin COMPU_METHOD F00265 "-*-" FORM "%3.0" "Segm" FORMULA "x" /end COMPU_METHOD
/begin COMPU_METHOD F00007 "-*-" FORM "%4.0" "Upm" FORMULA "x" /end COMPU_METHOD
/begin COMPU_METHOD F00142 "-*-" FORM "%4.0" "Upm/s" FORMULA "x" /end COMPU_METHOD
/begin COMPU_METHOD F00243 "-*-" FORM "%3.0" "°C" FORMULA "x" /end COMPU_METHOD
/begin COMPU_METHOD F00416 "-*-" FORM "%3.0" "°KW" FORMULA "x" /end COMPU_METHOD
/begin COMPU_METHOD F00015 "-*-" FORM "%3.0" "øC" FORMULA "x" /end COMPU_METHOD
/begin COMPU_METHOD F00011 "-*-" FORM "%2.0" "øKW" FORMULA "x" /end COMPU_METHOD
/begin COMPU_METHOD F00031 "-*-" FORM "%3.2" "-" FORMULA "X" /end COMPU_METHOD
/begin COMPU_METHOD F00213 "-*-" FORM "%5.0" "Dig/mA" FORMULA "X" /end COMPU_METHOD
/begin COMPU_METHOD F00076 "-*-" FORM "%5.0" "km/h" FORMULA "X" /end COMPU_METHOD
/begin COMPU_METHOD F00072 "-*-" FORM "%2.0" "kmh" FORMULA "X" /end COMPU_METHOD
/begin COMPU_METHOD F00217 "-*-" FORM "%3.2" "mA/V*Tast" FORMULA "X" /end COMPU_METHOD
/begin COMPU_METHOD F00276 "-*-" FORM "%3.2" "min" FORMULA "X" /end COMPU_METHOD
/begin COMPU_METHOD F00216 "-*-" FORM "%3.2" "ms" FORMULA "X" /end COMPU_METHOD
/begin COMPU_METHOD F00043 "-*-" FORM "%3.0" "s" FORMULA "X" /end COMPU_METHOD
/begin COMPU_METHOD F00262 "-*-" FORM "%3.0" "segm" FORMULA "X" /end COMPU_METHOD
/begin COMPU_METHOD F00279 "-*-" FORM "%3.0" "Upm" FORMULA "X" /end COMPU_METHOD
/begin COMPU_METHOD F00008 "-*-" FORM "%3.3" "ms" FORMULA "x*0.00321" /end COMPU_METHOD
/begin COMPU_METHOD F00066 "-*-" FORM "%3.2" "sec" FORMULA "x*0.01" /end COMPU_METHOD
/begin COMPU_METHOD F00171 "-*-" FORM "%3.1" "kW" FORMULA "x*0.01072" /end COMPU_METHOD
/begin COMPU_METHOD F00138 "-*-" FORM "%1.2" "sec" FORMULA "x*0.02" /end COMPU_METHOD
/begin COMPU_METHOD F00001 "-*-" FORM "%1.1" "Grad" FORMULA "x*0.04375" /end COMPU_METHOD
/begin COMPU_METHOD F00244 "-*-" FORM "%2.1" "s" FORMULA "x*0.1" /end COMPU_METHOD
/begin COMPU_METHOD F00088 "-*-" FORM "%1.1" "us" FORMULA "x*0.4" /end COMPU_METHOD
/begin COMPU_METHOD F00212 "-*-" FORM "%3.0" "mA" FORMULA "X*0.89" /end COMPU_METHOD
/begin COMPU_METHOD F00057 "-*-" FORM "%6.0" "ms" FORMULA "x*10" /end COMPU_METHOD
/begin COMPU_METHOD F00181 "-*-" FORM "%4.0" "Nm/s" FORMULA "x*10" /end COMPU_METHOD
/begin COMPU_METHOD F00182 "-*-" FORM "%4.0" "Upm/s" FORMULA "x*10" /end COMPU_METHOD
/begin COMPU_METHOD F00021 "-*-" FORM "%1.2" "%Md_Norm/s" FORMULA "x*10/256" /end COMPU_METHOD
/begin COMPU_METHOD F00019 "-*-" FORM "%5.1" "ms" FORMULA "x*100" /end COMPU_METHOD
/begin COMPU_METHOD F00245 "-*-" FORM "%2.1" "%/°C" FORMULA "x*100/1024" /end COMPU_METHOD
/begin COMPU_METHOD F00041 "-*-" FORM "%2.1" "%" FORMULA "x*100/250" /end COMPU_METHOD
/begin COMPU_METHOD F00246 "-*-" FORM "%2.1" "%" FORMULA "x*100/256" /end COMPU_METHOD
/begin COMPU_METHOD F00249 "-*-" FORM "%3.2" "msec" FORMULA "x*128/10000" /end COMPU_METHOD
/begin COMPU_METHOD F00162 "-*-" FORM "%4.0" "Nm" FORMULA "x*16" /end COMPU_METHOD
/begin COMPU_METHOD F00052 "-*-" FORM "%3.5" "%/s" FORMULA "x*2" /end COMPU_METHOD
/begin COMPU_METHOD F00200 "-*-" FORM "%3.0" "msec" FORMULA "x*2" /end COMPU_METHOD
/begin COMPU_METHOD F00210 "-*-" FORM "%4.0" "ms" FORMULA "x*20" /end COMPU_METHOD
/begin COMPU_METHOD F00083 "-*-" FORM "%4.0" "ms" FORMULA "X*20" /end COMPU_METHOD
/begin COMPU_METHOD F00214 "-*-" FORM "%7.0" "ms/mA" FORMULA "X*20" /end COMPU_METHOD
/begin COMPU_METHOD F00109 "-*-" FORM "%4.0" "Upm" FORMULA "x*40" /end COMPU_METHOD
/begin COMPU_METHOD F00040 "-*-" FORM "%4.0" "%/s" FORMULA "x*5" /end COMPU_METHOD
/begin COMPU_METHOD F00170 "-*-" FORM "%4.0" "Nm/s" FORMULA "x*5" /end COMPU_METHOD
/begin COMPU_METHOD F00207 "-*-" FORM "%1.3" "V" FORMULA "x*5/1023" /end COMPU_METHOD
/begin COMPU_METHOD F00137 "-*-" FORM "%4.3" "U/s" FORMULA "X*50/256" /end COMPU_METHOD
/begin COMPU_METHOD F00180 "-*-" FORM "%4.1" "%/s" FORMULA "x*5000/32768" /end COMPU_METHOD
/begin COMPU_METHOD F00005 "-*-" FORM "%3.0" "øKW" FORMULA "x*6" /end COMPU_METHOD
/begin COMPU_METHOD F00197 "-*-" FORM "%1.0" "-" FORMULA "x+1" /end COMPU_METHOD
/begin COMPU_METHOD F00280 "-*-" FORM "%3.2" "oC" FORMULA "x-48" /end COMPU_METHOD
/begin COMPU_METHOD F00014 "-*-" FORM "%3.0" "øC" FORMULA "x-48" /end COMPU_METHOD
/begin COMPU_METHOD F00071 "-*-" FORM "%3.2" "%" FORMULA "x/(10*64)" /end COMPU_METHOD
/begin COMPU_METHOD F00073 "-*-" FORM "%2.3" "km/h/s" FORMULA "x/(16*64)" /end COMPU_METHOD
/begin COMPU_METHOD F00064 "-*-" FORM "%2.3" "kg/h" FORMULA "x/(40*32)" /end COMPU_METHOD
/begin COMPU_METHOD F00048 "-*-" FORM "%3.2" "%" FORMULA "x/10" /end COMPU_METHOD
/begin COMPU_METHOD F00042 "-*-" FORM "%2.1" "%/20ms" FORMULA "x/10" /end COMPU_METHOD
/begin COMPU_METHOD F00039 "-*-" FORM "%2.1" "-" FORMULA "x/10" /end COMPU_METHOD
/begin COMPU_METHOD F00193 "-*-" FORM "%2.1" "m/(s*s)" FORMULA "x/10" /end COMPU_METHOD
/begin COMPU_METHOD F00251 "-*-" FORM "%1.1" "m/sec2" FORMULA "x/10" /end COMPU_METHOD
/begin COMPU_METHOD F00145 "-*-" FORM "%2.1" "Nm" FORMULA "x/10" /end COMPU_METHOD
/begin COMPU_METHOD F00168 "-*-" FORM "%4.1" "Nm/10ms" FORMULA "x/10" /end COMPU_METHOD
/begin COMPU_METHOD F00028 "-*-" FORM "%2.1" "s" FORMULA "x/10" /end COMPU_METHOD
/begin COMPU_METHOD F00198 "-*-" FORM "%2.1" "sec" FORMULA "x/10" /end COMPU_METHOD
/begin COMPU_METHOD F00018 "-*-" FORM "%2.1" "V" FORMULA "x/10" /end COMPU_METHOD
/begin COMPU_METHOD F00045 "-*-" FORM "%2.1" "ø" FORMULA "x/10" /end COMPU_METHOD
/begin COMPU_METHOD F00263 "-*-" FORM "%2.1" "ø/Segment" FORMULA "x/10" /end COMPU_METHOD
/begin COMPU_METHOD F00006 "-*-" FORM "%2.1" "øKW" FORMULA "x/10" /end COMPU_METHOD
/begin COMPU_METHOD F00143 "-*-" FORM "%2.3" "Nm" FORMULA "X/10" /end COMPU_METHOD
/begin COMPU_METHOD F00010 "-*-" FORM "%2.1" "s" FORMULA "X/10" /end COMPU_METHOD
/begin COMPU_METHOD F00027 "-*-" FORM "%1.1" "s" FORMULA "x/100" /end COMPU_METHOD
/begin COMPU_METHOD F00025 "-*-" FORM "%3.1" "sec" FORMULA "x/100" /end COMPU_METHOD
/begin COMPU_METHOD F00068 "-*-" FORM "%1.3" "-" FORMULA "x/1000" /end COMPU_METHOD
/begin COMPU_METHOD F00101 "-*-" FORM "%2.3" "dm**3" FORMULA "x/1000" /end COMPU_METHOD
/begin COMPU_METHOD F00102 "-*-" FORM "%2.3" "Kg/m**3" FORMULA "x/1000" /end COMPU_METHOD
/begin COMPU_METHOD F00009 "-*-" FORM "%2.1" "s" FORMULA "x/1000" /end COMPU_METHOD
/begin COMPU_METHOD F00060 "-*-" FORM "%1.4" "-" FORMULA "x/10000" /end COMPU_METHOD
/begin COMPU_METHOD F00067 "-*-" FORM "%1.2" "1/%rf" FORMULA "x/102.4" /end COMPU_METHOD
/begin COMPU_METHOD F00183 "-*-" FORM "%3.2" "Nm/sUpm" FORMULA "x/102.4" /end COMPU_METHOD
/begin COMPU_METHOD F00192 "-*-" FORM "%2.2" "" FORMULA "x/1024" /end COMPU_METHOD
/begin COMPU_METHOD F00085 "-*-" FORM "%1.3" "-" FORMULA "x/1024" /end COMPU_METHOD
/begin COMPU_METHOD F00016 "-*-" FORM "%7.3" "s" FORMULA "x/1024" /end COMPU_METHOD
/begin COMPU_METHOD F00056 "-*-" FORM "%1.2" "-" FORMULA "x/128" /end COMPU_METHOD
/begin COMPU_METHOD F00166 "-*-" FORM "%2.1" "%" FORMULA "x/128*100" /end COMPU_METHOD
/begin COMPU_METHOD F00167 "-*-" FORM "%2.2" "-" FORMULA "x/16" /end COMPU_METHOD
/begin COMPU_METHOD F00271 "-*-" FORM "%3.1" "km/20ms" FORMULA "x/16" /end COMPU_METHOD
/begin COMPU_METHOD F00079 "-*-" FORM "%4.0" "km/h" FORMULA "x/16" /end COMPU_METHOD
/begin COMPU_METHOD F00235 "-*-" FORM "%4.0" "øC" FORMULA "x/16" /end COMPU_METHOD
/begin COMPU_METHOD F00081 "-*-" FORM "%1.2" "kmh" FORMULA "X/16" /end COMPU_METHOD
/begin COMPU_METHOD F00264 "-*-" FORM "%2.2" "Grad/10ms" FORMULA "x/160" /end COMPU_METHOD
/begin COMPU_METHOD F00140 "-*-" FORM "%2.3" "Nm" FORMULA "x/160" /end COMPU_METHOD
/begin COMPU_METHOD F00075 "-*-" FORM "%3.3" "km/h/s" FORMULA "X/160" /end COMPU_METHOD
/begin COMPU_METHOD F00086 "-*-" FORM "%1.2" "kmh/s" FORMULA "X/160" /end COMPU_METHOD
/begin COMPU_METHOD F00139 "-*-" FORM "%2.3" "Nm" FORMULA "X/160" /end COMPU_METHOD
/begin COMPU_METHOD F00077 "-*-" FORM "%2.0" "km/h" FORMULA "x/1600" /end COMPU_METHOD
/begin COMPU_METHOD F00097 "-*-" FORM "%1.4" "-" FORMULA "x/16384" /end COMPU_METHOD
/begin COMPU_METHOD F00157 "-*-" FORM "%3.1" "kg/h" FORMULA "x/2" /end COMPU_METHOD
/begin COMPU_METHOD F00054 "-*-" FORM "%3.1" "ms" FORMULA "x/2" /end COMPU_METHOD
/begin COMPU_METHOD F00092 "-*-" FORM "%3.1" "U/kmh" FORMULA "x/2" /end COMPU_METHOD
/begin COMPU_METHOD F00049 "-*-" FORM "%3.2" "%" FORMULA "x/20" /end COMPU_METHOD
/begin COMPU_METHOD F00055 "-*-" FORM "%2.1" "%tv" FORMULA "x/20" /end COMPU_METHOD
/begin COMPU_METHOD F00099 "-*-" FORM "%1.2" "-" FORMULA "x/256" /end COMPU_METHOD
/begin COMPU_METHOD F00158 "-*-" FORM "%3.2" "kg/h" FORMULA "x/256" /end COMPU_METHOD
/begin COMPU_METHOD F00175 "-*-" FORM "%3.3" "Ns2" FORMULA "x/256" /end COMPU_METHOD
/begin COMPU_METHOD F00172 "-*-" FORM "%1.2" "s" FORMULA "x/256" /end COMPU_METHOD
/begin COMPU_METHOD F00247 "-*-" FORM "%3.1" "°C" FORMULA "x/256" /end COMPU_METHOD
/begin COMPU_METHOD F00252 "-*-" FORM "%1.3" "øC" FORMULA "x/256" /end COMPU_METHOD
/begin COMPU_METHOD F00080 "-*-" FORM "%3.3" "U/min" FORMULA "X/256" /end COMPU_METHOD
/begin COMPU_METHOD F00169 "-*-" FORM "%3.2" "Nms2" FORMULA "x/268" /end COMPU_METHOD
/begin COMPU_METHOD F00111 "-*-" FORM "%1.3" "øKW/s" FORMULA "x/2^14" /end COMPU_METHOD
/begin COMPU_METHOD F00202 "-*-" FORM "%4.0" "mbar" FORMULA "x/32" /end COMPU_METHOD
/begin COMPU_METHOD F00100 "-*-" FORM "%1.2" "-" FORMULA "x/32768" /end COMPU_METHOD
/begin COMPU_METHOD F00053 "-*-" FORM "%1.2" "sec" FORMULA "x/333" /end COMPU_METHOD
/begin COMPU_METHOD F00096 "-*-" FORM "%4.1" "kg/(h*720 øKW)" FORMULA "x/4" /end COMPU_METHOD
/begin COMPU_METHOD F00095 "-*-" FORM "%2.1" "kg/h" FORMULA "x/4" /end COMPU_METHOD
/begin COMPU_METHOD F00159 "-*-" FORM "%2.1" "%" FORMULA "x/50" /end COMPU_METHOD
/begin COMPU_METHOD F00082 "-*-" FORM "%1.3" "s" FORMULA "x/50" /end COMPU_METHOD
/begin COMPU_METHOD F00078 "-*-" FORM "%4.3" "s" FORMULA "X/50" /end COMPU_METHOD
/begin COMPU_METHOD F00059 "-*-" FORM "%1.1" "" FORMULA "x/64" /end COMPU_METHOD
/begin COMPU_METHOD F00003 "-*-" FORM "%1.2" "-" FORMULA "x/64" /end COMPU_METHOD
/begin COMPU_METHOD F00087 "-*-" FORM "%2.1" "%" FORMULA "x/640" /end COMPU_METHOD
/begin COMPU_METHOD F00177 "-*-" FORM "%2.1" "%" FORMULA "x/65535*100" /end COMPU_METHOD
/begin COMPU_METHOD F00074 "-*-" FORM "%4.0" "-/10ms" FORMULA "x/8" /end COMPU_METHOD
/begin COMPU_METHOD F00051 "-*-" FORM "%2.1" "%tv" FORMULA "x/80" /end COMPU_METHOD
/begin RECORD_LAYOUT CONST_0 /* unsigned byte */ FNC_VALUES 0 UBYTE ROW_DIR DIRECT /end RECORD_LAYOUT
/begin RECORD_LAYOUT CONST_1 /* signed byte */ FNC_VALUES 0 SBYTE ROW_DIR DIRECT /end RECORD_LAYOUT
/begin RECORD_LAYOUT CONST_2 /* unsigned word */ FNC_VALUES 0 UWORD ROW_DIR DIRECT /end RECORD_LAYOUT
/begin RECORD_LAYOUT CONST_3 /* signed word */ FNC_VALUES 0 SWORD ROW_DIR DIRECT /end RECORD_LAYOUT
/begin RECORD_LAYOUT CONST_4 /* unsigned long */ FNC_VALUES 0 ULONG ROW_DIR DIRECT /end RECORD_LAYOUT
/end MODULE
