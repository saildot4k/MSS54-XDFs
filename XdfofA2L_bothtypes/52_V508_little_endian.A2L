/begin MODULE 52_V508.A2L "52_V508.A2L"
/begin MOD_COMMON "BMSCOMMON" /* Definition der Standard-Byteorder */ BYTE_ORDER LITTLE_ENDIAN /* Motorola byte order */ /end MOD_COMMON
/begin CHARACTERISTIC K_ED_FIL_CTL[83] "" VALUE 0x3C9C CONST_0 100.000000 F00058 0.000000 255.000000 FUNCTION_LIST Fehlerfilter Kontrolle /end CHARACTERISTIC
/begin CHARACTERISTIC K_ED_FIL_CTL[84] "" VALUE 0x3CAA CONST_0 100.000000 F00058 0.000000 255.000000 FUNCTION_LIST Fehlerfilter Kontrolle /end CHARACTERISTIC
/begin CHARACTERISTIC K_ED_FIL_CTL[85] "" VALUE 0x3CB8 CONST_0 100.000000 F00058 0.000000 255.000000 FUNCTION_LIST Fehlerfilter Kontrolle /end CHARACTERISTIC
/begin CHARACTERISTIC K_ED_FIL_CTL[86] "" VALUE 0x3CC6 CONST_0 100.000000 F00058 0.000000 255.000000 FUNCTION_LIST Fehlerfilter Kontrolle /end CHARACTERISTIC
/begin CHARACTERISTIC K_ED_FIL_CTL[87] "" VALUE 0x3CD4 CONST_0 100.000000 F00058 0.000000 255.000000 FUNCTION_LIST Fehlerfilter Kontrolle /end CHARACTERISTIC
/begin CHARACTERISTIC K_ED_FIL_CTL[88] "" VALUE 0x3CE2 CONST_0 100.000000 F00058 0.000000 255.000000 FUNCTION_LIST Fehlerfilter Kontrolle /end CHARACTERISTIC
/begin CHARACTERISTIC K_ED_FIL_CTL[89] "" VALUE 0x3CF0 CONST_0 100.000000 F00058 0.000000 255.000000 FUNCTION_LIST Fehlerfilter Kontrolle /end CHARACTERISTIC
/begin CHARACTERISTIC K_ED_FIL_CTL[90] "" VALUE 0x3CFE CONST_0 100.000000 F00058 0.000000 255.000000 FUNCTION_LIST Fehlerfilter Kontrolle /end CHARACTERISTIC
/begin CHARACTERISTIC K_ED_FIL_CTL[91] "" VALUE 0x3D0C CONST_0 100.000000 F00058 0.000000 255.000000 FUNCTION_LIST Fehlerfilter Kontrolle /end CHARACTERISTIC
/begin CHARACTERISTIC K_ED_FIL_CTL[92] "" VALUE 0x3D1A CONST_0 100.000000 F00058 0.000000 255.000000 FUNCTION_LIST Fehlerfilter Kontrolle /end CHARACTERISTIC
/begin CHARACTERISTIC K_ED_FIL_CTL[93] "" VALUE 0x3D28 CONST_0 100.000000 F00058 0.000000 255.000000 FUNCTION_LIST Fehlerfilter Kontrolle /end CHARACTERISTIC
/begin CHARACTERISTIC K_ED_FIL_CTL[94] "" VALUE 0x3D36 CONST_0 100.000000 F00058 0.000000 255.000000 FUNCTION_LIST Fehlerfilter Kontrolle /end CHARACTERISTIC
/begin CHARACTERISTIC K_ED_FIL_CTL[95] "" VALUE 0x3D44 CONST_0 100.000000 F00058 0.000000 255.000000 FUNCTION_LIST Fehlerfilter Kontrolle /end CHARACTERISTIC
/begin CHARACTERISTIC K_ED_FIL_CTL[96] "" VALUE 0x3D52 CONST_0 100.000000 F00058 0.000000 255.000000 FUNCTION_LIST Fehlerfilter Kontrolle /end CHARACTERISTIC
/begin CHARACTERISTIC K_ED_FIL_CTL[97] "" VALUE 0x3D60 CONST_0 100.000000 F00058 0.000000 255.000000 FUNCTION_LIST Fehlerfilter Kontrolle /end CHARACTERISTIC
/begin CHARACTERISTIC K_ED_FIL_CTL[98] "" VALUE 0x3D6E CONST_0 100.000000 F00058 0.000000 255.000000 FUNCTION_LIST Fehlerfilter Kontrolle /end CHARACTERISTIC
/begin CHARACTERISTIC K_ED_FIL_CTL[99] "" VALUE 0x3D7C CONST_0 100.000000 F00058 0.000000 255.000000 FUNCTION_LIST Fehlerfilter Kontrolle /end CHARACTERISTIC
/begin CHARACTERISTIC K_ED_FIL_CTL[100] "" VALUE 0x3D8A CONST_0 100.000000 F00058 0.000000 255.000000 FUNCTION_LIST Fehlerfilter Kontrolle /end CHARACTERISTIC
/begin CHARACTERISTIC K_ED_FIL_CTL[101] "" VALUE 0x3D98 CONST_0 100.000000 F00058 0.000000 255.000000 FUNCTION_LIST Fehlerfilter Kontrolle /end CHARACTERISTIC
/begin CHARACTERISTIC K_ED_FIL_CTL[102] "" VALUE 0x3DA6 CONST_0 100.000000 F00058 0.000000 255.000000 FUNCTION_LIST Fehlerfilter Kontrolle /end CHARACTERISTIC
/begin CHARACTERISTIC K_ED_FIL_CTL[103] "" VALUE 0x3DB4 CONST_0 100.000000 F00058 0.000000 255.000000 FUNCTION_LIST Fehlerfilter Kontrolle /end CHARACTERISTIC
/begin CHARACTERISTIC K_ED_FIL_CTL[104] "" VALUE 0x3DC2 CONST_0 100.000000 F00058 0.000000 255.000000 FUNCTION_LIST Fehlerfilter Kontrolle /end CHARACTERISTIC
/begin CHARACTERISTIC K_ED_FIL_CTL[105] "" VALUE 0x3DD0 CONST_0 100.000000 F00058 0.000000 255.000000 FUNCTION_LIST Fehlerfilter Kontrolle /end CHARACTERISTIC
/begin CHARACTERISTIC K_ED_FIL_CTL[106] "" VALUE 0x3DDE CONST_0 100.000000 F00058 0.000000 255.000000 FUNCTION_LIST Fehlerfilter Kontrolle /end CHARACTERISTIC
/begin CHARACTERISTIC K_ED_FIL_CTL[107] "" VALUE 0x3DEC CONST_0 100.000000 F00058 0.000000 255.000000 FUNCTION_LIST Fehlerfilter Kontrolle /end CHARACTERISTIC
/begin CHARACTERISTIC K_ED_FIL_CTL[108] "" VALUE 0x3DFA CONST_0 100.000000 F00058 0.000000 255.000000 FUNCTION_LIST Fehlerfilter Kontrolle /end CHARACTERISTIC
/begin CHARACTERISTIC K_ED_FIL_CTL[109] "" VALUE 0x3E08 CONST_0 100.000000 F00058 0.000000 255.000000 FUNCTION_LIST Fehlerfilter Kontrolle /end CHARACTERISTIC
/begin CHARACTERISTIC K_ED_FIL_CTL[110] "" VALUE 0x3E16 CONST_0 100.000000 F00058 0.000000 255.000000 FUNCTION_LIST Fehlerfilter Kontrolle /end CHARACTERISTIC
/begin CHARACTERISTIC K_ED_FIL_CTL[111] "" VALUE 0x3E24 CONST_0 100.000000 F00058 0.000000 255.000000 FUNCTION_LIST Fehlerfilter Kontrolle /end CHARACTERISTIC
/begin CHARACTERISTIC K_ED_FIL_CTL[112] "" VALUE 0x3E32 CONST_0 100.000000 F00058 0.000000 255.000000 FUNCTION_LIST Fehlerfilter Kontrolle /end CHARACTERISTIC
/begin CHARACTERISTIC K_ED_FIL_CTL[113] "" VALUE 0x3E40 CONST_0 100.000000 F00058 0.000000 255.000000 FUNCTION_LIST Fehlerfilter Kontrolle /end CHARACTERISTIC
/begin CHARACTERISTIC K_ED_FIL_CTL[114] "" VALUE 0x3E4E CONST_0 100.000000 F00058 0.000000 255.000000 FUNCTION_LIST Fehlerfilter Kontrolle /end CHARACTERISTIC
/begin CHARACTERISTIC K_ED_FIL_CTL[115] "" VALUE 0x3E5C CONST_0 100.000000 F00058 0.000000 255.000000 FUNCTION_LIST Fehlerfilter Kontrolle /end CHARACTERISTIC
/begin CHARACTERISTIC K_ED_FIL_CTL[116] "" VALUE 0x3E6A CONST_0 100.000000 F00058 0.000000 255.000000 FUNCTION_LIST Fehlerfilter Kontrolle /end CHARACTERISTIC
/begin CHARACTERISTIC K_ED_FIL_CTL[117] "" VALUE 0x3E78 CONST_0 100.000000 F00058 0.000000 255.000000 FUNCTION_LIST Fehlerfilter Kontrolle /end CHARACTERISTIC
/begin CHARACTERISTIC K_ED_FIL_CTL[118] "" VALUE 0x3E86 CONST_0 100.000000 F00058 0.000000 255.000000 FUNCTION_LIST Fehlerfilter Kontrolle /end CHARACTERISTIC
/begin CHARACTERISTIC K_ED_FIL_CTL[119] "" VALUE 0x3E94 CONST_0 100.000000 F00058 0.000000 255.000000 FUNCTION_LIST Fehlerfilter Kontrolle /end CHARACTERISTIC
/begin CHARACTERISTIC K_ED_FIL_CTL[120] "" VALUE 0x3EA2 CONST_0 100.000000 F00058 0.000000 255.000000 FUNCTION_LIST Fehlerfilter Kontrolle /end CHARACTERISTIC
/begin CHARACTERISTIC K_ED_FIL_CTL[121] "" VALUE 0x3EB0 CONST_0 100.000000 F00058 0.000000 255.000000 FUNCTION_LIST Fehlerfilter Kontrolle /end CHARACTERISTIC
/begin CHARACTERISTIC K_ED_FIL_CTL[122] "" VALUE 0x3EBE CONST_0 100.000000 F00058 0.000000 255.000000 FUNCTION_LIST Fehlerfilter Kontrolle /end CHARACTERISTIC
/begin CHARACTERISTIC K_ED_FIL_CTL[123] "" VALUE 0x3ECC CONST_0 100.000000 F00058 0.000000 255.000000 FUNCTION_LIST Fehlerfilter Kontrolle /end CHARACTERISTIC
/begin CHARACTERISTIC K_ED_FIL_CTL[124] "" VALUE 0x3EDA CONST_0 100.000000 F00058 0.000000 255.000000 FUNCTION_LIST Fehlerfilter Kontrolle /end CHARACTERISTIC
/begin CHARACTERISTIC K_ED_FIL_CTL[125] "" VALUE 0x3EE8 CONST_0 100.000000 F00058 0.000000 255.000000 FUNCTION_LIST Fehlerfilter Kontrolle /end CHARACTERISTIC
/begin CHARACTERISTIC K_ED_FIL_CTL[126] "" VALUE 0x3EF6 CONST_0 100.000000 F00058 0.000000 255.000000 FUNCTION_LIST Fehlerfilter Kontrolle /end CHARACTERISTIC
/begin CHARACTERISTIC K_ED_FIL_CTL[127] "" VALUE 0x3F04 CONST_0 100.000000 F00058 0.000000 255.000000 FUNCTION_LIST Fehlerfilter Kontrolle /end CHARACTERISTIC
/begin CHARACTERISTIC K_AQ_ABS_MIN "" VALUE 0x6FB0 CONST_2 100.000000 F00281 0.000000 20000.000000 FUNCTION_LIST Relativer_Oeffnungsquerschnitt /end CHARACTERISTIC
/begin CHARACTERISTIC K_AQ_ABS_MAX "" VALUE 0x6FB2 CONST_2 100.000000 F00281 0.000000 20000.000000 FUNCTION_LIST Relativer_Oeffnungsquerschnitt /end CHARACTERISTIC
/begin CHARACTERISTIC K_AQ_SK_CONTROL "" VALUE 0x6FB4 CONST_0 100.000000 F00282 0.000000 255.000000 FUNCTION_LIST Relativer_Oeffnungsquerschnitt /end CHARACTERISTIC
/begin CHARACTERISTIC K_AR_TMOT_MIN "" VALUE 0x5820 CONST_0 100.000000 F00014 -48.000000 207.000000 FUNCTION_LIST ANTIRUCKELFUNKTION /end CHARACTERISTIC
/begin CHARACTERISTIC K_AR_NMIN "" VALUE 0x5822 CONST_2 100.000000 F00007 0.000000 10000.000000 FUNCTION_LIST ANTIRUCKELFUNKTION /end CHARACTERISTIC
/begin CHARACTERISTIC K_AR_NMAX "" VALUE 0x5824 CONST_2 100.000000 F00007 0.000000 10000.000000 FUNCTION_LIST ANTIRUCKELFUNKTION /end CHARACTERISTIC
/begin CHARACTERISTIC K_AR_RFMIN "" VALUE 0x5826 CONST_2 100.000000 F00068 0.000000 2.000000 FUNCTION_LIST ANTIRUCKELFUNKTION /end CHARACTERISTIC
/begin CHARACTERISTIC K_AR_RFMAX "" VALUE 0x5828 CONST_2 100.000000 F00068 0.000000 2.000000 FUNCTION_LIST ANTIRUCKELFUNKTION /end CHARACTERISTIC
/begin CHARACTERISTIC K_AR_VMIN "" VALUE 0x582A CONST_2 100.000000 F00004 0.000000 360.000000 FUNCTION_LIST ANTIRUCKELFUNKTION /end CHARACTERISTIC
/begin CHARACTERISTIC K_AR_VMAX "" VALUE 0x582C CONST_2 100.000000 F00004 0.000000 360.000000 FUNCTION_LIST ANTIRUCKELFUNKTION /end CHARACTERISTIC
/begin CHARACTERISTIC K_AR_T_TRIGGER "" VALUE 0x582E CONST_2 100.000000 F00016 0.000000 64.000000 FUNCTION_LIST ANTIRUCKELFUNKTION /end CHARACTERISTIC
/begin CHARACTERISTIC K_AR_T_AKTIV "" VALUE 0x5830 CONST_2 100.000000 F00016 0.000000 64.000000 FUNCTION_LIST ANTIRUCKELFUNKTION /end CHARACTERISTIC
/begin CHARACTERISTIC K_AR_ANZ_TRIGGER "" VALUE 0x5832 CONST_0 100.000000 F00013 0.000000 255.000000 FUNCTION_LIST ANTIRUCKELFUNKTION /end CHARACTERISTIC
/begin CHARACTERISTIC K_AR_ENABLE "" VALUE 0x5833 CONST_0 100.000000 F00283 0.000000 255.000000 FUNCTION_LIST ANTIRUCKELFUNKTION /end CHARACTERISTIC
/begin CHARACTERISTIC K_AR_MDB1 "" VALUE 0x5834 CONST_3 100.000000 F00145 -1000.000000 1000.000000 FUNCTION_LIST ANTIRUCKELFUNKTION /end CHARACTERISTIC
/begin CHARACTERISTIC K_AR_MDB2 "" VALUE 0x5836 CONST_3 100.000000 F00145 -1000.000000 1000.000000 FUNCTION_LIST ANTIRUCKELFUNKTION /end CHARACTERISTIC
/begin CHARACTERISTIC K_AUSS_CFG "" VALUE 0x6662 CONST_0 100.000000 F00284 0.000000 255.000000 FUNCTION_LIST Aussetzerkennung /end CHARACTERISTIC
/begin CHARACTERISTIC K_AUSS_KS "" VALUE 0x6664 CONST_2 100.000000 F00285 0.000000 257.000000 FUNCTION_LIST Aussetzerkennung /end CHARACTERISTIC
/begin CHARACTERISTIC K_AUSS_ABG1 "" VALUE 0x6666 CONST_0 100.000000 F00286 0.000000 255.000000 FUNCTION_LIST Aussetzerkennung /end CHARACTERISTIC
/begin CHARACTERISTIC K_AUSS_ABG "" VALUE 0x6667 CONST_0 100.000000 F00286 0.000000 255.000000 FUNCTION_LIST Aussetzerkennung /end CHARACTERISTIC
/begin CHARACTERISTIC K_AUSS_RATE_ABG_ZYL "" VALUE 0x6668 CONST_0 100.000000 F00286 0.000000 255.000000 FUNCTION_LIST Aussetzerkennung /end CHARACTERISTIC
/begin CHARACTERISTIC K_AUSS_ANZ_ZYL_OFF "" VALUE 0x6669 CONST_0 100.000000 F00013 0.000000 8.000000 FUNCTION_LIST Aussetzerkennung /end CHARACTERISTIC
/begin CHARACTERISTIC K_AUSS_ANZ_SA "" VALUE 0x666A CONST_0 100.000000 F00013 1.000000 255.000000 FUNCTION_LIST Aussetzerkennung /end CHARACTERISTIC
/begin CHARACTERISTIC K_AUSS_SA_TMIN "" VALUE 0x666B CONST_0 100.000000 F00028 0.000000 25.000000 FUNCTION_LIST Aussetzerkennung /end CHARACTERISTIC
/begin CHARACTERISTIC K_AVAN1_RAD "" VALUE 0x51EA CONST_1 100.000000 F00005 -360.000000 360.000000 FUNCTION_LIST Vanos /end CHARACTERISTIC
/begin CHARACTERISTIC K_AVAN1_OFFSET "" VALUE 0x51EC CONST_3 100.000000 F00006 -20.000000 80.000000 FUNCTION_LIST Vanos /end CHARACTERISTIC
/begin CHARACTERISTIC K_AVAN1_SOLL_OFFSET "" VALUE 0x51EE CONST_1 100.000000 F00011 -20.000000 80.000000 FUNCTION_LIST Vanos /end CHARACTERISTIC
/begin CHARACTERISTIC K_AVAN1_N_OFF "" VALUE 0x51F0 CONST_2 100.000000 F00007 0.000000 10000.000000 FUNCTION_LIST Vanos /end CHARACTERISTIC
/begin CHARACTERISTIC K_AVAN1_IMPULS_MIN "" VALUE 0x51F2 CONST_2 100.000000 F00008 0.000000 210.000000 FUNCTION_LIST Vanos /end CHARACTERISTIC
/begin CHARACTERISTIC K_AVAN1_SOLL_MAX "" VALUE 0x51F4 CONST_3 100.000000 F00006 -20.000000 80.000000 FUNCTION_LIST Vanos /end CHARACTERISTIC
/begin CHARACTERISTIC K_AVAN1_SOLL_MIN "" VALUE 0x51F6 CONST_3 100.000000 F00006 -20.000000 80.000000 FUNCTION_LIST Vanos /end CHARACTERISTIC
/begin CHARACTERISTIC K_AVAN1_SOLL_ERSATZ "" VALUE 0x51F8 CONST_3 100.000000 F00006 -20.000000 80.000000 FUNCTION_LIST Vanos /end CHARACTERISTIC
/begin CHARACTERISTIC K_AVAN1_SOLL_DICHT "" VALUE 0x51FA CONST_1 100.000000 F00011 -20.000000 80.000000 FUNCTION_LIST Vanos /end CHARACTERISTIC
/begin CHARACTERISTIC K_AVAN1_AUF_FAKT "" VALUE 0x51FC CONST_3 100.000000 F00288 0.000000 199.000000 FUNCTION_LIST Vanos /end CHARACTERISTIC
/begin CHARACTERISTIC K_AVAN1_AB_FAKT "" VALUE 0x51FE CONST_3 100.000000 F00288 0.000000 199.000000 FUNCTION_LIST Vanos /end CHARACTERISTIC
/begin CHARACTERISTIC K_AVAN1_T_DRUCKAB "" VALUE 0x5200 CONST_2 100.000000 F00009 0.000000 65.000000 FUNCTION_LIST Vanos /end CHARACTERISTIC
/begin CHARACTERISTIC K_AVAN1_T_ENTL "" VALUE 0x5202 CONST_2 100.000000 F00009 0.000000 65.000000 FUNCTION_LIST Vanos /end CHARACTERISTIC
/begin CHARACTERISTIC K_AVAN1_REGLER_TAU "" VALUE 0x5204 CONST_0 100.000000 F00010 0.000000 25.000000 FUNCTION_LIST Vanos /end CHARACTERISTIC
/begin CHARACTERISTIC K_AVAN1_XD_REG_MIN "" VALUE 0x5205 CONST_0 100.000000 F00006 0.000000 25.000000 FUNCTION_LIST Vanos /end CHARACTERISTIC
/begin CHARACTERISTIC K_AVAN1_XD_MAX "" VALUE 0x5206 CONST_3 100.000000 F00006 -20.000000 80.000000 FUNCTION_LIST Vanos /end CHARACTERISTIC
/begin CHARACTERISTIC K_AVAN1_ADAP_ANSCHLAG "" VALUE 0x5208 CONST_1 100.000000 F00006 -12.000000 12.000000 FUNCTION_LIST Vanos /end CHARACTERISTIC
/begin CHARACTERISTIC K_AVAN1_ADAP_SOLL_MAX "" VALUE 0x5209 CONST_1 100.000000 F00006 -12.000000 12.000000 FUNCTION_LIST Vanos /end CHARACTERISTIC
/begin CHARACTERISTIC K_AVAN1_CONTROL "" VALUE 0x520A CONST_0 100.000000 F00012 0.000000 255.000000 FUNCTION_LIST Vanos /end CHARACTERISTIC
/begin CHARACTERISTIC K_BA_AKTIV_SCHWELLE "" VALUE 0x7560 CONST_0 100.000000 F00109 0.000000 10000.000000 FUNCTION_LIST BA /end CHARACTERISTIC
/begin CHARACTERISTIC K_BA_IGN_DECAY_NEG "" VALUE 0x7561 CONST_0 100.000000 F00031 0.000000 255.000000 FUNCTION_LIST BA /end CHARACTERISTIC
/begin CHARACTERISTIC K_BA_IGN_DECAY_POS "" VALUE 0x7562 CONST_0 100.000000 F00031 0.000000 255.000000 FUNCTION_LIST BA /end CHARACTERISTIC
/begin CHARACTERISTIC K_BA_FAKT_MIN "" VALUE 0x7564 CONST_2 100.000000 F00085 0.000000 2.000000 FUNCTION_LIST BA /end CHARACTERISTIC
/begin CHARACTERISTIC K_BA_FAKT_MAX "" VALUE 0x7566 CONST_2 100.000000 F00085 0.000000 2.000000 FUNCTION_LIST BA /end CHARACTERISTIC
/begin CHARACTERISTIC K_BA_ZEIT_WIEDEREINSETZEN "" VALUE 0x7568 CONST_2 100.000000 F00216 0.000000 65535.000000 FUNCTION_LIST BA /end CHARACTERISTIC
/begin CHARACTERISTIC K_CAN_UBMIN_S "" VALUE 0x4D64 CONST_0 100.000000 F00018 0.000000 20.000000 FUNCTION_LIST CAN_Schnittstelle-Slave /end CHARACTERISTIC
/begin CHARACTERISTIC K_CAN_ED_TSPERR_S "" VALUE 0x4D65 CONST_0 100.000000 F00057 0.000000 2550.000000 FUNCTION_LIST CAN_Schnittstelle-Slave /end CHARACTERISTIC
/begin CHARACTERISTIC cfg_s.baureihe "" VALUE 0x4006 CONST_1 100.000000 F00029 -128.000000 127.000000 FUNCTION_LIST NO_FUNCTION /end CHARACTERISTIC
/begin CHARACTERISTIC cfg_s.motortyp "" VALUE 0x4007 CONST_1 100.000000 F00293 -128.000000 127.000000 FUNCTION_LIST NO_FUNCTION /end CHARACTERISTIC
/begin CHARACTERISTIC cfg_s.getriebetyp "" VALUE 0x4008 CONST_1 100.000000 F00031 -128.000000 127.000000 FUNCTION_LIST NO_FUNCTION /end CHARACTERISTIC
/begin CHARACTERISTIC cfg_s.canstand "" VALUE 0x4009 CONST_1 100.000000 F00032 -128.000000 127.000000 FUNCTION_LIST NO_FUNCTION /end CHARACTERISTIC
/begin CHARACTERISTIC cfg_s.variante "" VALUE 0x400A CONST_1 100.000000 F00033 -128.000000 127.000000 FUNCTION_LIST NO_FUNCTION /end CHARACTERISTIC
/begin CHARACTERISTIC cfg_s.kr "" VALUE 0x400B CONST_1 100.000000 F00034 -128.000000 127.000000 FUNCTION_LIST NO_FUNCTION /end CHARACTERISTIC
/begin CHARACTERISTIC cfg_s.diagnose "" VALUE 0x400E CONST_1 100.000000 F00031 -128.000000 127.000000 FUNCTION_LIST NO_FUNCTION /end CHARACTERISTIC
/begin CHARACTERISTIC cfg_s.status "" VALUE 0x400F CONST_1 100.000000 F00035 -128.000000 127.000000 FUNCTION_LIST NO_FUNCTION /end CHARACTERISTIC
/begin CHARACTERISTIC cfg_s.sg_typ "" VALUE 0x4010 CONST_1 100.000000 F00031 -128.000000 127.000000 FUNCTION_LIST NO_FUNCTION /end CHARACTERISTIC
/begin CHARACTERISTIC cfg_s.betriebsmode "" VALUE 0x4011 CONST_1 100.000000 F00294 -128.000000 127.000000 FUNCTION_LIST NO_FUNCTION /end CHARACTERISTIC
/begin CHARACTERISTIC cfg_s.egas "" VALUE 0x4012 CONST_1 100.000000 F00037 -128.000000 127.000000 FUNCTION_LIST NO_FUNCTION /end CHARACTERISTIC
/begin CHARACTERISTIC K_DKBA_NMAX "" VALUE 0x5510 CONST_0 100.000000 F00109 0.000000 10000.000000 FUNCTION_LIST DKBA /end CHARACTERISTIC
/begin CHARACTERISTIC K_EKP_CFG "" VALUE 0x7048 CONST_0 100.000000 F00297 0.000000 255.000000 FUNCTION_LIST Kraftstoffpumpe /end CHARACTERISTIC
/begin CHARACTERISTIC K_EKP_PERIOD "" VALUE 0x704A CONST_2 100.000000 F00008 3.000000 32.000000 FUNCTION_LIST Kraftstoffpumpe /end CHARACTERISTIC
/begin CHARACTERISTIC K_EKP_LOWTIME_MIN "" VALUE 0x704C CONST_0 100.000000 F00008 0.000000 0.000000 FUNCTION_LIST Kraftstoffpumpe /end CHARACTERISTIC
/begin CHARACTERISTIC K_EKP_U_SH_TO_GND "" VALUE 0x704D CONST_0 100.000000 F00298 0.000000 16.000000 FUNCTION_LIST Kraftstoffpumpe /end CHARACTERISTIC
/begin CHARACTERISTIC K_EKP_U_OPEN_LOAD "" VALUE 0x704E CONST_0 100.000000 F00298 0.000000 16.000000 FUNCTION_LIST Kraftstoffpumpe /end CHARACTERISTIC
/begin CHARACTERISTIC K_EKP_U_UNPLAUSIBEL "" VALUE 0x704F CONST_0 100.000000 F00298 0.000000 16.000000 FUNCTION_LIST Kraftstoffpumpe /end CHARACTERISTIC
/begin CHARACTERISTIC K_EKP_CRASH "" VALUE 0x7050 CONST_0 100.000000 F00028 0.000000 25.000000 FUNCTION_LIST Kraftstoffpumpe /end CHARACTERISTIC
/begin CHARACTERISTIC K_EKP_START_ENDE "" VALUE 0x7051 CONST_0 100.000000 F00017 0.000000 255.000000 FUNCTION_LIST Kraftstoffpumpe /end CHARACTERISTIC
/begin CHARACTERISTIC K_EKP_TMOT_MIN "" VALUE 0x7052 CONST_0 100.000000 F00014 -48.000000 207.000000 FUNCTION_LIST Kraftstoffpumpe /end CHARACTERISTIC
/begin CHARACTERISTIC K_EKP_TAN_MIN "" VALUE 0x7053 CONST_0 100.000000 F00014 -48.000000 207.000000 FUNCTION_LIST Kraftstoffpumpe /end CHARACTERISTIC
/begin CHARACTERISTIC K_ELU_TAN_ECKERT "" VALUE 0x7000 CONST_0 100.000000 F00014 -48.000000 207.000000 FUNCTION_LIST Elektroluefter /end CHARACTERISTIC
/begin CHARACTERISTIC K_ELU_N_ECKERT "" VALUE 0x7001 CONST_0 100.000000 F00013 0.000000 15.000000 FUNCTION_LIST Elektroluefter /end CHARACTERISTIC
/begin CHARACTERISTIC K_ELU_DIAG_V_E36_7 "" VALUE 0x7002 CONST_0 100.000000 F00004 0.000000 255.000000 FUNCTION_LIST Elektroluefter /end CHARACTERISTIC
/begin CHARACTERISTIC K_ELU_DIAG_TMOT_E36_7 "" VALUE 0x7003 CONST_0 100.000000 F00014 -48.000000 207.000000 FUNCTION_LIST Elektroluefter /end CHARACTERISTIC
/begin CHARACTERISTIC K_ELU_TMOT_E36_7 "" VALUE 0x7004 CONST_0 100.000000 F00014 -48.000000 207.000000 FUNCTION_LIST Elektroluefter /end CHARACTERISTIC
/begin CHARACTERISTIC K_ELU_TMOT_HYS_E36_7 "" VALUE 0x7005 CONST_0 100.000000 F00015 0.000000 255.000000 FUNCTION_LIST Elektroluefter /end CHARACTERISTIC
/begin CHARACTERISTIC K_ELU_V_E36_7 "" VALUE 0x7006 CONST_0 100.000000 F00004 0.000000 255.000000 FUNCTION_LIST Elektroluefter /end CHARACTERISTIC
/begin CHARACTERISTIC K_ELU_V_HYS_E36_7 "" VALUE 0x7007 CONST_0 100.000000 F00004 0.000000 255.000000 FUNCTION_LIST Elektroluefter /end CHARACTERISTIC
/begin CHARACTERISTIC K_ELU_HYS_SCHLEPP "" VALUE 0x7008 CONST_0 100.000000 F00093 0.000000 100.000000 FUNCTION_LIST Elektroluefter /end CHARACTERISTIC
/begin CHARACTERISTIC K_ELU_TKA_TMOT_DIFF "" VALUE 0x7009 CONST_0 100.000000 F00015 0.000000 255.000000 FUNCTION_LIST Elektroluefter /end CHARACTERISTIC
/begin CHARACTERISTIC K_ELU_PWM_MIN "" VALUE 0x700A CONST_0 100.000000 F00093 0.000000 49.000000 FUNCTION_LIST Elektroluefter /end CHARACTERISTIC
/begin CHARACTERISTIC K_ELU_PWM_MAX "" VALUE 0x700B CONST_0 100.000000 F00093 50.000000 100.000000 FUNCTION_LIST Elektroluefter /end CHARACTERISTIC
/begin CHARACTERISTIC K_ELU_PWM_AUS "" VALUE 0x700C CONST_0 100.000000 F00093 0.000000 10.000000 FUNCTION_LIST Elektroluefter /end CHARACTERISTIC
/begin CHARACTERISTIC K_ELU_PWM_TAU "" VALUE 0x700D CONST_0 100.000000 F00195 25.000000 0.000000 FUNCTION_LIST Elektroluefter /end CHARACTERISTIC
/begin CHARACTERISTIC K_ELU_START_TIME "" VALUE 0x700E CONST_0 100.000000 F00017 0.000000 255.000000 FUNCTION_LIST Elektroluefter /end CHARACTERISTIC
/begin CHARACTERISTIC K_ELU_UB_NORM "" VALUE 0x700F CONST_0 100.000000 F00018 5.000000 16.000000 FUNCTION_LIST Elektroluefter /end CHARACTERISTIC
/begin CHARACTERISTIC K_ELU_UB_ED "" VALUE 0x7010 CONST_0 100.000000 F00018 5.000000 16.000000 FUNCTION_LIST Elektroluefter /end CHARACTERISTIC
/begin CHARACTERISTIC K_ELU_TAN "" VALUE 0x7011 CONST_0 100.000000 F00014 -48.000000 207.000000 FUNCTION_LIST Elektroluefter /end CHARACTERISTIC
/begin CHARACTERISTIC K_ELU_TAN_HYS "" VALUE 0x7012 CONST_0 100.000000 F00015 0.000000 255.000000 FUNCTION_LIST Elektroluefter /end CHARACTERISTIC
/begin CHARACTERISTIC K_ELU_TAN_DREH "" VALUE 0x7013 CONST_0 100.000000 F00093 0.000000 100.000000 FUNCTION_LIST Elektroluefter /end CHARACTERISTIC
/begin CHARACTERISTIC K_ELU_KKOS_ERSATZ "" VALUE 0x7014 CONST_0 100.000000 F00093 0.000000 100.000000 FUNCTION_LIST Elektroluefter /end CHARACTERISTIC
/begin CHARACTERISTIC K_ELU_DIAG_OP_BEGIN "" VALUE 0x7015 CONST_0 100.000000 F00017 0.000000 255.000000 FUNCTION_LIST Elektroluefter /end CHARACTERISTIC
/begin CHARACTERISTIC K_ELU_DIAG_OP_ANSTEUER "" VALUE 0x7016 CONST_0 100.000000 F00028 0.000000 25.000000 FUNCTION_LIST Elektroluefter /end CHARACTERISTIC
/begin CHARACTERISTIC K_ELU_DIAG_OP_ABTAST "" VALUE 0x7017 CONST_0 100.000000 F00028 0.000000 25.000000 FUNCTION_LIST Elektroluefter /end CHARACTERISTIC
/begin CHARACTERISTIC K_ELU_DIAG_OP_WAIT "" VALUE 0x7018 CONST_0 100.000000 F00028 0.000000 25.000000 FUNCTION_LIST Elektroluefter /end CHARACTERISTIC
/begin CHARACTERISTIC K_ELU_DIAG_OP_PWM "" VALUE 0x7019 CONST_0 100.000000 F00093 0.000000 100.000000 FUNCTION_LIST Elektroluefter /end CHARACTERISTIC
/begin CHARACTERISTIC K_ELU_DIAG_FENSTER "" VALUE 0x701A CONST_0 100.000000 F00017 0.000000 255.000000 FUNCTION_LIST Elektroluefter /end CHARACTERISTIC
/begin CHARACTERISTIC K_ELU_DIAG_V "" VALUE 0x701B CONST_0 100.000000 F00004 0.000000 255.000000 FUNCTION_LIST Elektroluefter /end CHARACTERISTIC
/begin CHARACTERISTIC K_ELU_KKOS[1of16] "" VALUE 0x701C CONST_0 100.000000 F00093 0.000000 100.000000 FUNCTION_LIST Elektroluefter /end CHARACTERISTIC
/begin CHARACTERISTIC K_ELU_KKOS[2of16] "" VALUE 0x701D CONST_0 100.000000 F00093 0.000000 100.000000 FUNCTION_LIST Elektroluefter /end CHARACTERISTIC
/begin CHARACTERISTIC K_ELU_KKOS[3of16] "" VALUE 0x701E CONST_0 100.000000 F00093 0.000000 100.000000 FUNCTION_LIST Elektroluefter /end CHARACTERISTIC
/begin CHARACTERISTIC K_ELU_KKOS[4of16] "" VALUE 0x701F CONST_0 100.000000 F00093 0.000000 100.000000 FUNCTION_LIST Elektroluefter /end CHARACTERISTIC
/begin CHARACTERISTIC K_ELU_KKOS[5of16] "" VALUE 0x7020 CONST_0 100.000000 F00093 0.000000 100.000000 FUNCTION_LIST Elektroluefter /end CHARACTERISTIC
/begin CHARACTERISTIC K_ELU_KKOS[6of16] "" VALUE 0x7021 CONST_0 100.000000 F00093 0.000000 100.000000 FUNCTION_LIST Elektroluefter /end CHARACTERISTIC
/begin CHARACTERISTIC K_ELU_KKOS[7of16] "" VALUE 0x7022 CONST_0 100.000000 F00093 0.000000 100.000000 FUNCTION_LIST Elektroluefter /end CHARACTERISTIC
/begin CHARACTERISTIC K_ELU_KKOS[8of16] "" VALUE 0x7023 CONST_0 100.000000 F00093 0.000000 100.000000 FUNCTION_LIST Elektroluefter /end CHARACTERISTIC
/begin CHARACTERISTIC K_ELU_KKOS[9of16] "" VALUE 0x7024 CONST_0 100.000000 F00093 0.000000 100.000000 FUNCTION_LIST Elektroluefter /end CHARACTERISTIC
/begin CHARACTERISTIC K_ELU_KKOS[10of16] "" VALUE 0x7025 CONST_0 100.000000 F00093 0.000000 100.000000 FUNCTION_LIST Elektroluefter /end CHARACTERISTIC
/begin CHARACTERISTIC K_ELU_KKOS[11of16] "" VALUE 0x7026 CONST_0 100.000000 F00093 0.000000 100.000000 FUNCTION_LIST Elektroluefter /end CHARACTERISTIC
/begin CHARACTERISTIC K_ELU_KKOS[12of16] "" VALUE 0x7027 CONST_0 100.000000 F00093 0.000000 100.000000 FUNCTION_LIST Elektroluefter /end CHARACTERISTIC
/begin CHARACTERISTIC K_ELU_KKOS[13of16] "" VALUE 0x7028 CONST_0 100.000000 F00093 0.000000 100.000000 FUNCTION_LIST Elektroluefter /end CHARACTERISTIC
/begin CHARACTERISTIC K_ELU_KKOS[14of16] "" VALUE 0x7029 CONST_0 100.000000 F00093 0.000000 100.000000 FUNCTION_LIST Elektroluefter /end CHARACTERISTIC
/begin CHARACTERISTIC K_ELU_KKOS[15of16] "" VALUE 0x702A CONST_0 100.000000 F00093 0.000000 100.000000 FUNCTION_LIST Elektroluefter /end CHARACTERISTIC
/begin CHARACTERISTIC K_ELU_KKOS[16of16] "" VALUE 0x702B CONST_0 100.000000 F00093 0.000000 100.000000 FUNCTION_LIST Elektroluefter /end CHARACTERISTIC
/begin CHARACTERISTIC K_EVAN1_RAD "" VALUE 0x4E36 CONST_1 100.000000 F00005 -360.000000 360.000000 FUNCTION_LIST Vanos /end CHARACTERISTIC
/begin CHARACTERISTIC K_EVAN1_OFFSET "" VALUE 0x4E38 CONST_3 100.000000 F00006 -20.000000 80.000000 FUNCTION_LIST Vanos /end CHARACTERISTIC
/begin CHARACTERISTIC K_EVAN1_SOLL_OFFSET "" VALUE 0x4E3A CONST_1 100.000000 F00011 -20.000000 80.000000 FUNCTION_LIST Vanos /end CHARACTERISTIC
/begin CHARACTERISTIC K_EVAN1_N_OFF "" VALUE 0x4E3C CONST_2 100.000000 F00007 0.000000 10000.000000 FUNCTION_LIST Vanos /end CHARACTERISTIC
/begin CHARACTERISTIC K_EVAN1_IMPULS_MIN "" VALUE 0x4E3E CONST_2 100.000000 F00008 0.000000 210.000000 FUNCTION_LIST Vanos /end CHARACTERISTIC
/begin CHARACTERISTIC K_EVAN1_SOLL_MAX "" VALUE 0x4E40 CONST_3 100.000000 F00006 -20.000000 80.000000 FUNCTION_LIST Vanos /end CHARACTERISTIC
/begin CHARACTERISTIC K_EVAN1_SOLL_MIN "" VALUE 0x4E42 CONST_3 100.000000 F00006 -20.000000 80.000000 FUNCTION_LIST Vanos /end CHARACTERISTIC
/begin CHARACTERISTIC K_EVAN1_SOLL_ERSATZ "" VALUE 0x4E44 CONST_3 100.000000 F00006 -20.000000 80.000000 FUNCTION_LIST Vanos /end CHARACTERISTIC
/begin CHARACTERISTIC K_EVAN1_SOLL_DICHT "" VALUE 0x4E46 CONST_1 100.000000 F00011 -20.000000 80.000000 FUNCTION_LIST Vanos /end CHARACTERISTIC
/begin CHARACTERISTIC K_EVAN1_AUF_FAKT "" VALUE 0x4E48 CONST_3 100.000000 F00288 0.000000 99.000000 FUNCTION_LIST Vanos /end CHARACTERISTIC
/begin CHARACTERISTIC K_EVAN1_AB_FAKT "" VALUE 0x4E4A CONST_3 100.000000 F00288 0.000000 99.000000 FUNCTION_LIST Vanos /end CHARACTERISTIC
/begin CHARACTERISTIC K_EVAN_AB_BEGR "" VALUE 0x4E4C CONST_0 100.000000 F00299 164.000000 0.000000 FUNCTION_LIST Vanos /end CHARACTERISTIC
/begin CHARACTERISTIC K_EVAN_TMOT_BEGR "" VALUE 0x4E4D CONST_0 100.000000 F00014 -48.000000 207.000000 FUNCTION_LIST Vanos /end CHARACTERISTIC
/begin CHARACTERISTIC K_EVAN1_T_DRUCKAB "" VALUE 0x4E4E CONST_2 100.000000 F00009 0.000000 65.000000 FUNCTION_LIST Vanos /end CHARACTERISTIC
/begin CHARACTERISTIC K_EVAN_POS_ABSTELL "" VALUE 0x4E50 CONST_3 100.000000 F00006 -20.000000 80.000000 FUNCTION_LIST Vanos /end CHARACTERISTIC
/begin CHARACTERISTIC K_EVAN_T_START_DLY "" VALUE 0x4E52 CONST_2 100.000000 F00009 0.000000 65.000000 FUNCTION_LIST Vanos /end CHARACTERISTIC
/begin CHARACTERISTIC K_EVAN1_DRUCK "" VALUE 0x4E54 CONST_3 100.000000 F00006 -20.000000 80.000000 FUNCTION_LIST Vanos /end CHARACTERISTIC
/begin CHARACTERISTIC K_EVAN1_DRUCK_HYS "" VALUE 0x4E56 CONST_3 100.000000 F00006 -20.000000 80.000000 FUNCTION_LIST Vanos /end CHARACTERISTIC
/begin CHARACTERISTIC K_EVAN1_REGLER_TAU "" VALUE 0x4E58 CONST_0 100.000000 F00028 0.000000 25.000000 FUNCTION_LIST Vanos /end CHARACTERISTIC
/begin CHARACTERISTIC K_EVAN1_XD_REG_MIN "" VALUE 0x4E59 CONST_0 100.000000 F00006 0.000000 25.000000 FUNCTION_LIST Vanos /end CHARACTERISTIC
/begin CHARACTERISTIC K_EVAN1_XD_MAX "" VALUE 0x4E5A CONST_3 100.000000 F00006 -20.000000 80.000000 FUNCTION_LIST Vanos /end CHARACTERISTIC
/begin CHARACTERISTIC K_EVAN1_ADAP_ANSCHLAG "" VALUE 0x4E5C CONST_3 100.000000 F00006 -20.000000 80.000000 FUNCTION_LIST Vanos /end CHARACTERISTIC
/begin CHARACTERISTIC K_EVAN1_ADAP_SOLL_MIN "" VALUE 0x4E5E CONST_3 100.000000 F00006 -20.000000 80.000000 FUNCTION_LIST Vanos /end CHARACTERISTIC
/begin CHARACTERISTIC K_VAN1_ADAP_LIMIT "" VALUE 0x4E60 CONST_0 100.000000 F00006 0.000000 25.000000 FUNCTION_LIST Vanos /end CHARACTERISTIC
/begin CHARACTERISTIC K_VAN1_ADAP_NACHFUEHR "" VALUE 0x4E61 CONST_0 100.000000 F00006 0.000000 25.000000 FUNCTION_LIST Vanos /end CHARACTERISTIC
/begin CHARACTERISTIC K_VAN1_ADAP_DAUER "" VALUE 0x4E62 CONST_0 100.000000 F00028 0.000000 25.000000 FUNCTION_LIST Vanos /end CHARACTERISTIC
/begin CHARACTERISTIC K_VAN1_ADAP_START_DLY "" VALUE 0x4E64 CONST_2 100.000000 F00017 0.000000 65535.000000 FUNCTION_LIST Vanos /end CHARACTERISTIC
/begin CHARACTERISTIC K_VAN1_ADAP_PAUSE "" VALUE 0x4E66 CONST_0 100.000000 F00300 0.000000 255.000000 FUNCTION_LIST Vanos /end CHARACTERISTIC
/begin CHARACTERISTIC K_VAN1_ADAP_TMOT_MIN "" VALUE 0x4E67 CONST_0 100.000000 F00014 -48.000000 207.000000 FUNCTION_LIST Vanos /end CHARACTERISTIC
/begin CHARACTERISTIC K_VAN1_ADAP_TOEL_MIN "" VALUE 0x4E68 CONST_0 100.000000 F00014 -48.000000 207.000000 FUNCTION_LIST Vanos /end CHARACTERISTIC
/begin CHARACTERISTIC K_VAN1_REG_PAUSE "" VALUE 0x4E69 CONST_0 100.000000 F00047 0.000000 255.000000 FUNCTION_LIST Vanos /end CHARACTERISTIC
/begin CHARACTERISTIC K_VAN_LLR_NSOLL "" VALUE 0x4E6A CONST_2 100.000000 F00007 0.000000 10000.000000 FUNCTION_LIST Vanos /end CHARACTERISTIC
/begin CHARACTERISTIC K_EVAN1_SMG_MD_MIN "" VALUE 0x4E6C CONST_2 100.000000 F00048 0.000000 100.000000 FUNCTION_LIST Vanos /end CHARACTERISTIC
/begin CHARACTERISTIC K_EVAN1_SMG_MD_ABBR "" VALUE 0x4E6E CONST_2 100.000000 F00048 0.000000 100.000000 FUNCTION_LIST Vanos /end CHARACTERISTIC
/begin CHARACTERISTIC K_EVAN1_SMG_N_MIN "" VALUE 0x4E70 CONST_2 100.000000 F00007 0.000000 10000.000000 FUNCTION_LIST Vanos /end CHARACTERISTIC
/begin CHARACTERISTIC K_EVAN1_SMG_N_ABBR "" VALUE 0x4E72 CONST_2 100.000000 F00007 0.000000 10000.000000 FUNCTION_LIST Vanos /end CHARACTERISTIC
/begin CHARACTERISTIC K_EVAN1_SMG_AQ_REL "" VALUE 0x4E74 CONST_2 100.000000 F00290 0.000000 120.000000 FUNCTION_LIST Vanos /end CHARACTERISTIC
/begin CHARACTERISTIC K_EVAN1_SMG_DAUER_MAX "" VALUE 0x4E76 CONST_0 100.000000 F00057 0.000000 2550.000000 FUNCTION_LIST Vanos /end CHARACTERISTIC
/begin CHARACTERISTIC K_EVAN1_SMG_T_AUFREG "" VALUE 0x4E77 CONST_0 100.000000 F00057 0.000000 2550.000000 FUNCTION_LIST Vanos /end CHARACTERISTIC
/begin CHARACTERISTIC K_KVA_NORM "" VALUE 0x4BBA CONST_0 100.000000 F00056 0.000000 1.000000 FUNCTION_LIST NO_FUNCTION /end CHARACTERISTIC
/begin CHARACTERISTIC K_LA_TMOT_UNTER_SCH "" VALUE 0x7110 CONST_0 100.000000 F00303 -48.000000 207.000000 FUNCTION_LIST Lambda /end CHARACTERISTIC
/begin CHARACTERISTIC K_LA_TMOT_OBER_SCH "" VALUE 0x7111 CONST_0 100.000000 F00303 -48.000000 207.000000 FUNCTION_LIST Lambda /end CHARACTERISTIC
/begin CHARACTERISTIC K_LA_FREIGABE "" VALUE 0x7112 CONST_0 100.000000 F00013 0.000000 255.000000 FUNCTION_LIST Lambda /end CHARACTERISTIC
/begin CHARACTERISTIC K_LA_TMOT_SCHWELLE "" VALUE 0x7113 CONST_0 100.000000 F00303 -48.000000 207.000000 FUNCTION_LIST Lambda /end CHARACTERISTIC
/begin CHARACTERISTIC K_LA_T_RF "" VALUE 0x7114 CONST_2 100.000000 F00248 0.000000 65535.000000 FUNCTION_LIST Lambda /end CHARACTERISTIC
/begin CHARACTERISTIC K_LA_N_VL "" VALUE 0x7116 CONST_2 100.000000 F00304 0.000000 65535.000000 FUNCTION_LIST Lambda /end CHARACTERISTIC
/begin CHARACTERISTIC K_LA_UF "" VALUE 0x7118 CONST_2 100.000000 F00222 0.000000 65535.000000 FUNCTION_LIST Lambda /end CHARACTERISTIC
/begin CHARACTERISTIC K_LA_UM "" VALUE 0x711A CONST_2 100.000000 F00222 0.000000 65535.000000 FUNCTION_LIST Lambda /end CHARACTERISTIC
/begin CHARACTERISTIC K_LA_T_EIN "" VALUE 0x711C CONST_2 100.000000 F00248 0.000000 65535.000000 FUNCTION_LIST Lambda /end CHARACTERISTIC
/begin CHARACTERISTIC K_LA_T_AUS "" VALUE 0x711E CONST_2 100.000000 F00248 0.000000 65535.000000 FUNCTION_LIST Lambda /end CHARACTERISTIC
/begin CHARACTERISTIC K_LASN_TAU "" VALUE 0x7120 CONST_2 100.000000 F00305 0.000000 655350.000000 FUNCTION_LIST Lambda /end CHARACTERISTIC
/begin CHARACTERISTIC K_LA_LASV_TEMP "" VALUE 0x7122 CONST_2 100.000000 F00303 -48.000000 1252.000000 FUNCTION_LIST Lambda /end CHARACTERISTIC
/begin CHARACTERISTIC K_LA_LSHV_T "" VALUE 0x7124 CONST_2 100.000000 F00306 0.000000 1092.000000 FUNCTION_LIST Lambda /end CHARACTERISTIC
/begin CHARACTERISTIC K_LAS_NP "" VALUE 0x7126 CONST_2 100.000000 F00222 0.000000 65535.000000 FUNCTION_LIST Lambda /end CHARACTERISTIC
/begin CHARACTERISTIC K_LAS_M "" VALUE 0x7128 CONST_2 100.000000 F00307 0.000000 63.000000 FUNCTION_LIST Lambda /end CHARACTERISTIC
/begin CHARACTERISTIC K_LA_FMAX "" VALUE 0x712A CONST_2 100.000000 F00100 1.000000 1.000000 FUNCTION_LIST Lambda /end CHARACTERISTIC
/begin CHARACTERISTIC K_LA_FMIN "" VALUE 0x712C CONST_2 100.000000 F00100 0.000000 1.000000 FUNCTION_LIST Lambda /end CHARACTERISTIC
/begin CHARACTERISTIC K_LAS_UREF "" VALUE 0x712E CONST_2 100.000000 F00222 0.000000 65535.000000 FUNCTION_LIST Lambda /end CHARACTERISTIC
/begin CHARACTERISTIC K_LAS_R_FETT "" VALUE 0x7130 CONST_2 100.000000 F00222 0.000000 65535.000000 FUNCTION_LIST Lambda /end CHARACTERISTIC
/begin CHARACTERISTIC K_LAS_R_MAGER "" VALUE 0x7132 CONST_2 100.000000 F00222 0.000000 65535.000000 FUNCTION_LIST Lambda /end CHARACTERISTIC
/begin CHARACTERISTIC K_LAA_TMOT_MIN "" VALUE 0x7134 CONST_0 100.000000 F00303 -48.000000 207.000000 FUNCTION_LIST Lambda /end CHARACTERISTIC
/begin CHARACTERISTIC K_LAA_TMOT_MAX "" VALUE 0x7135 CONST_0 100.000000 F00303 -48.000000 207.000000 FUNCTION_LIST Lambda /end CHARACTERISTIC
/begin CHARACTERISTIC K_LAA_TAN "" VALUE 0x7136 CONST_0 100.000000 F00303 -48.000000 207.000000 FUNCTION_LIST Lambda /end CHARACTERISTIC
/begin CHARACTERISTIC K_LAA_TAU "" VALUE 0x7138 CONST_2 100.000000 F00305 0.000000 327670.000000 FUNCTION_LIST Lambda /end CHARACTERISTIC
/begin CHARACTERISTIC K_LAA_FMAX "" VALUE 0x713A CONST_2 100.000000 F00100 0.000000 2.000000 FUNCTION_LIST Lambda /end CHARACTERISTIC
/begin CHARACTERISTIC K_LAA_FMIN "" VALUE 0x713C CONST_2 100.000000 F00100 0.000000 2.000000 FUNCTION_LIST Lambda /end CHARACTERISTIC
/begin CHARACTERISTIC K_LAA_ML_SO1 "" VALUE 0x713E CONST_2 100.000000 F00095 0.000000 16383.000000 FUNCTION_LIST Lambda /end CHARACTERISTIC
/begin CHARACTERISTIC K_LAA_ML_SU2 "" VALUE 0x7140 CONST_2 100.000000 F00095 0.000000 16383.000000 FUNCTION_LIST Lambda /end CHARACTERISTIC
/begin CHARACTERISTIC K_LAA_N_SO1 "" VALUE 0x7142 CONST_2 100.000000 F00304 0.000000 65535.000000 FUNCTION_LIST Lambda /end CHARACTERISTIC
/begin CHARACTERISTIC K_LAA_RF_SU2 "" VALUE 0x7144 CONST_2 100.000000 F00068 0.000000 2.000000 FUNCTION_LIST Lambda /end CHARACTERISTIC
/begin CHARACTERISTIC K_LAA_TAU1 "" VALUE 0x7146 CONST_2 100.000000 F00305 0.000000 655350.000000 FUNCTION_LIST Lambda /end CHARACTERISTIC
/begin CHARACTERISTIC K_LAA_TAU2 "" VALUE 0x7148 CONST_2 100.000000 F00305 0.000000 655350.000000 FUNCTION_LIST Lambda /end CHARACTERISTIC
/begin CHARACTERISTIC K_LAA_T_US "" VALUE 0x714A CONST_2 100.000000 F00248 0.000000 65535.000000 FUNCTION_LIST Lambda /end CHARACTERISTIC
/begin CHARACTERISTIC K_LAA_OFFSET_MAX "" VALUE 0x714C CONST_3 100.000000 F00308 0.000000 1.000000 FUNCTION_LIST Lambda /end CHARACTERISTIC
/begin CHARACTERISTIC K_LAA_OFFSET_MIN "" VALUE 0x714E CONST_3 100.000000 F00308 -1.000000 0.000000 FUNCTION_LIST Lambda /end CHARACTERISTIC
/begin CHARACTERISTIC K_LAA_V "" VALUE 0x7150 CONST_0 100.000000 F00004 0.000000 255.000000 FUNCTION_LIST Lambda /end CHARACTERISTIC
/begin CHARACTERISTIC K_LAA_N_NORM "" VALUE 0x7151 CONST_0 100.000000 F00309 0.000000 10200.000000 FUNCTION_LIST Lambda /end CHARACTERISTIC
/begin CHARACTERISTIC K_LAA_N_NORM_MIN "" VALUE 0x7152 CONST_0 100.000000 F00309 0.000000 10200.000000 FUNCTION_LIST Lambda /end CHARACTERISTIC
/begin CHARACTERISTIC K_LA_TI_MIN "" VALUE 0x7154 CONST_2 100.000000 F00308 0.000000 2.000000 FUNCTION_LIST Lambda /end CHARACTERISTIC
/begin CHARACTERISTIC K_LAA_OFFSET_O "" VALUE 0x7156 CONST_3 100.000000 F00308 0.000000 1.000000 FUNCTION_LIST Lambda /end CHARACTERISTIC
/begin CHARACTERISTIC K_LAA_OFFSET_U "" VALUE 0x7158 CONST_3 100.000000 F00308 -1.000000 0.000000 FUNCTION_LIST Lambda /end CHARACTERISTIC
/begin CHARACTERISTIC K_LAA_F_O "" VALUE 0x715A CONST_2 100.000000 F00100 0.000000 2.000000 FUNCTION_LIST Lambda /end CHARACTERISTIC
/begin CHARACTERISTIC K_LAA_F_U "" VALUE 0x715C CONST_2 100.000000 F00100 0.000000 2.000000 FUNCTION_LIST Lambda /end CHARACTERISTIC
/begin CHARACTERISTIC K_LA_BA_OFF_POS "" VALUE 0x715E CONST_2 100.000000 F00085 0.000000 63.000000 FUNCTION_LIST Lambda /end CHARACTERISTIC
/begin CHARACTERISTIC K_LA_BA_OFF_NEG "" VALUE 0x7160 CONST_2 100.000000 F00085 0.000000 63.000000 FUNCTION_LIST Lambda /end CHARACTERISTIC
/begin CHARACTERISTIC K_LA_TMOT_KS_MIN "" VALUE 0x7162 CONST_0 100.000000 F00014 -48.000000 207.000000 FUNCTION_LIST Lambda /end CHARACTERISTIC
/begin CHARACTERISTIC K_LA_TMOT_KS_MAX "" VALUE 0x7163 CONST_0 100.000000 F00014 -48.000000 207.000000 FUNCTION_LIST Lambda /end CHARACTERISTIC
/begin CHARACTERISTIC K_LA_TMOT_HS_MIN "" VALUE 0x7164 CONST_0 100.000000 F00014 -48.000000 207.000000 FUNCTION_LIST Lambda /end CHARACTERISTIC
/begin CHARACTERISTIC K_LA_TMOT_HS_MAX "" VALUE 0x7165 CONST_0 100.000000 F00014 -48.000000 207.000000 FUNCTION_LIST Lambda /end CHARACTERISTIC
/begin CHARACTERISTIC K_LA_TV_OF_TML "" VALUE 0x7166 CONST_2 100.000000 F00017 0.000000 65535.000000 FUNCTION_LIST Lambda /end CHARACTERISTIC
/begin CHARACTERISTIC K_LA_DELTA_DYN "" VALUE 0x7168 CONST_2 100.000000 F00100 0.000000 1.000000 FUNCTION_LIST Lambda /end CHARACTERISTIC
/begin CHARACTERISTIC K_LA_T_DYN "" VALUE 0x716A CONST_2 100.000000 F00027 0.000000 655.000000 FUNCTION_LIST Lambda /end CHARACTERISTIC
/begin CHARACTERISTIC K_LA_USV_GMW_RF_MIN "" VALUE 0x716C CONST_2 100.000000 F00068 0.000000 2.000000 FUNCTION_LIST Lambda /end CHARACTERISTIC
/begin CHARACTERISTIC K_LA_USV_GMW_RF_MAX "" VALUE 0x716E CONST_2 100.000000 F00068 0.000000 2.000000 FUNCTION_LIST Lambda /end CHARACTERISTIC
/begin CHARACTERISTIC K_LA_USV_GMW_TAU "" VALUE 0x7170 CONST_2 100.000000 F00027 0.000000 655.000000 FUNCTION_LIST Lambda /end CHARACTERISTIC
/begin CHARACTERISTIC K_LA_USV_GMW_HYS "" VALUE 0x7172 CONST_2 100.000000 F00222 0.000000 1200.000000 FUNCTION_LIST Lambda /end CHARACTERISTIC
/begin CHARACTERISTIC K_LA_USV_GMW_MAX_INI "" VALUE 0x7174 CONST_2 100.000000 F00222 0.000000 1200.000000 FUNCTION_LIST Lambda /end CHARACTERISTIC
/begin CHARACTERISTIC K_LA_USV_GMW_MIN_INI "" VALUE 0x7176 CONST_2 100.000000 F00222 0.000000 1200.000000 FUNCTION_LIST Lambda /end CHARACTERISTIC
/begin CHARACTERISTIC K_LA_GRENZ_INI "" VALUE 0x7178 CONST_2 100.000000 F00222 0.000000 1200.000000 FUNCTION_LIST Lambda /end CHARACTERISTIC
/begin CHARACTERISTIC K_LA_USV_HUB_DIAG "" VALUE 0x717A CONST_2 100.000000 F00222 0.000000 1200.000000 FUNCTION_LIST Lambda /end CHARACTERISTIC
/begin CHARACTERISTIC K_LA_USV_HUB_P_SPR "" VALUE 0x717C CONST_0 100.000000 F00013 0.000000 255.000000 FUNCTION_LIST Lambda /end CHARACTERISTIC
/begin CHARACTERISTIC K_KSD_N_MIN "" VALUE 0x717E CONST_2 100.000000 F00304 0.000000 65535.000000 FUNCTION_LIST Lambda /end CHARACTERISTIC
/begin CHARACTERISTIC K_KSD_N_MAX "" VALUE 0x7180 CONST_2 100.000000 F00304 0.000000 65535.000000 FUNCTION_LIST Lambda /end CHARACTERISTIC
/begin CHARACTERISTIC K_KSD_RF_MIN "" VALUE 0x7182 CONST_2 100.000000 F00068 0.000000 2.000000 FUNCTION_LIST Lambda /end CHARACTERISTIC
/begin CHARACTERISTIC K_KSD_RF_MAX "" VALUE 0x7184 CONST_2 100.000000 F00068 0.000000 2.000000 FUNCTION_LIST Lambda /end CHARACTERISTIC
/begin CHARACTERISTIC K_KSD_P_SPR "" VALUE 0x7186 CONST_0 100.000000 F00013 0.000000 255.000000 FUNCTION_LIST Lambda /end CHARACTERISTIC
/begin CHARACTERISTIC K_KSD_TMOT_MIN "" VALUE 0x7187 CONST_0 100.000000 F00303 -48.000000 207.000000 FUNCTION_LIST Lambda /end CHARACTERISTIC
/begin CHARACTERISTIC K_KSD_TMOT_MAX "" VALUE 0x7188 CONST_0 100.000000 F00303 -48.000000 207.000000 FUNCTION_LIST Lambda /end CHARACTERISTIC
/begin CHARACTERISTIC K_KSD_TAN "" VALUE 0x7189 CONST_0 100.000000 F00303 -48.000000 207.000000 FUNCTION_LIST Lambda /end CHARACTERISTIC
/begin CHARACTERISTIC K_KSD_V "" VALUE 0x718A CONST_0 100.000000 F00004 0.000000 255.000000 FUNCTION_LIST Lambda /end CHARACTERISTIC
/begin CHARACTERISTIC K_KSD_LL_LAM_MAX "" VALUE 0x718C CONST_2 100.000000 F00100 0.000000 2.000000 FUNCTION_LIST Lambda /end CHARACTERISTIC
/begin CHARACTERISTIC K_KSD_LL_LAM_MIN "" VALUE 0x718E CONST_2 100.000000 F00100 0.000000 2.000000 FUNCTION_LIST Lambda /end CHARACTERISTIC
/begin CHARACTERISTIC K_KSD_TL_LAM_MAX "" VALUE 0x7190 CONST_2 100.000000 F00100 0.000000 2.000000 FUNCTION_LIST Lambda /end CHARACTERISTIC
/begin CHARACTERISTIC K_KSD_TL_LAM_MIN "" VALUE 0x7192 CONST_2 100.000000 F00100 0.000000 2.000000 FUNCTION_LIST Lambda /end CHARACTERISTIC
/begin CHARACTERISTIC K_KSD_DIAG_T "" VALUE 0x7194 CONST_2 100.000000 F00198 0.000000 6553.000000 FUNCTION_LIST Lambda /end CHARACTERISTIC
/begin CHARACTERISTIC K_KSD_LL_MIN_T "" VALUE 0x7196 CONST_2 100.000000 F00198 0.000000 6553.000000 FUNCTION_LIST Lambda /end CHARACTERISTIC
/begin CHARACTERISTIC K_KSD_LL_MAX_T "" VALUE 0x7198 CONST_2 100.000000 F00198 0.000000 6553.000000 FUNCTION_LIST Lambda /end CHARACTERISTIC
/begin CHARACTERISTIC K_KSD_TL_MIN_T "" VALUE 0x719A CONST_2 100.000000 F00198 0.000000 6553.000000 FUNCTION_LIST Lambda /end CHARACTERISTIC
/begin CHARACTERISTIC K_KSD_TL_MAX_T "" VALUE 0x719C CONST_2 100.000000 F00198 0.000000 6553.000000 FUNCTION_LIST Lambda /end CHARACTERISTIC
/begin CHARACTERISTIC K_KSD_OEL_SPERR_MAX "" VALUE 0x719E CONST_0 100.000000 F00013 0.000000 255.000000 FUNCTION_LIST Lambda /end CHARACTERISTIC
/begin CHARACTERISTIC K_LA_USV_KATS "" VALUE 0x71A0 CONST_2 100.000000 F00222 0.000000 1200.000000 FUNCTION_LIST Lambda /end CHARACTERISTIC
/begin CHARACTERISTIC K_LA_USN_KATS "" VALUE 0x71A2 CONST_2 100.000000 F00222 0.000000 1200.000000 FUNCTION_LIST Lambda /end CHARACTERISTIC
/begin CHARACTERISTIC K_LAS_KATS_TEMP "" VALUE 0x71A4 CONST_2 100.000000 F00303 -48.000000 1252.000000 FUNCTION_LIST Lambda /end CHARACTERISTIC
/begin CHARACTERISTIC K_LASV_T_MAX "" VALUE 0x7354 CONST_2 100.000000 F00313 0.000000 65.000000 FUNCTION_LIST Lambdadiagnose /end CHARACTERISTIC
/begin CHARACTERISTIC K_LASV_T_ERW_MAX "" VALUE 0x7356 CONST_2 100.000000 F00313 0.000000 65.000000 FUNCTION_LIST Lambdadiagnose /end CHARACTERISTIC
/begin CHARACTERISTIC K_LASV_T_MIN "" VALUE 0x7358 CONST_2 100.000000 F00313 0.000000 65.000000 FUNCTION_LIST Lambdadiagnose /end CHARACTERISTIC
/begin CHARACTERISTIC K_LASV_T_GND "" VALUE 0x735A CONST_2 100.000000 F00313 0.000000 65.000000 FUNCTION_LIST Lambdadiagnose /end CHARACTERISTIC
/begin CHARACTERISTIC K_LASV_T_OL "" VALUE 0x735C CONST_2 100.000000 F00313 0.000000 65.000000 FUNCTION_LIST Lambdadiagnose /end CHARACTERISTIC
/begin CHARACTERISTIC K_LASV_T_ERW_OL "" VALUE 0x735E CONST_2 100.000000 F00313 0.000000 65.000000 FUNCTION_LIST Lambdadiagnose /end CHARACTERISTIC
/begin CHARACTERISTIC K_LAS_FMAX "" VALUE 0x7360 CONST_2 100.000000 F00100 0.000000 2.000000 FUNCTION_LIST Lambdadiagnose /end CHARACTERISTIC
/begin CHARACTERISTIC K_LAS_TEMP "" VALUE 0x7362 CONST_2 100.000000 F00303 -48.000000 1252.000000 FUNCTION_LIST Lambdadiagnose /end CHARACTERISTIC
/begin CHARACTERISTIC K_LA_T_FMIN "" VALUE 0x7364 CONST_2 100.000000 F00313 0.000000 65.000000 FUNCTION_LIST Lambdadiagnose /end CHARACTERISTIC
/begin CHARACTERISTIC K_LA_T_FMAX "" VALUE 0x7366 CONST_2 100.000000 F00313 0.000000 65.000000 FUNCTION_LIST Lambdadiagnose /end CHARACTERISTIC
/begin CHARACTERISTIC K_LAS_UMAX "" VALUE 0x7368 CONST_2 100.000000 F00222 0.000000 65535.000000 FUNCTION_LIST Lambdadiagnose /end CHARACTERISTIC
/begin CHARACTERISTIC K_LAS_UMIN "" VALUE 0x736A CONST_2 100.000000 F00222 0.000000 65535.000000 FUNCTION_LIST Lambdadiagnose /end CHARACTERISTIC
/begin CHARACTERISTIC K_LSHV_T_AKTIV "" VALUE 0x736C CONST_2 100.000000 F00306 0.000000 1092.000000 FUNCTION_LIST Lambdadiagnose /end CHARACTERISTIC
/begin CHARACTERISTIC K_LSHN_T_AKTIV "" VALUE 0x736E CONST_2 100.000000 F00306 0.000000 1092.000000 FUNCTION_LIST Lambdadiagnose /end CHARACTERISTIC
/begin CHARACTERISTIC K_LASN_T_MAX "" VALUE 0x7370 CONST_2 100.000000 F00313 0.000000 65.000000 FUNCTION_LIST Lambdadiagnose /end CHARACTERISTIC
/begin CHARACTERISTIC K_LASN_T_OL "" VALUE 0x7372 CONST_2 100.000000 F00250 0.000000 65535.000000 FUNCTION_LIST Lambdadiagnose /end CHARACTERISTIC
/begin CHARACTERISTIC K_LASN_T_GND "" VALUE 0x7374 CONST_2 100.000000 F00313 0.000000 65.000000 FUNCTION_LIST Lambdadiagnose /end CHARACTERISTIC
/begin CHARACTERISTIC K_LAS_N_DIAG_SCHW "" VALUE 0x7376 CONST_2 100.000000 F00007 0.000000 10000.000000 FUNCTION_LIST Lambdadiagnose /end CHARACTERISTIC
/begin CHARACTERISTIC K_LAS_RF_DIAG_SCHW "" VALUE 0x7378 CONST_2 100.000000 F00068 0.000000 2.000000 FUNCTION_LIST Lambdadiagnose /end CHARACTERISTIC
/begin CHARACTERISTIC K_LAS_T_STAB "" VALUE 0x737A CONST_2 100.000000 F00313 0.000000 65.000000 FUNCTION_LIST Lambdadiagnose /end CHARACTERISTIC
/begin CHARACTERISTIC K_LAS_TABG "" VALUE 0x737C CONST_3 100.000000 F00015 -50.000000 1200.000000 FUNCTION_LIST Lambdadiagnose /end CHARACTERISTIC
/begin CHARACTERISTIC K_LANK_USF "" VALUE 0x6710 CONST_2 100.000000 F00222 0.000000 65535.000000 FUNCTION_LIST Lambda /end CHARACTERISTIC
/begin CHARACTERISTIC K_LANK_USM "" VALUE 0x6712 CONST_2 100.000000 F00222 0.000000 65535.000000 FUNCTION_LIST Lambda /end CHARACTERISTIC
/begin CHARACTERISTIC K_LANK_T_EIN "" VALUE 0x6714 CONST_2 100.000000 F00248 0.000000 65535.000000 FUNCTION_LIST Lambda /end CHARACTERISTIC
/begin CHARACTERISTIC K_LANK_T_AUS "" VALUE 0x6716 CONST_2 100.000000 F00250 0.000000 65535.000000 FUNCTION_LIST Lambda /end CHARACTERISTIC
/begin CHARACTERISTIC K_LA_T_AKTIV "" VALUE 0x6718 CONST_2 100.000000 F00248 0.000000 65535.000000 FUNCTION_LIST Lambda /end CHARACTERISTIC
/begin CHARACTERISTIC K_LANK_TKAT_SCHW "" VALUE 0x671A CONST_3 100.000000 F00243 -50.000000 1200.000000 FUNCTION_LIST Lambda /end CHARACTERISTIC
/begin CHARACTERISTIC K_LANK_ML_SCHW "" VALUE 0x671C CONST_2 100.000000 F00314 0.000000 0.000000 FUNCTION_LIST Lambda /end CHARACTERISTIC
/begin CHARACTERISTIC K_LANK_N_MAX "" VALUE 0x671E CONST_2 100.000000 F00304 0.000000 65535.000000 FUNCTION_LIST Lambda /end CHARACTERISTIC
/begin CHARACTERISTIC K_LANK_N_MIN "" VALUE 0x6720 CONST_2 100.000000 F00304 0.000000 65535.000000 FUNCTION_LIST Lambda /end CHARACTERISTIC
/begin CHARACTERISTIC K_LANK_RF_MAX "" VALUE 0x6722 CONST_2 100.000000 F00068 0.000000 2.000000 FUNCTION_LIST Lambda /end CHARACTERISTIC
/begin CHARACTERISTIC K_LANK_RF_MIN "" VALUE 0x6724 CONST_2 100.000000 F00068 0.000000 2.000000 FUNCTION_LIST Lambda /end CHARACTERISTIC
/begin CHARACTERISTIC K_LANK_I_TV_MIN "" VALUE 0x6726 CONST_3 100.000000 F00315 -640.000000 639.000000 FUNCTION_LIST Lambda /end CHARACTERISTIC
/begin CHARACTERISTIC K_LANK_I_TV_MAX "" VALUE 0x6728 CONST_3 100.000000 F00315 -640.000000 639.000000 FUNCTION_LIST Lambda /end CHARACTERISTIC
/begin CHARACTERISTIC K_LANK_I_GEM_MIN "" VALUE 0x672A CONST_3 100.000000 F00315 -640.000000 639.000000 FUNCTION_LIST Lambda /end CHARACTERISTIC
/begin CHARACTERISTIC K_LANK_I_GEM_MAX "" VALUE 0x672C CONST_3 100.000000 F00315 -640.000000 639.000000 FUNCTION_LIST Lambda /end CHARACTERISTIC
/begin CHARACTERISTIC K_LANK_I_GEM_TAU "" VALUE 0x672E CONST_2 100.000000 F00198 0.000000 3276.000000 FUNCTION_LIST Lambda /end CHARACTERISTIC
/begin CHARACTERISTIC K_LANK_I_AD_TAU "" VALUE 0x6730 CONST_2 100.000000 F00198 0.000000 3276.000000 FUNCTION_LIST Lambda /end CHARACTERISTIC
/begin CHARACTERISTIC K_LANK_TEA_SCHW "" VALUE 0x6732 CONST_2 100.000000 F00100 0.000000 2.000000 FUNCTION_LIST Lambda /end CHARACTERISTIC
/begin CHARACTERISTIC K_LANK_TAU_S "" VALUE 0x6734 CONST_2 100.000000 F00305 0.000000 655350.000000 FUNCTION_LIST Lambda /end CHARACTERISTIC
/begin CHARACTERISTIC K_LANK_FILT_UNT "" VALUE 0x6736 CONST_2 100.000000 F00222 0.000000 65535.000000 FUNCTION_LIST Lambda /end CHARACTERISTIC
/begin CHARACTERISTIC K_LANK_FILT_OB "" VALUE 0x6738 CONST_2 100.000000 F00222 0.000000 65535.000000 FUNCTION_LIST Lambda /end CHARACTERISTIC
/begin CHARACTERISTIC K_LANK_FILT_TIME "" VALUE 0x673A CONST_2 100.000000 F00248 0.000000 65535.000000 FUNCTION_LIST Lambda /end CHARACTERISTIC
/begin CHARACTERISTIC K_LANK_KA_US "" VALUE 0x73B0 CONST_2 100.000000 F00222 0.000000 65535.000000 FUNCTION_LIST Lambda-OBD /end CHARACTERISTIC
/begin CHARACTERISTIC K_LA_KA_SA_T "" VALUE 0x73B2 CONST_2 100.000000 F00313 0.000000 65.000000 FUNCTION_LIST Lambda-OBD /end CHARACTERISTIC
/begin CHARACTERISTIC K_LA_KA_ML_MIN "" VALUE 0x73B4 CONST_2 100.000000 F00314 0.000000 1.000000 FUNCTION_LIST Lambda-OBD /end CHARACTERISTIC
/begin CHARACTERISTIC K_LA_KA_ML_MAX "" VALUE 0x73B6 CONST_2 100.000000 F00314 0.000000 1.000000 FUNCTION_LIST Lambda-OBD /end CHARACTERISTIC
/begin CHARACTERISTIC K_LA_OBD_FREIGABE "" VALUE 0x73B8 CONST_0 100.000000 F00013 0.000000 255.000000 FUNCTION_LIST Lambda-OBD /end CHARACTERISTIC
/begin CHARACTERISTIC K_LA_ALT_TV_MIN "" VALUE 0x73BA CONST_3 100.000000 F00317 -1270.000000 1270.000000 FUNCTION_LIST Lambda-OBD /end CHARACTERISTIC
/begin CHARACTERISTIC K_LA_ALT_TV_MAX "" VALUE 0x73BC CONST_3 100.000000 F00317 -1270.000000 1270.000000 FUNCTION_LIST Lambda-OBD /end CHARACTERISTIC
/begin CHARACTERISTIC K_LA_ALT_TV_MAX_COUNT "" VALUE 0x73BE CONST_0 100.000000 F00013 0.000000 255.000000 FUNCTION_LIST Lambda-OBD /end CHARACTERISTIC
/begin CHARACTERISTIC K_LA_ALT_TV_MIN_COUNT "" VALUE 0x73BF CONST_0 100.000000 F00013 0.000000 255.000000 FUNCTION_LIST Lambda-OBD /end CHARACTERISTIC
/begin CHARACTERISTIC K_LA_ALT_TV_INC "" VALUE 0x73C0 CONST_0 100.000000 F00013 0.000000 255.000000 FUNCTION_LIST Lambda-OBD /end CHARACTERISTIC
/begin CHARACTERISTIC K_LA_ALT_TV_DEC "" VALUE 0x73C1 CONST_0 100.000000 F00013 0.000000 255.000000 FUNCTION_LIST Lambda-OBD /end CHARACTERISTIC
/begin CHARACTERISTIC K_LA_ALT_P_TEMP "" VALUE 0x73C2 CONST_3 100.000000 F00243 -50.000000 1200.000000 FUNCTION_LIST Lambda-OBD /end CHARACTERISTIC
/begin CHARACTERISTIC K_LA_ALT_P_TAU "" VALUE 0x73C4 CONST_2 100.000000 F00198 0.000000 6553.000000 FUNCTION_LIST Lambda-OBD /end CHARACTERISTIC
/begin CHARACTERISTIC K_LA_ALT_P_VERZ_T "" VALUE 0x73C6 CONST_2 100.000000 F00248 0.000000 65535.000000 FUNCTION_LIST Lambda-OBD /end CHARACTERISTIC
/begin CHARACTERISTIC K_LA_ALT_P_N_MIN "" VALUE 0x73C8 CONST_2 100.000000 F00304 0.000000 65535.000000 FUNCTION_LIST Lambda-OBD /end CHARACTERISTIC
/begin CHARACTERISTIC K_LA_ALT_P_N_MAX "" VALUE 0x73CA CONST_2 100.000000 F00304 0.000000 65535.000000 FUNCTION_LIST Lambda-OBD /end CHARACTERISTIC
/begin CHARACTERISTIC K_LA_ALT_P_RF_MIN "" VALUE 0x73CC CONST_2 100.000000 F00068 0.000000 2.000000 FUNCTION_LIST Lambda-OBD /end CHARACTERISTIC
/begin CHARACTERISTIC K_LA_ALT_P_RF_MAX "" VALUE 0x73CE CONST_2 100.000000 F00068 0.000000 2.000000 FUNCTION_LIST Lambda-OBD /end CHARACTERISTIC
/begin CHARACTERISTIC K_LA_ALT_P_ANZ_SPR "" VALUE 0x73D0 CONST_0 100.000000 F00013 1.000000 255.000000 FUNCTION_LIST Lambda-OBD /end CHARACTERISTIC
/begin CHARACTERISTIC K_LA_ALT_P_ANZ_DIAG "" VALUE 0x73D1 CONST_0 100.000000 F00013 0.000000 255.000000 FUNCTION_LIST Lambda-OBD /end CHARACTERISTIC
/begin CHARACTERISTIC K_LA_ALT_P_MAX "" VALUE 0x73D2 CONST_2 100.000000 F00248 0.000000 65535.000000 FUNCTION_LIST Lambda-OBD /end CHARACTERISTIC
/begin CHARACTERISTIC K_LA_ALT_P_MIN "" VALUE 0x73D4 CONST_2 100.000000 F00248 0.000000 65535.000000 FUNCTION_LIST Lambda-OBD /end CHARACTERISTIC
/begin CHARACTERISTIC K_LA_ALT_P_MAX_KONV "" VALUE 0x73D6 CONST_2 100.000000 F00248 0.000000 65535.000000 FUNCTION_LIST Lambda-OBD /end CHARACTERISTIC
/begin CHARACTERISTIC K_LA_ALT_P_MIN_KONV "" VALUE 0x73D8 CONST_2 100.000000 F00248 0.000000 65535.000000 FUNCTION_LIST Lambda-OBD /end CHARACTERISTIC
/begin CHARACTERISTIC K_LA_ALT_P_TE_SPUEL "" VALUE 0x73DA CONST_2 100.000000 F00027 0.000000 127.000000 FUNCTION_LIST Lambda-OBD /end CHARACTERISTIC
/begin CHARACTERISTIC K_LA_ALTER_S_T "" VALUE 0x73DC CONST_2 100.000000 F00198 0.000000 2550.000000 FUNCTION_LIST Lambda-OBD /end CHARACTERISTIC
/begin CHARACTERISTIC K_LA_ALTER_S_SA_US "" VALUE 0x73DE CONST_2 100.000000 F00222 0.000000 65535.000000 FUNCTION_LIST Lambda-OBD /end CHARACTERISTIC
/begin CHARACTERISTIC K_LA_ALTER_S_SA_T "" VALUE 0x73E0 CONST_2 100.000000 F00313 0.000000 65.000000 FUNCTION_LIST Lambda-OBD /end CHARACTERISTIC
/begin CHARACTERISTIC K_LA_ALTER_S_ML "" VALUE 0x73E2 CONST_2 100.000000 F00314 0.000000 1.000000 FUNCTION_LIST Lambda-OBD /end CHARACTERISTIC
/begin CHARACTERISTIC K_LA_ALTER_S_TML "" VALUE 0x73E4 CONST_2 100.000000 F00306 0.000000 1092.000000 FUNCTION_LIST Lambda-OBD /end CHARACTERISTIC
/begin CHARACTERISTIC K_LA_ALTER_S_WE_T "" VALUE 0x73E6 CONST_2 100.000000 F00313 0.000000 65.000000 FUNCTION_LIST Lambda-OBD /end CHARACTERISTIC
/begin CHARACTERISTIC K_LA_ALTER_S_SA_WE_T "" VALUE 0x73E8 CONST_2 100.000000 F00313 0.000000 65.000000 FUNCTION_LIST Lambda-OBD /end CHARACTERISTIC
/begin CHARACTERISTIC K_LA_ALTER_S_TV_T "" VALUE 0x73EA CONST_2 100.000000 F00313 0.000000 65.000000 FUNCTION_LIST Lambda-OBD /end CHARACTERISTIC
/begin CHARACTERISTIC K_LA_ALTER_US_FETT "" VALUE 0x73EC CONST_2 100.000000 F00222 0.000000 65535.000000 FUNCTION_LIST Lambda-OBD /end CHARACTERISTIC
/begin CHARACTERISTIC K_LA_ALTER_US_FETT_MAX "" VALUE 0x73EE CONST_2 100.000000 F00222 0.000000 65535.000000 FUNCTION_LIST Lambda-OBD /end CHARACTERISTIC
/begin CHARACTERISTIC K_LA_ALTER_S_NMIN "" VALUE 0x73F0 CONST_2 100.000000 F00304 0.000000 65535.000000 FUNCTION_LIST Lambda-OBD /end CHARACTERISTIC
/begin CHARACTERISTIC K_LA_ALTER_S_NMAX "" VALUE 0x73F2 CONST_2 100.000000 F00304 0.000000 65535.000000 FUNCTION_LIST Lambda-OBD /end CHARACTERISTIC
/begin CHARACTERISTIC K_LA_ALTER_S_WE_ML "" VALUE 0x73F4 CONST_2 100.000000 F00314 0.000000 1.000000 FUNCTION_LIST Lambda-OBD /end CHARACTERISTIC
/begin CHARACTERISTIC K_LA_ALTER_S_COUNT "" VALUE 0x73F6 CONST_0 100.000000 F00013 0.000000 255.000000 FUNCTION_LIST Lambda-OBD /end CHARACTERISTIC
/begin CHARACTERISTIC K_LA_KONV_T_MOT "" VALUE 0x73F8 CONST_2 100.000000 F00310 0.000000 524.000000 FUNCTION_LIST Lambda-OBD /end CHARACTERISTIC
/begin CHARACTERISTIC K_LA_KONV_DIAG_T "" VALUE 0x73FA CONST_2 100.000000 F00198 0.000000 6553.000000 FUNCTION_LIST Lambda-OBD /end CHARACTERISTIC
/begin CHARACTERISTIC K_LA_KONV_AKTIV_T "" VALUE 0x73FC CONST_2 100.000000 F00313 0.000000 8.000000 FUNCTION_LIST Lambda-OBD /end CHARACTERISTIC
/begin CHARACTERISTIC K_LA_KONV_N_MAX "" VALUE 0x73FE CONST_2 100.000000 F00304 0.000000 65535.000000 FUNCTION_LIST Lambda-OBD /end CHARACTERISTIC
/begin CHARACTERISTIC K_LA_KONV_TKAT "" VALUE 0x7400 CONST_3 100.000000 F00243 -50.000000 1200.000000 FUNCTION_LIST Lambda-OBD /end CHARACTERISTIC
/begin CHARACTERISTIC K_LA_KONV_GR_N_MAX "" VALUE 0x7402 CONST_2 100.000000 F00304 0.000000 65535.000000 FUNCTION_LIST Lambda-OBD /end CHARACTERISTIC
/begin CHARACTERISTIC K_LA_KONV_GR_N_MIN "" VALUE 0x7404 CONST_2 100.000000 F00304 0.000000 65535.000000 FUNCTION_LIST Lambda-OBD /end CHARACTERISTIC
/begin CHARACTERISTIC K_LA_KONV_GR_RF_MAX "" VALUE 0x7406 CONST_2 100.000000 F00068 0.000000 2.000000 FUNCTION_LIST Lambda-OBD /end CHARACTERISTIC
/begin CHARACTERISTIC K_LA_KONV_GR_RF_MIN "" VALUE 0x7408 CONST_2 100.000000 F00068 0.000000 2.000000 FUNCTION_LIST Lambda-OBD /end CHARACTERISTIC
/begin CHARACTERISTIC K_LA_KONV_T_UMG "" VALUE 0x740A CONST_0 100.000000 F00014 -48.000000 207.000000 FUNCTION_LIST Lambda-OBD /end CHARACTERISTIC
/begin CHARACTERISTIC K_LA_KONV_TEA_SCHW "" VALUE 0x740C CONST_2 100.000000 F00100 0.000000 2.000000 FUNCTION_LIST Lambda-OBD /end CHARACTERISTIC
/begin CHARACTERISTIC K_LA_KONV_FH_TAU "" VALUE 0x740E CONST_0 100.000000 F00195 25.000000 0.000000 FUNCTION_LIST Lambda-OBD /end CHARACTERISTIC
/begin CHARACTERISTIC K_LA_KONV_FT_TAU "" VALUE 0x740F CONST_0 100.000000 F00195 25.000000 0.000000 FUNCTION_LIST Lambda-OBD /end CHARACTERISTIC
/begin CHARACTERISTIC K_LA_KONV_APPL_TAU "" VALUE 0x7410 CONST_2 100.000000 F00198 0.000000 3276.000000 FUNCTION_LIST Lambda-OBD /end CHARACTERISTIC
/begin CHARACTERISTIC K_LA_KONV_WB_VKAT "" VALUE 0x7412 CONST_2 100.000000 F00222 0.000000 1200.000000 FUNCTION_LIST Lambda-OBD /end CHARACTERISTIC
/begin CHARACTERISTIC K_LA_KONV_ANZ_GRENZ "" VALUE 0x7414 CONST_0 100.000000 F00013 0.000000 255.000000 FUNCTION_LIST Lambda-OBD /end CHARACTERISTIC
/begin CHARACTERISTIC K_LA_KONV_KF_ADAPT "" VALUE 0x7415 CONST_0 100.000000 F00318 0.000000 1.000000 FUNCTION_LIST Lambda-OBD /end CHARACTERISTIC
/begin CHARACTERISTIC K_LA_KONV_KF_INIT "" VALUE 0x7416 CONST_3 100.000000 F00319 -1.000000 1.000000 FUNCTION_LIST Lambda-OBD /end CHARACTERISTIC
/begin CHARACTERISTIC K_LA_ALT_SPR_ANZ_MAGER "" VALUE 0x7418 CONST_0 100.000000 F00013 0.000000 255.000000 FUNCTION_LIST Lambda-OBD /end CHARACTERISTIC
/begin CHARACTERISTIC K_LA_ALT_SPR_ANZ_FETT "" VALUE 0x7419 CONST_0 100.000000 F00013 0.000000 255.000000 FUNCTION_LIST Lambda-OBD /end CHARACTERISTIC
/begin CHARACTERISTIC K_LA_ALT_SPR_M_QUOT "" VALUE 0x741A CONST_2 100.000000 F00056 0.000000 100.000000 FUNCTION_LIST Lambda-OBD /end CHARACTERISTIC
/begin CHARACTERISTIC K_LA_ALT_SPR_F_QUOT "" VALUE 0x741C CONST_2 100.000000 F00056 0.000000 100.000000 FUNCTION_LIST Lambda-OBD /end CHARACTERISTIC
/begin CHARACTERISTIC K_LA_ALT_SPR_HYS "" VALUE 0x741E CONST_2 100.000000 F00222 0.000000 1200.000000 FUNCTION_LIST Lambda-OBD /end CHARACTERISTIC
/begin CHARACTERISTIC K_LA_USV_SPR_P_SPR "" VALUE 0x7420 CONST_0 100.000000 F00013 0.000000 255.000000 FUNCTION_LIST Lambda-OBD /end CHARACTERISTIC
/begin CHARACTERISTIC K_LA_ALT_SPR_TEMP "" VALUE 0x7422 CONST_3 100.000000 F00243 -50.000000 1200.000000 FUNCTION_LIST Lambda-OBD /end CHARACTERISTIC
/begin CHARACTERISTIC K_LA_ALT_SPR_N_MIN "" VALUE 0x7424 CONST_2 100.000000 F00304 0.000000 65535.000000 FUNCTION_LIST Lambda-OBD /end CHARACTERISTIC
/begin CHARACTERISTIC K_LA_ALT_SPR_N_MAX "" VALUE 0x7426 CONST_2 100.000000 F00304 0.000000 65535.000000 FUNCTION_LIST Lambda-OBD /end CHARACTERISTIC
/begin CHARACTERISTIC K_LA_ALT_SPR_RF_MIN "" VALUE 0x7428 CONST_2 100.000000 F00068 0.000000 2.000000 FUNCTION_LIST Lambda-OBD /end CHARACTERISTIC
/begin CHARACTERISTIC K_LA_ALT_SPR_RF_MAX "" VALUE 0x742A CONST_2 100.000000 F00068 0.000000 2.000000 FUNCTION_LIST Lambda-OBD /end CHARACTERISTIC
/begin CHARACTERISTIC K_LDP_CFG "" VALUE 0x6F10 CONST_0 100.000000 F00320 0.000000 255.000000 FUNCTION_LIST Tankleckdiagnose /end CHARACTERISTIC
/begin CHARACTERISTIC K_LDP_ANZ_FAHRTEN "" VALUE 0x6F11 CONST_0 100.000000 F00031 0.000000 255.000000 FUNCTION_LIST Tankleckdiagnose /end CHARACTERISTIC
/begin CHARACTERISTIC K_LDP_GROB_OHNE_FEIN "" VALUE 0x6F12 CONST_0 100.000000 F00321 0.000000 255.000000 FUNCTION_LIST Tankleckdiagnose /end CHARACTERISTIC
/begin CHARACTERISTIC K_LDP_ANZ_DECKEL "" VALUE 0x6F13 CONST_0 100.000000 F00321 0.000000 255.000000 FUNCTION_LIST Tankleckdiagnose /end CHARACTERISTIC
/begin CHARACTERISTIC K_LDP_ANZ_DECKEL_LECK "" VALUE 0x6F14 CONST_0 100.000000 F00321 0.000000 255.000000 FUNCTION_LIST Tankleckdiagnose /end CHARACTERISTIC
/begin CHARACTERISTIC K_LDP_ABBR_FEIN "" VALUE 0x6F15 CONST_0 100.000000 F00321 0.000000 255.000000 FUNCTION_LIST Tankleckdiagnose /end CHARACTERISTIC
/begin CHARACTERISTIC K_LDP_ABBR_FEUCHT_MAX "" VALUE 0x6F16 CONST_0 100.000000 F00321 0.000000 255.000000 FUNCTION_LIST Tankleckdiagnose /end CHARACTERISTIC
/begin CHARACTERISTIC K_LDP_ABBR_FEUCHT_DECR "" VALUE 0x6F17 CONST_0 100.000000 F00321 0.000000 255.000000 FUNCTION_LIST Tankleckdiagnose /end CHARACTERISTIC
/begin CHARACTERISTIC K_LDP_I_DT2_FILT "" VALUE 0x6F18 CONST_2 100.000000 F00322 0.000000 230.000000 FUNCTION_LIST Tankleckdiagnose /end CHARACTERISTIC
/begin CHARACTERISTIC K_LDP_I_REF_KORR "" VALUE 0x6F1A CONST_0 100.000000 F00056 0.000000 1.000000 FUNCTION_LIST Tankleckdiagnose /end CHARACTERISTIC
/begin CHARACTERISTIC K_LDP_I_FAKT_CCDECKEL "" VALUE 0x6F1B CONST_0 100.000000 F00056 0.000000 1.000000 FUNCTION_LIST Tankleckdiagnose /end CHARACTERISTIC
/begin CHARACTERISTIC K_LDP_I_FAKT_GROB "" VALUE 0x6F1C CONST_0 100.000000 F00056 0.000000 1.000000 FUNCTION_LIST Tankleckdiagnose /end CHARACTERISTIC
/begin CHARACTERISTIC K_LDP_DI_STABIL "" VALUE 0x6F1E CONST_2 100.000000 F00323 0.000000 147.000000 FUNCTION_LIST Tankleckdiagnose /end CHARACTERISTIC
/begin CHARACTERISTIC K_LDP_DI_BETANK "" VALUE 0x6F20 CONST_2 100.000000 F00323 0.000000 147.000000 FUNCTION_LIST Tankleckdiagnose /end CHARACTERISTIC
/begin CHARACTERISTIC K_LDP_DI_DECKEL "" VALUE 0x6F22 CONST_2 100.000000 F00323 0.000000 147.000000 FUNCTION_LIST Tankleckdiagnose /end CHARACTERISTIC
/begin CHARACTERISTIC K_LDP_I_FAKT_P "" VALUE 0x6F24 CONST_0 100.000000 F00324 0.000000 1.000000 FUNCTION_LIST Tankleckdiagnose /end CHARACTERISTIC
/begin CHARACTERISTIC K_LDP_I_REF_MIN "" VALUE 0x6F26 CONST_2 100.000000 F00323 0.000000 147.000000 FUNCTION_LIST Tankleckdiagnose /end CHARACTERISTIC
/begin CHARACTERISTIC K_LDP_I_REF_MAX "" VALUE 0x6F28 CONST_2 100.000000 F00323 0.000000 147.000000 FUNCTION_LIST Tankleckdiagnose /end CHARACTERISTIC
/begin CHARACTERISTIC K_LDP_I_REF_DIFF "" VALUE 0x6F2A CONST_2 100.000000 F00323 0.000000 147.000000 FUNCTION_LIST Tankleckdiagnose /end CHARACTERISTIC
/begin CHARACTERISTIC K_LDP_I_REF_1_2_DIFF "" VALUE 0x6F2C CONST_2 100.000000 F00323 0.000000 147.000000 FUNCTION_LIST Tankleckdiagnose /end CHARACTERISTIC
/begin CHARACTERISTIC K_LDP_T_ABSTELL "" VALUE 0x6F2E CONST_2 100.000000 F00223 0.000000 65535.000000 FUNCTION_LIST Tankleckdiagnose /end CHARACTERISTIC
/begin CHARACTERISTIC K_LDP_T_ML_MIN "" VALUE 0x6F30 CONST_2 100.000000 F00325 0.000000 30.000000 FUNCTION_LIST Tankleckdiagnose /end CHARACTERISTIC
/begin CHARACTERISTIC K_LDP_T_DECKEL_ML_MIN "" VALUE 0x6F32 CONST_2 100.000000 F00325 0.000000 30.000000 FUNCTION_LIST Tankleckdiagnose /end CHARACTERISTIC
/begin CHARACTERISTIC K_LDP_T_START_DLY "" VALUE 0x6F34 CONST_0 100.000000 F00028 0.000000 25.000000 FUNCTION_LIST Tankleckdiagnose /end CHARACTERISTIC
/begin CHARACTERISTIC K_LDP_T_AY_DLY "" VALUE 0x6F35 CONST_0 100.000000 F00028 0.000000 25.000000 FUNCTION_LIST Tankleckdiagnose /end CHARACTERISTIC
/begin CHARACTERISTIC K_LDP_T_REF "" VALUE 0x6F36 CONST_0 100.000000 F00028 0.000000 25.000000 FUNCTION_LIST Tankleckdiagnose /end CHARACTERISTIC
/begin CHARACTERISTIC K_LDP_T_VENT_CHK "" VALUE 0x6F37 CONST_0 100.000000 F00028 0.000000 25.000000 FUNCTION_LIST Tankleckdiagnose /end CHARACTERISTIC
/begin CHARACTERISTIC K_LDP_T_MESS_GES "" VALUE 0x6F38 CONST_2 100.000000 F00028 0.000000 810.000000 FUNCTION_LIST Tankleckdiagnose /end CHARACTERISTIC
/begin CHARACTERISTIC K_LDP_T_CC_DAUER "" VALUE 0x6F3A CONST_2 100.000000 F00028 0.000000 6553.000000 FUNCTION_LIST Tankleckdiagnose /end CHARACTERISTIC
/begin CHARACTERISTIC K_LDP_T_VENT_UM "" VALUE 0x6F3C CONST_0 100.000000 F00027 0.000000 2.000000 FUNCTION_LIST Tankleckdiagnose /end CHARACTERISTIC
/begin CHARACTERISTIC K_LDP_T_KURZSCHL "" VALUE 0x6F3D CONST_0 100.000000 F00047 0.000000 255.000000 FUNCTION_LIST Tankleckdiagnose /end CHARACTERISTIC
/begin CHARACTERISTIC K_LDP_DU_MAX "" VALUE 0x6F3E CONST_0 100.000000 F00018 0.000000 20.000000 FUNCTION_LIST Tankleckdiagnose /end CHARACTERISTIC
/begin CHARACTERISTIC K_LDP_UB_MAX "" VALUE 0x6F3F CONST_0 100.000000 F00018 0.000000 20.000000 FUNCTION_LIST Tankleckdiagnose /end CHARACTERISTIC
/begin CHARACTERISTIC K_LDP_UB_MIN "" VALUE 0x6F40 CONST_0 100.000000 F00018 0.000000 20.000000 FUNCTION_LIST Tankleckdiagnose /end CHARACTERISTIC
/begin CHARACTERISTIC K_LDP_TEMP_MAX "" VALUE 0x6F41 CONST_0 100.000000 F00014 -48.000000 207.000000 FUNCTION_LIST Tankleckdiagnose /end CHARACTERISTIC
/begin CHARACTERISTIC K_LDP_TEMP_MIN "" VALUE 0x6F42 CONST_0 100.000000 F00014 -48.000000 207.000000 FUNCTION_LIST Tankleckdiagnose /end CHARACTERISTIC
/begin CHARACTERISTIC K_LDP_TEMP_DECKEL_MAX "" VALUE 0x6F43 CONST_0 100.000000 F00014 -48.000000 207.000000 FUNCTION_LIST Tankleckdiagnose /end CHARACTERISTIC
/begin CHARACTERISTIC K_LDP_TEMP_DECKEL_MIN "" VALUE 0x6F44 CONST_0 100.000000 F00014 -48.000000 207.000000 FUNCTION_LIST Tankleckdiagnose /end CHARACTERISTIC
/begin CHARACTERISTIC K_LDP_TEMP_VENT_MIN "" VALUE 0x6F45 CONST_0 100.000000 F00014 -48.000000 207.000000 FUNCTION_LIST Tankleckdiagnose /end CHARACTERISTIC
/begin CHARACTERISTIC K_LDP_TEMP_START_MIN "" VALUE 0x6F46 CONST_0 100.000000 F00014 -48.000000 207.000000 FUNCTION_LIST Tankleckdiagnose /end CHARACTERISTIC
/begin CHARACTERISTIC K_LDP_V_MIN "" VALUE 0x6F47 CONST_0 100.000000 F00004 0.000000 255.000000 FUNCTION_LIST Tankleckdiagnose /end CHARACTERISTIC
/begin CHARACTERISTIC K_LDP_I_KURZSCHL "" VALUE 0x6F48 CONST_2 100.000000 F00323 0.000000 147.000000 FUNCTION_LIST Tankleckdiagnose /end CHARACTERISTIC
/begin CHARACTERISTIC K_LDP_TP_I_ROH "" VALUE 0x6F4A CONST_0 100.000000 F00047 0.000000 255.000000 FUNCTION_LIST Tankleckdiagnose /end CHARACTERISTIC
/begin CHARACTERISTIC K_LDP_TP_UB "" VALUE 0x6F4B CONST_0 100.000000 F00047 0.000000 255.000000 FUNCTION_LIST Tankleckdiagnose /end CHARACTERISTIC
/begin CHARACTERISTIC K_LDP_TP_I_BEG "" VALUE 0x6F4C CONST_0 100.000000 F00027 0.000000 2.000000 FUNCTION_LIST Tankleckdiagnose /end CHARACTERISTIC
/begin CHARACTERISTIC K_LDP_TP_I "" VALUE 0x6F4E CONST_2 100.000000 F00027 0.000000 655.000000 FUNCTION_LIST Tankleckdiagnose /end CHARACTERISTIC
/begin CHARACTERISTIC K_LDP_TP_I_TANK "" VALUE 0x6F50 CONST_2 100.000000 F00027 0.000000 655.000000 FUNCTION_LIST Tankleckdiagnose /end CHARACTERISTIC
/begin CHARACTERISTIC K_LDP_FST_MAX "" VALUE 0x6F52 CONST_0 100.000000 F00091 0.000000 255.000000 FUNCTION_LIST Tankleckdiagnose /end CHARACTERISTIC
/begin CHARACTERISTIC K_LDP_FST_MIN "" VALUE 0x6F53 CONST_0 100.000000 F00091 0.000000 255.000000 FUNCTION_LIST Tankleckdiagnose /end CHARACTERISTIC
/begin CHARACTERISTIC K_LDP_FST_DECKEL_MAX "" VALUE 0x6F54 CONST_0 100.000000 F00091 0.000000 255.000000 FUNCTION_LIST Tankleckdiagnose /end CHARACTERISTIC
/begin CHARACTERISTIC K_LDP_P_MIN "" VALUE 0x6F55 CONST_0 100.000000 F00104 500.000000 1150.000000 FUNCTION_LIST Tankleckdiagnose /end CHARACTERISTIC
/begin CHARACTERISTIC K_LDP_AY_MAX "" VALUE 0x6F56 CONST_1 100.000000 F00193 0.000000 12.000000 FUNCTION_LIST Tankleckdiagnose /end CHARACTERISTIC
/begin CHARACTERISTIC K_LDP_FAKT_T_DECKEL "" VALUE 0x6F57 CONST_0 100.000000 F00131 0.000000 7.000000 FUNCTION_LIST Tankleckdiagnose /end CHARACTERISTIC
/begin CHARACTERISTIC K_LDP_DI_DU "" VALUE 0x6F58 CONST_0 100.000000 F00326 0.000000 255.000000 FUNCTION_LIST Tankleckdiagnose /end CHARACTERISTIC
/begin CHARACTERISTIC K_LL_TI_FAC[1of8] "" VALUE 0x4DEE CONST_3 100.000000 F00269 -5.000000 5.000000 FUNCTION_LIST LeerLaufSYNChornisation /end CHARACTERISTIC
/begin CHARACTERISTIC K_LL_TI_FAC[2of8] "" VALUE 0x4DF0 CONST_3 100.000000 F00269 -5.000000 5.000000 FUNCTION_LIST LeerLaufSYNChornisation /end CHARACTERISTIC
/begin CHARACTERISTIC K_LL_TI_FAC[3of8] "" VALUE 0x4DF2 CONST_3 100.000000 F00269 -5.000000 5.000000 FUNCTION_LIST LeerLaufSYNChornisation /end CHARACTERISTIC
/begin CHARACTERISTIC K_LL_TI_FAC[4of8] "" VALUE 0x4DF4 CONST_3 100.000000 F00269 -5.000000 5.000000 FUNCTION_LIST LeerLaufSYNChornisation /end CHARACTERISTIC
/begin CHARACTERISTIC K_LL_TI_FAC[5of8] "" VALUE 0x4DF6 CONST_3 100.000000 F00269 -5.000000 5.000000 FUNCTION_LIST LeerLaufSYNChornisation /end CHARACTERISTIC
/begin CHARACTERISTIC K_LL_TI_FAC[6of8] "" VALUE 0x4DF8 CONST_3 100.000000 F00269 -5.000000 5.000000 FUNCTION_LIST LeerLaufSYNChornisation /end CHARACTERISTIC
/begin CHARACTERISTIC K_LL_TI_FAC[7of8] "" VALUE 0x4DFA CONST_3 100.000000 F00269 -5.000000 5.000000 FUNCTION_LIST LeerLaufSYNChornisation /end CHARACTERISTIC
/begin CHARACTERISTIC K_LL_TI_FAC[8of8] "" VALUE 0x4DFC CONST_3 100.000000 F00269 -5.000000 5.000000 FUNCTION_LIST LeerLaufSYNChornisation /end CHARACTERISTIC
/begin CHARACTERISTIC K_LL_ABW_MAX "" VALUE 0x4DFE CONST_3 100.000000 F00329 -2.000000 2.000000 FUNCTION_LIST LeerLaufSYNChornisation /end CHARACTERISTIC
/begin CHARACTERISTIC K_LL_SYNC_CONTROL "" VALUE 0x4E00 CONST_0 100.000000 F00330 0.000000 255.000000 FUNCTION_LIST LeerLaufSYNChornisation /end CHARACTERISTIC
/begin CHARACTERISTIC K_LL_AKTIV_CONTROL "" VALUE 0x4E01 CONST_0 100.000000 F00031 0.000000 255.000000 FUNCTION_LIST LeerLaufSYNChornisation /end CHARACTERISTIC
/begin CHARACTERISTIC K_LL_TAN_MIN "" VALUE 0x4E02 CONST_0 100.000000 F00014 -48.000000 207.000000 FUNCTION_LIST LeerLaufSYNChornisation /end CHARACTERISTIC
/begin CHARACTERISTIC K_LL_TAN_MAX "" VALUE 0x4E03 CONST_0 100.000000 F00014 -48.000000 207.000000 FUNCTION_LIST LeerLaufSYNChornisation /end CHARACTERISTIC
/begin CHARACTERISTIC K_LL_TMOT_MIN "" VALUE 0x4E04 CONST_0 100.000000 F00014 -48.000000 207.000000 FUNCTION_LIST LeerLaufSYNChornisation /end CHARACTERISTIC
/begin CHARACTERISTIC K_LL_TMOT_MAX "" VALUE 0x4E05 CONST_0 100.000000 F00014 -48.000000 207.000000 FUNCTION_LIST LeerLaufSYNChornisation /end CHARACTERISTIC
/begin CHARACTERISTIC K_LL_N_ANZ "" VALUE 0x4E06 CONST_0 100.000000 F00031 1.000000 255.000000 FUNCTION_LIST LeerLaufSYNChornisation /end CHARACTERISTIC
/begin CHARACTERISTIC K_LL_DN_MAX "" VALUE 0x4E08 CONST_2 100.000000 F00007 0.000000 10000.000000 FUNCTION_LIST LeerLaufSYNChornisation /end CHARACTERISTIC
/begin CHARACTERISTIC K_LL_N_MAX "" VALUE 0x4E0A CONST_2 100.000000 F00007 0.000000 10000.000000 FUNCTION_LIST LeerLaufSYNChornisation /end CHARACTERISTIC
/begin CHARACTERISTIC K_LL_V_MAX "" VALUE 0x4E0C CONST_2 100.000000 F00004 0.000000 360.000000 FUNCTION_LIST LeerLaufSYNChornisation /end CHARACTERISTIC
/begin CHARACTERISTIC K_LL_TEA_MIN "" VALUE 0x4E0E CONST_2 100.000000 F00100 0.000000 2.000000 FUNCTION_LIST LeerLaufSYNChornisation /end CHARACTERISTIC
/begin CHARACTERISTIC K_LL_SYNC_SPERRZEIT "" VALUE 0x4E10 CONST_2 100.000000 F00016 0.000000 64.000000 FUNCTION_LIST LeerLaufSYNChornisation /end CHARACTERISTIC
/begin CHARACTERISTIC K_LSH_UB_MAX "" VALUE 0x780C CONST_0 100.000000 F00018 0.000000 25.000000 FUNCTION_LIST Lamdasondenheizung /end CHARACTERISTIC
/begin CHARACTERISTIC K_LSH_RF_HYS "" VALUE 0x780E CONST_2 100.000000 F00068 0.000000 2.000000 FUNCTION_LIST Lamdasondenheizung /end CHARACTERISTIC
/begin CHARACTERISTIC K_LSH_TABG_MAX "" VALUE 0x7810 CONST_3 100.000000 F00015 -50.000000 1200.000000 FUNCTION_LIST Lamdasondenheizung /end CHARACTERISTIC
/begin CHARACTERISTIC K_LSH_TKAT_MAX "" VALUE 0x7812 CONST_3 100.000000 F00015 -50.000000 1200.000000 FUNCTION_LIST Lamdasondenheizung /end CHARACTERISTIC
/begin CHARACTERISTIC K_LSH_TAUP "" VALUE 0x7814 CONST_3 100.000000 F00015 -50.000000 1200.000000 FUNCTION_LIST Lamdasondenheizung /end CHARACTERISTIC
/begin CHARACTERISTIC K_LSH_TAUP_T "" VALUE 0x7850 CONST_2 100.000000 F00313 0.000000 66.000000 FUNCTION_LIST NO_FUNCTION /end CHARACTERISTIC
/begin CHARACTERISTIC K_LSHV1_DIAG_RU "" VALUE 0x7852 CONST_2 100.000000 F00331 0.000000 6553.000000 FUNCTION_LIST NO_FUNCTION /end CHARACTERISTIC
/begin CHARACTERISTIC K_LSHV2_DIAG_RU "" VALUE 0x7854 CONST_2 100.000000 F00331 0.000000 6553.000000 FUNCTION_LIST NO_FUNCTION /end CHARACTERISTIC
/begin CHARACTERISTIC K_LSHN1_DIAG_RU "" VALUE 0x7856 CONST_2 100.000000 F00331 0.000000 6553.000000 FUNCTION_LIST NO_FUNCTION /end CHARACTERISTIC
/begin CHARACTERISTIC K_LSHN2_DIAG_RU "" VALUE 0x7858 CONST_2 100.000000 F00331 0.000000 6553.000000 FUNCTION_LIST NO_FUNCTION /end CHARACTERISTIC
/begin CHARACTERISTIC K_LSHV1_DIAG_RO "" VALUE 0x785A CONST_2 100.000000 F00331 0.000000 6553.000000 FUNCTION_LIST NO_FUNCTION /end CHARACTERISTIC
/begin CHARACTERISTIC K_LSHV2_DIAG_RO "" VALUE 0x785C CONST_2 100.000000 F00331 0.000000 6553.000000 FUNCTION_LIST NO_FUNCTION /end CHARACTERISTIC
/begin CHARACTERISTIC K_LSHN1_DIAG_RO "" VALUE 0x785E CONST_2 100.000000 F00331 0.000000 6553.000000 FUNCTION_LIST NO_FUNCTION /end CHARACTERISTIC
/begin CHARACTERISTIC K_LSHN2_DIAG_RO "" VALUE 0x7860 CONST_2 100.000000 F00331 0.000000 6553.000000 FUNCTION_LIST NO_FUNCTION /end CHARACTERISTIC
/begin CHARACTERISTIC K_LSH_R_TAU "" VALUE 0x7862 CONST_0 100.000000 F00196 2.000000 0.000000 FUNCTION_LIST NO_FUNCTION /end CHARACTERISTIC
/begin CHARACTERISTIC K_LU_CFG "" VALUE 0x5F9C CONST_0 100.000000 F00332 0.000000 255.000000 FUNCTION_LIST Laufunruhe /end CHARACTERISTIC
/begin CHARACTERISTIC K_LU_N_MIN "" VALUE 0x5F9E CONST_2 100.000000 F00007 0.000000 10000.000000 FUNCTION_LIST Laufunruhe /end CHARACTERISTIC
/begin CHARACTERISTIC K_LU_START_DELAY "" VALUE 0x5FA0 CONST_2 100.000000 F00009 0.000000 20.000000 FUNCTION_LIST Laufunruhe /end CHARACTERISTIC
/begin CHARACTERISTIC K_LU_SCHW_ANH "" VALUE 0x5FA2 CONST_0 100.000000 F00131 0.000000 7.000000 FUNCTION_LIST Laufunruhe /end CHARACTERISTIC
/begin CHARACTERISTIC K_LU_SCHW_EV_ERR "" VALUE 0x5FA3 CONST_0 100.000000 F00131 0.000000 7.000000 FUNCTION_LIST Laufunruhe /end CHARACTERISTIC
/begin CHARACTERISTIC K_LU_SA_DELAY "" VALUE 0x5FA4 CONST_0 100.000000 F00028 0.000000 25.000000 FUNCTION_LIST Laufunruhe /end CHARACTERISTIC
/begin CHARACTERISTIC K_LU_KKOS_DELAY "" VALUE 0x5FA5 CONST_0 100.000000 F00028 0.000000 25.000000 FUNCTION_LIST Laufunruhe /end CHARACTERISTIC
/begin CHARACTERISTIC K_LU_KUPPL_DELAY "" VALUE 0x5FA6 CONST_0 100.000000 F00028 0.000000 25.000000 FUNCTION_LIST Laufunruhe /end CHARACTERISTIC
/begin CHARACTERISTIC K_LU_AUSKUPPL_DELAY "" VALUE 0x5FA7 CONST_0 100.000000 F00028 0.000000 25.000000 FUNCTION_LIST Laufunruhe /end CHARACTERISTIC
/begin CHARACTERISTIC K_LU_SWE_DELAY "" VALUE 0x5FA8 CONST_0 100.000000 F00028 0.000000 25.000000 FUNCTION_LIST Laufunruhe /end CHARACTERISTIC
/begin CHARACTERISTIC K_LU_MD_DELAY "" VALUE 0x5FA9 CONST_0 100.000000 F00028 0.000000 25.000000 FUNCTION_LIST Laufunruhe /end CHARACTERISTIC
/begin CHARACTERISTIC K_LU_TZ_DELAY "" VALUE 0x5FAA CONST_0 100.000000 F00265 0.000000 255.000000 FUNCTION_LIST Laufunruhe /end CHARACTERISTIC
/begin CHARACTERISTIC K_LU_TZ_DELTA "" VALUE 0x5FAC CONST_3 100.000000 F00333 0.000000 60.000000 FUNCTION_LIST Laufunruhe /end CHARACTERISTIC
/begin CHARACTERISTIC K_LU_ACT_N_MIN "" VALUE 0x5FAE CONST_2 100.000000 F00007 0.000000 10000.000000 FUNCTION_LIST Laufunruhe /end CHARACTERISTIC
/begin CHARACTERISTIC K_LU_ACT_N_MAX "" VALUE 0x5FB0 CONST_2 100.000000 F00007 0.000000 10000.000000 FUNCTION_LIST Laufunruhe /end CHARACTERISTIC
/begin CHARACTERISTIC K_LU_ADAP_DELAY "" VALUE 0x5FB2 CONST_0 100.000000 F00028 0.000000 10.000000 FUNCTION_LIST Laufunruhe /end CHARACTERISTIC
/begin CHARACTERISTIC K_LU_ADAP_N_MIN "" VALUE 0x5FB4 CONST_2 100.000000 F00007 0.000000 10000.000000 FUNCTION_LIST Laufunruhe /end CHARACTERISTIC
/begin CHARACTERISTIC K_LU_ADAP_N_MAX "" VALUE 0x5FB6 CONST_2 100.000000 F00007 0.000000 10000.000000 FUNCTION_LIST Laufunruhe /end CHARACTERISTIC
/begin CHARACTERISTIC K_LU_ADAP_GANG_MIN "" VALUE 0x5FB8 CONST_0 100.000000 F00334 0.000000 6.000000 FUNCTION_LIST Laufunruhe /end CHARACTERISTIC
/begin CHARACTERISTIC K_LU_ADAP_LIMIT "" VALUE 0x5FBA CONST_2 100.000000 F00335 0.000000 7.000000 FUNCTION_LIST Laufunruhe /end CHARACTERISTIC
/begin CHARACTERISTIC K_LU_ADAP_ENDE "" VALUE 0x5FBC CONST_2 100.000000 F00336 0.000000 65535.000000 FUNCTION_LIST Laufunruhe /end CHARACTERISTIC
/begin CHARACTERISTIC K_MCSFLA_CONTROL_S "" VALUE 0x66A8 CONST_0 100.000000 F00160 0.000000 255.000000 FUNCTION_LIST NO_FUNCTION /end CHARACTERISTIC
/begin CHARACTERISTIC K_MD_TZ_CONTROL "" VALUE 0x6900 CONST_0 100.000000 F00342 0.000000 255.000000 FUNCTION_LIST Momentenmanager /end CHARACTERISTIC
/begin CHARACTERISTIC K_MD_BEZUG_ZW "" VALUE 0x6901 CONST_0 100.000000 F00343 0.000000 255.000000 BIT_MASK 0xFF FUNCTION_LIST Momentenmanager /end CHARACTERISTIC
/begin CHARACTERISTIC K_MD_KR_CONTROL "" VALUE 0x6902 CONST_0 100.000000 F00344 0.000000 255.000000 FUNCTION_LIST Momentenmanager /end CHARACTERISTIC
/begin CHARACTERISTIC K_MD_ETA_STAT_TAU "" VALUE 0x6903 CONST_0 100.000000 F00161 0.000000 255.000000 FUNCTION_LIST Momentenmanager /end CHARACTERISTIC
/begin CHARACTERISTIC K_MD_ETA_EINGRIFF "" VALUE 0x6904 CONST_2 100.000000 F00177 0.000000 100.000000 FUNCTION_LIST Momentenmanager /end CHARACTERISTIC
/begin CHARACTERISTIC K_MD_POLYNOM_A_LL "" VALUE 0x6B3A CONST_3 100.000000 F00345 -320.000000 320.000000 FUNCTION_LIST Momentenmanager /end CHARACTERISTIC
/begin CHARACTERISTIC K_MD_POLYNOM_B_LL "" VALUE 0x6B3C CONST_3 100.000000 F00345 -320.000000 320.000000 FUNCTION_LIST Momentenmanager /end CHARACTERISTIC
/begin CHARACTERISTIC K_MD_TZMIN_HYS "" VALUE 0x6B3E CONST_3 100.000000 F00045 -50.000000 60.000000 FUNCTION_LIST Momentenmanager /end CHARACTERISTIC
/begin CHARACTERISTIC K_MD_SK_ETA_MIN "" VALUE 0x6DB6 CONST_2 100.000000 F00177 0.000000 100.000000 FUNCTION_LIST Momentenmanager /end CHARACTERISTIC
/begin CHARACTERISTIC K_MD_SK_TIRED_MIN "" VALUE 0x6DB8 CONST_0 100.000000 F00031 0.000000 8.000000 FUNCTION_LIST Momentenmanager /end CHARACTERISTIC
/begin CHARACTERISTIC K_MD_SK_TIRED_HYS "" VALUE 0x6DBA CONST_2 100.000000 F00192 0.000000 10.000000 FUNCTION_LIST Momentenmanager /end CHARACTERISTIC
/begin CHARACTERISTIC K_NFF_ZYL_ENABLE "" VALUE 0x57BA CONST_0 100.000000 F00013 0.000000 1.000000 FUNCTION_LIST Klopfen /end CHARACTERISTIC
/begin CHARACTERISTIC K_NFF_ZYL "" VALUE 0x57BB CONST_0 100.000000 F00013 1.000000 8.000000 FUNCTION_LIST Klopfen /end CHARACTERISTIC
/begin CHARACTERISTIC K_SA_N40_HYS "" VALUE 0x4D70 CONST_0 100.000000 F00109 0.000000 10000.000000 FUNCTION_LIST SA_WE /end CHARACTERISTIC
/begin CHARACTERISTIC K_SA_MSR_SPERRZEIT "" VALUE 0x4D71 CONST_0 100.000000 F00027 0.000000 2.000000 FUNCTION_LIST SA_WE /end CHARACTERISTIC
/begin CHARACTERISTIC K_SA_MD_NE_MIN "" VALUE 0x4D72 CONST_2 100.000000 F00145 0.000000 1000.000000 FUNCTION_LIST SA_WE /end CHARACTERISTIC
/begin CHARACTERISTIC K_WE_MD_HYS "" VALUE 0x4D74 CONST_2 100.000000 F00145 0.000000 1000.000000 FUNCTION_LIST SA_WE /end CHARACTERISTIC
/begin CHARACTERISTIC K_WE_DN40_HARD "" VALUE 0x4D76 CONST_1 100.000000 F00346 -5000.000000 5000.000000 FUNCTION_LIST SA_WE /end CHARACTERISTIC
/begin CHARACTERISTIC K_SA_MD_HYS "" VALUE 0x4D78 CONST_2 100.000000 F00145 0.000000 1000.000000 FUNCTION_LIST SA_WE /end CHARACTERISTIC
/begin CHARACTERISTIC K_SA_N40_KKOS_ON "" VALUE 0x4D7A CONST_0 100.000000 F00109 0.000000 10000.000000 FUNCTION_LIST SA_WE /end CHARACTERISTIC
/begin CHARACTERISTIC K_SA_WDK "" VALUE 0x4D7B CONST_0 100.000000 F00041 0.000000 100.000000 FUNCTION_LIST SA_WE /end CHARACTERISTIC
/begin CHARACTERISTIC K_SA_TZ_MIN_HYS "" VALUE 0x4D7C CONST_3 100.000000 F00045 -50.000000 60.000000 FUNCTION_LIST SA_WE /end CHARACTERISTIC
/begin CHARACTERISTIC K_SA_TKAT "" VALUE 0x4D7E CONST_3 100.000000 F00015 -50.000000 1250.000000 FUNCTION_LIST SA_WE /end CHARACTERISTIC
/begin CHARACTERISTIC K_S_GANG_LL_ED "" VALUE 0x753E CONST_2 100.000000 F00028 0.000000 6553.000000 FUNCTION_LIST Messwerte /end CHARACTERISTIC
/begin CHARACTERISTIC K_S_GANG_SA_ED "" VALUE 0x7540 CONST_0 100.000000 F00028 0.000000 25.000000 FUNCTION_LIST Messwerte /end CHARACTERISTIC
/begin CHARACTERISTIC K_S_GANG1_NV_MIN "" VALUE 0x7542 CONST_2 100.000000 F00092 0.000000 32767.000000 FUNCTION_LIST Messwerte /end CHARACTERISTIC
/begin CHARACTERISTIC K_S_GANG1_NV_MAX "" VALUE 0x7544 CONST_2 100.000000 F00092 0.000000 32767.000000 FUNCTION_LIST Messwerte /end CHARACTERISTIC
/begin CHARACTERISTIC K_S_GANG2_NV_MIN "" VALUE 0x7546 CONST_0 100.000000 F00092 0.000000 127.000000 FUNCTION_LIST Messwerte /end CHARACTERISTIC
/begin CHARACTERISTIC K_S_GANG2_NV_MAX "" VALUE 0x7547 CONST_0 100.000000 F00092 0.000000 127.000000 FUNCTION_LIST Messwerte /end CHARACTERISTIC
/begin CHARACTERISTIC K_S_GANG3_NV_MIN "" VALUE 0x7548 CONST_0 100.000000 F00092 0.000000 127.000000 FUNCTION_LIST Messwerte /end CHARACTERISTIC
/begin CHARACTERISTIC K_S_GANG3_NV_MAX "" VALUE 0x7549 CONST_0 100.000000 F00092 0.000000 127.000000 FUNCTION_LIST Messwerte /end CHARACTERISTIC
/begin CHARACTERISTIC K_S_GANG4_NV_MIN "" VALUE 0x754A CONST_0 100.000000 F00092 0.000000 127.000000 FUNCTION_LIST Messwerte /end CHARACTERISTIC
/begin CHARACTERISTIC K_S_GANG4_NV_MAX "" VALUE 0x754B CONST_0 100.000000 F00092 0.000000 127.000000 FUNCTION_LIST Messwerte /end CHARACTERISTIC
/begin CHARACTERISTIC K_S_GANG5_NV_MIN "" VALUE 0x754C CONST_0 100.000000 F00092 0.000000 127.000000 FUNCTION_LIST Messwerte /end CHARACTERISTIC
/begin CHARACTERISTIC K_S_GANG5_NV_MAX "" VALUE 0x754D CONST_0 100.000000 F00092 0.000000 127.000000 FUNCTION_LIST Messwerte /end CHARACTERISTIC
/begin CHARACTERISTIC K_S_GANG6_NV_MIN "" VALUE 0x754E CONST_0 100.000000 F00092 0.000000 127.000000 FUNCTION_LIST Messwerte /end CHARACTERISTIC
/begin CHARACTERISTIC K_S_GANG6_NV_MAX "" VALUE 0x754F CONST_0 100.000000 F00092 0.000000 127.000000 FUNCTION_LIST Messwerte /end CHARACTERISTIC
/begin CHARACTERISTIC K_S_GANG7_NV_MIN "" VALUE 0x7550 CONST_0 100.000000 F00092 0.000000 127.000000 FUNCTION_LIST Messwerte /end CHARACTERISTIC
/begin CHARACTERISTIC K_S_GANG7_NV_MAX "" VALUE 0x7551 CONST_0 100.000000 F00092 0.000000 127.000000 FUNCTION_LIST Messwerte /end CHARACTERISTIC
/begin CHARACTERISTIC K_TOGLAMP_START_E36_7 "" VALUE 0x7552 CONST_0 100.000000 F00017 0.000000 255.000000 FUNCTION_LIST Messwerte /end CHARACTERISTIC
/begin CHARACTERISTIC K_TOGLAMP_KLA_E36_7 "" VALUE 0x7553 CONST_0 100.000000 F00017 0.000000 255.000000 FUNCTION_LIST Messwerte /end CHARACTERISTIC
/begin CHARACTERISTIC K_SK_HW_AD_DELTA_MAX "" VALUE 0x7090 CONST_0 100.000000 F00239 0.000000 255.000000 FUNCTION_LIST Sicherheitskonzept /end CHARACTERISTIC
/begin CHARACTERISTIC K_SK_HW_AD_STAT_ZAEHLER "" VALUE 0x7091 CONST_0 100.000000 F00057 0.000000 2550.000000 FUNCTION_LIST Sicherheitskonzept /end CHARACTERISTIC
/begin CHARACTERISTIC K_SK_HW_AD_ED_ZAEHLER "" VALUE 0x7092 CONST_0 100.000000 F00057 0.000000 2550.000000 FUNCTION_LIST Sicherheitskonzept /end CHARACTERISTIC
/begin CHARACTERISTIC K_SK_HW_AD_STAT "" VALUE 0x7093 CONST_0 100.000000 F00239 0.000000 255.000000 FUNCTION_LIST Sicherheitskonzept /end CHARACTERISTIC
/begin CHARACTERISTIC K_SK_CONTROL_S "" VALUE 0x7094 CONST_0 100.000000 F00219 0.000000 255.000000 FUNCTION_LIST Sicherheitskonzept /end CHARACTERISTIC
/begin CHARACTERISTIC K_SK_UEBERGANG2_S "" VALUE 0x7095 CONST_0 100.000000 F00082 0.000000 5.000000 FUNCTION_LIST Sicherheitskonzept /end CHARACTERISTIC
/begin CHARACTERISTIC K_SK_UEBERGANG3_S "" VALUE 0x7096 CONST_0 100.000000 F00082 0.000000 5.000000 FUNCTION_LIST Sicherheitskonzept /end CHARACTERISTIC
/begin CHARACTERISTIC K_SK_UEBERGANG4 "" VALUE 0x7097 CONST_0 100.000000 F00082 0.000000 5.000000 FUNCTION_LIST Sicherheitskonzept /end CHARACTERISTIC
/begin CHARACTERISTIC K_SK_TR_MAX "" VALUE 0x7098 CONST_0 100.000000 F00013 0.000000 255.000000 FUNCTION_LIST Sicherheitskonzept /end CHARACTERISTIC
/begin CHARACTERISTIC K_SKS_IPK_TIMEOUT "" VALUE 0x7099 CONST_0 100.000000 F00028 0.000000 25.000000 FUNCTION_LIST Sicherheitskonzept /end CHARACTERISTIC
/begin CHARACTERISTIC K_SK_FGR_BLS_CNT "" VALUE 0x7102 CONST_0 100.000000 F00031 0.000000 255.000000 FUNCTION_LIST SK_FGR /end CHARACTERISTIC
/begin CHARACTERISTIC K_SMG_TAU_MD_FAHRER "" VALUE 0x5960 CONST_0 100.000000 F00196 2.000000 0.000000 FUNCTION_LIST smg /end CHARACTERISTIC
/begin CHARACTERISTIC K_SMG_TAU_DN_FILTER "" VALUE 0x5961 CONST_0 100.000000 F00196 2.000000 0.000000 FUNCTION_LIST smg /end CHARACTERISTIC
/begin CHARACTERISTIC K_SMG_TAU_DN_DWF "" VALUE 0x5962 CONST_0 100.000000 F00196 2.000000 0.000000 FUNCTION_LIST smg /end CHARACTERISTIC
/begin CHARACTERISTIC K_SMG_TAU_KSCHLUPF "" VALUE 0x5963 CONST_0 100.000000 F00196 2.000000 0.000000 FUNCTION_LIST smg /end CHARACTERISTIC
/begin CHARACTERISTIC K_SMG_TAU_AX_BERECH "" VALUE 0x5964 CONST_0 100.000000 F00024 5.000000 0.000000 FUNCTION_LIST smg /end CHARACTERISTIC
/begin CHARACTERISTIC K_SMG_TAU_AX_MESS "" VALUE 0x5965 CONST_0 100.000000 F00024 5.000000 0.000000 FUNCTION_LIST smg /end CHARACTERISTIC
/begin CHARACTERISTIC K_SMG_TAU_AX_BERG "" VALUE 0x5966 CONST_0 100.000000 F00024 5.000000 0.000000 FUNCTION_LIST smg /end CHARACTERISTIC
/begin CHARACTERISTIC K_SMG_TAU_DMD_FAHRER "" VALUE 0x5967 CONST_0 100.000000 F00024 5.000000 0.000000 FUNCTION_LIST smg /end CHARACTERISTIC
/begin CHARACTERISTIC K_SMG_TAU_DN_GETR_EIN "" VALUE 0x5968 CONST_0 100.000000 F00024 5.000000 0.000000 FUNCTION_LIST smg /end CHARACTERISTIC
/begin CHARACTERISTIC K_SMG_TAU_RSCHLUPF "" VALUE 0x5969 CONST_0 100.000000 F00024 5.000000 0.000000 FUNCTION_LIST smg /end CHARACTERISTIC
/begin CHARACTERISTIC K_SMG_TAU_DSC_ABS "" VALUE 0x596A CONST_0 100.000000 F00196 2.000000 0.000000 FUNCTION_LIST smg /end CHARACTERISTIC
/begin CHARACTERISTIC K_SMG_J_MOTOR "" VALUE 0x596B CONST_0 100.000000 F00349 0.000000 1.000000 FUNCTION_LIST smg /end CHARACTERISTIC
/begin CHARACTERISTIC K_SMG_R_RAD_DYN "" VALUE 0x596C CONST_2 100.000000 F00350 0.000000 6554.000000 FUNCTION_LIST smg /end CHARACTERISTIC
/begin CHARACTERISTIC K_SMG_PROG_MAX_AUTOMAT "" VALUE 0x596E CONST_0 100.000000 F00351 1.000000 5.000000 FUNCTION_LIST smg /end CHARACTERISTIC
/begin CHARACTERISTIC K_SMG_PROG_MIN_ZR "" VALUE 0x596F CONST_0 100.000000 F00351 1.000000 8.000000 FUNCTION_LIST smg /end CHARACTERISTIC
/begin CHARACTERISTIC K_SMG_N_ABRISS_HYS "" VALUE 0x5970 CONST_0 100.000000 F00007 0.000000 255.000000 FUNCTION_LIST smg /end CHARACTERISTIC
/begin CHARACTERISTIC K_SMG_N_NULL "" VALUE 0x5971 CONST_0 100.000000 F00007 0.000000 255.000000 FUNCTION_LIST smg /end CHARACTERISTIC
/begin CHARACTERISTIC K_SMG_M_NULL "" VALUE 0x5972 CONST_0 100.000000 F00145 0.000000 25.000000 FUNCTION_LIST smg /end CHARACTERISTIC
/begin CHARACTERISTIC K_SMG_KSCHLUPF_SCHW_AUF "" VALUE 0x5973 CONST_0 100.000000 F00352 0.000000 10.000000 FUNCTION_LIST smg /end CHARACTERISTIC
/begin CHARACTERISTIC K_SMG_KI_MAX_DSC "" VALUE 0x5974 CONST_0 100.000000 F00031 0.000000 12.000000 FUNCTION_LIST smg /end CHARACTERISTIC
/begin CHARACTERISTIC K_SMG_KI_AKS_AY_MAX "" VALUE 0x5975 CONST_1 100.000000 F00193 -12.000000 12.000000 FUNCTION_LIST smg /end CHARACTERISTIC
/begin CHARACTERISTIC K_SMG_KI_NEU_AY_MAX "" VALUE 0x5976 CONST_1 100.000000 F00193 -12.000000 12.000000 FUNCTION_LIST smg /end CHARACTERISTIC
/begin CHARACTERISTIC K_SMG_KI_DELTA_PWG "" VALUE 0x5977 CONST_0 100.000000 F00048 0.000000 25.000000 FUNCTION_LIST smg /end CHARACTERISTIC
/begin CHARACTERISTIC K_SMG_T_KORR_AB_MIN "" VALUE 0x5978 CONST_0 100.000000 F00057 0.000000 2550.000000 FUNCTION_LIST smg /end CHARACTERISTIC
/begin CHARACTERISTIC K_SMG_NO_LW_N_SCHW "" VALUE 0x5979 CONST_0 100.000000 F00007 0.000000 255.000000 FUNCTION_LIST smg /end CHARACTERISTIC
/begin CHARACTERISTIC K_SMG_TESTMODE "" VALUE 0x597A CONST_0 100.000000 F00353 0.000000 255.000000 FUNCTION_LIST smg /end CHARACTERISTIC
/begin CHARACTERISTIC K_SMG_MD_FW_MIN_ZUG "" VALUE 0x597C CONST_2 100.000000 F00145 0.000000 150.000000 FUNCTION_LIST smg /end CHARACTERISTIC
/begin CHARACTERISTIC K_SMG_MD_FW_MIN_SCH "" VALUE 0x597E CONST_3 100.000000 F00145 -150.000000 0.000000 FUNCTION_LIST smg /end CHARACTERISTIC
/begin CHARACTERISTIC K_SMG_MD_FW_SA_N_OFF "" VALUE 0x5980 CONST_0 100.000000 F00007 0.000000 255.000000 FUNCTION_LIST smg /end CHARACTERISTIC
/begin CHARACTERISTIC K_SMG_MD_FW_SA_D_M "" VALUE 0x5981 CONST_0 100.000000 F00181 0.000000 2550.000000 FUNCTION_LIST smg /end CHARACTERISTIC
/begin CHARACTERISTIC K_SMG_MD_FW_HYS_ZUG "" VALUE 0x5982 CONST_0 100.000000 F00145 0.000000 25.000000 FUNCTION_LIST smg /end CHARACTERISTIC
/begin CHARACTERISTIC K_SMG_MD_FW_HYS_SCH "" VALUE 0x5983 CONST_0 100.000000 F00354 0.000000 -25.000000 FUNCTION_LIST smg /end CHARACTERISTIC
/begin CHARACTERISTIC K_SMG_KUPP_M_NORM "" VALUE 0x5984 CONST_0 100.000000 F00355 0.000000 1020.000000 FUNCTION_LIST smg /end CHARACTERISTIC
/begin CHARACTERISTIC K_SMG_KUPP_DM_MIN "" VALUE 0x5985 CONST_0 100.000000 F00181 0.000000 2550.000000 FUNCTION_LIST smg /end CHARACTERISTIC
/begin CHARACTERISTIC K_SMG_KUPP_DM_RAB "" VALUE 0x5986 CONST_0 100.000000 F00181 0.000000 2550.000000 FUNCTION_LIST smg /end CHARACTERISTIC
/begin CHARACTERISTIC K_SMG_KUPP_DM_SOLL_F "" VALUE 0x5987 CONST_0 100.000000 F00356 0.000000 1.000000 FUNCTION_LIST smg /end CHARACTERISTIC
/begin CHARACTERISTIC K_SMG_KUPP_M_MAX_1 "" VALUE 0x5988 CONST_2 100.000000 F00145 0.000000 1000.000000 FUNCTION_LIST smg /end CHARACTERISTIC
/begin CHARACTERISTIC K_SMG_KUPP_M_MAX_2 "" VALUE 0x598A CONST_2 100.000000 F00145 0.000000 1000.000000 FUNCTION_LIST smg /end CHARACTERISTIC
/begin CHARACTERISTIC K_SMG_KUPP_STOP_T_FAK "" VALUE 0x598C CONST_0 100.000000 F00357 0.000000 255.000000 FUNCTION_LIST smg /end CHARACTERISTIC
/begin CHARACTERISTIC K_SMG_KUPP_RAMPE_N "" VALUE 0x598D CONST_0 100.000000 F00007 0.000000 255.000000 FUNCTION_LIST smg /end CHARACTERISTIC
/begin CHARACTERISTIC K_SMG_KUPP_RAMPE_DM "" VALUE 0x598E CONST_0 100.000000 F00181 0.000000 2550.000000 FUNCTION_LIST smg /end CHARACTERISTIC
/begin CHARACTERISTIC K_SMG_KUPP_N_KSCHUTZ "" VALUE 0x5990 CONST_2 100.000000 F00007 0.000000 10000.000000 FUNCTION_LIST smg /end CHARACTERISTIC
/begin CHARACTERISTIC K_SMG_N_ZIEL_OFF_ZH "" VALUE 0x5992 CONST_2 100.000000 F00007 0.000000 10000.000000 FUNCTION_LIST smg /end CHARACTERISTIC
/begin CHARACTERISTIC K_SMG_N_ZIEL_OFF_ZR "" VALUE 0x5994 CONST_2 100.000000 F00007 0.000000 10000.000000 FUNCTION_LIST smg /end CHARACTERISTIC
/begin CHARACTERISTIC K_SMG_N_ZIEL_OFF_SCH "" VALUE 0x5996 CONST_2 100.000000 F00007 0.000000 10000.000000 FUNCTION_LIST smg /end CHARACTERISTIC
/begin CHARACTERISTIC K_SMG_N_ZIEL_HYS "" VALUE 0x5998 CONST_2 100.000000 F00007 0.000000 10000.000000 FUNCTION_LIST smg /end CHARACTERISTIC
/begin CHARACTERISTIC K_SMG_N_ZIEL_OFF_BEGR "" VALUE 0x599A CONST_0 100.000000 F00007 0.000000 255.000000 FUNCTION_LIST smg /end CHARACTERISTIC
/begin CHARACTERISTIC K_SMG_DN_ZIEL_OFF_AH "" VALUE 0x599B CONST_0 100.000000 F00007 0.000000 255.000000 FUNCTION_LIST smg /end CHARACTERISTIC
/begin CHARACTERISTIC K_SMG_N_ZIEL_OFF_AH "" VALUE 0x599C CONST_2 100.000000 F00007 0.000000 10000.000000 FUNCTION_LIST smg /end CHARACTERISTIC
/begin CHARACTERISTIC K_SMG_N_ZIEL_AUF_END "" VALUE 0x599E CONST_0 100.000000 F00109 0.000000 10000.000000 FUNCTION_LIST smg /end CHARACTERISTIC
/begin CHARACTERISTIC K_SMG_N_ZIEL_ABWUERG "" VALUE 0x599F CONST_0 100.000000 F00109 0.000000 10000.000000 FUNCTION_LIST smg /end CHARACTERISTIC
/begin CHARACTERISTIC K_SMG_MOT_M_VOR_AUF "" VALUE 0x59A0 CONST_0 100.000000 F00057 0.000000 2550.000000 FUNCTION_LIST smg /end CHARACTERISTIC
/begin CHARACTERISTIC K_SMG_MOT_NL_T_MAX "" VALUE 0x59A1 CONST_0 100.000000 F00057 0.000000 2550.000000 FUNCTION_LIST smg /end CHARACTERISTIC
/begin CHARACTERISTIC K_SMG_MOT_NL_M_MAX "" VALUE 0x59A2 CONST_2 100.000000 F00145 0.000000 1000.000000 FUNCTION_LIST smg /end CHARACTERISTIC
/begin CHARACTERISTIC K_SMG_MOT_NL_DDK_MAX "" VALUE 0x59A4 CONST_0 100.000000 F00181 0.000000 2550.000000 FUNCTION_LIST smg /end CHARACTERISTIC
/begin CHARACTERISTIC K_SMG_MOT_NL_TZ_AB "" VALUE 0x59A5 CONST_0 100.000000 F00056 0.000000 1.000000 FUNCTION_LIST smg /end CHARACTERISTIC
/begin CHARACTERISTIC K_SMG_MOT_DN_SOLL_MIN "" VALUE 0x59A6 CONST_0 100.000000 F00142 0.000000 255.000000 FUNCTION_LIST smg /end CHARACTERISTIC
/begin CHARACTERISTIC K_SMG_MOT_DN_SOLL_VOR "" VALUE 0x59A8 CONST_2 100.000000 F00007 0.000000 10000.000000 FUNCTION_LIST smg /end CHARACTERISTIC
/begin CHARACTERISTIC K_SMG_MOT_DN_REG_I_P "" VALUE 0x59AA CONST_0 100.000000 F00358 0.000000 0.000000 FUNCTION_LIST smg /end CHARACTERISTIC
/begin CHARACTERISTIC K_SMG_MOT_DN_REG_I_N "" VALUE 0x59AB CONST_0 100.000000 F00358 0.000000 0.000000 FUNCTION_LIST smg /end CHARACTERISTIC
/begin CHARACTERISTIC K_SMG_MOT_N_SA_SCHW "" VALUE 0x59AC CONST_0 100.000000 F00109 0.000000 10000.000000 FUNCTION_LIST smg /end CHARACTERISTIC
/begin CHARACTERISTIC K_SMG_MOT_RAB_M_MIN "" VALUE 0x59AE CONST_3 100.000000 F00145 -100.000000 100.000000 FUNCTION_LIST smg /end CHARACTERISTIC
/begin CHARACTERISTIC K_SMG_MOT_RAB_M_MAX "" VALUE 0x59B0 CONST_2 100.000000 F00145 0.000000 1000.000000 FUNCTION_LIST smg /end CHARACTERISTIC
/begin CHARACTERISTIC K_SMG_MOT_RAB_T_MAX "" VALUE 0x59B2 CONST_2 100.000000 F00025 0.000000 655.000000 FUNCTION_LIST smg /end CHARACTERISTIC
/begin CHARACTERISTIC K_SMG_MOT_N_REG_P_AH "" VALUE 0x59B4 CONST_0 100.000000 F00359 0.000000 2.000000 FUNCTION_LIST smg /end CHARACTERISTIC
/begin CHARACTERISTIC K_SMG_MOT_N_REG_P_KH "" VALUE 0x59B5 CONST_0 100.000000 F00359 0.000000 2.000000 FUNCTION_LIST smg /end CHARACTERISTIC
/begin CHARACTERISTIC K_SMG_MOT_N_REG_I "" VALUE 0x59B6 CONST_0 100.000000 F00360 0.000000 0.000000 FUNCTION_LIST smg /end CHARACTERISTIC
/begin CHARACTERISTIC K_SMG_MOT_N_REG_I_AH "" VALUE 0x59B7 CONST_0 100.000000 F00360 0.000000 0.000000 FUNCTION_LIST smg /end CHARACTERISTIC
/begin CHARACTERISTIC K_SMG_MOT_N_REG_I_KH "" VALUE 0x59B8 CONST_0 100.000000 F00360 0.000000 0.000000 FUNCTION_LIST smg /end CHARACTERISTIC
/begin CHARACTERISTIC K_SMG_MOT_N_REG_I_SCHW "" VALUE 0x59BA CONST_2 100.000000 F00007 0.000000 10000.000000 FUNCTION_LIST smg /end CHARACTERISTIC
/begin CHARACTERISTIC K_SMG_MOT_N_REG_I_T "" VALUE 0x59BC CONST_0 100.000000 F00057 0.000000 2550.000000 FUNCTION_LIST smg /end CHARACTERISTIC
/begin CHARACTERISTIC K_SMG_MOT_N_REG_M_STG "" VALUE 0x59BE CONST_2 100.000000 F00145 0.000000 1000.000000 FUNCTION_LIST smg /end CHARACTERISTIC
/begin CHARACTERISTIC K_SMG_MOT_N_REG_D_MIN "" VALUE 0x59C0 CONST_0 100.000000 F00007 0.000000 255.000000 FUNCTION_LIST smg /end CHARACTERISTIC
/begin CHARACTERISTIC K_SMG_MOT_N_REG_D_MAX "" VALUE 0x59C2 CONST_2 100.000000 F00007 0.000000 10000.000000 FUNCTION_LIST smg /end CHARACTERISTIC
/begin CHARACTERISTIC K_SMG_MOT_N_REG_M_MAX "" VALUE 0x59C4 CONST_2 100.000000 F00145 0.000000 1000.000000 FUNCTION_LIST smg /end CHARACTERISTIC
/begin CHARACTERISTIC K_SMG_MOT_N_REG_T_MAX "" VALUE 0x59C6 CONST_0 100.000000 F00057 10.000000 2550.000000 FUNCTION_LIST smg /end CHARACTERISTIC
/begin CHARACTERISTIC K_SMG_MOT_ANF_N_OFF "" VALUE 0x59C7 CONST_1 100.000000 F00109 -4000.000000 4000.000000 FUNCTION_LIST smg /end CHARACTERISTIC
/begin CHARACTERISTIC K_SMG_MOT_ANF_FW_X "" VALUE 0x59C8 CONST_2 100.000000 F00007 1.000000 10000.000000 FUNCTION_LIST smg /end CHARACTERISTIC
/begin CHARACTERISTIC K_SMG_MOT_ANF_STG_X "" VALUE 0x59CA CONST_2 100.000000 F00145 0.000000 1000.000000 FUNCTION_LIST smg /end CHARACTERISTIC
/begin CHARACTERISTIC K_SMG_MOT_RS_N_SCHW "" VALUE 0x59CC CONST_2 100.000000 F00007 0.000000 10000.000000 FUNCTION_LIST smg /end CHARACTERISTIC
/begin CHARACTERISTIC K_SMG_MOT_RS_S_SCHW "" VALUE 0x59CE CONST_3 100.000000 F00352 -100.000000 100.000000 FUNCTION_LIST smg /end CHARACTERISTIC
/begin CHARACTERISTIC K_SMG_MOT_RS_N_OFF "" VALUE 0x59D0 CONST_2 100.000000 F00007 0.000000 10000.000000 FUNCTION_LIST smg /end CHARACTERISTIC
/begin CHARACTERISTIC K_SMG_MOT_RS_T_LO "" VALUE 0x59D2 CONST_0 100.000000 F00057 10.000000 2550.000000 FUNCTION_LIST smg /end CHARACTERISTIC
/begin CHARACTERISTIC K_SMG_MOT_RS_T_HI "" VALUE 0x59D3 CONST_0 100.000000 F00057 10.000000 2550.000000 FUNCTION_LIST smg /end CHARACTERISTIC
/begin CHARACTERISTIC K_SMG_ETA_RES_ANF "" VALUE 0x59D4 CONST_0 100.000000 F00166 50.000000 101.000000 FUNCTION_LIST smg /end CHARACTERISTIC
/begin CHARACTERISTIC K_SMG_ETA_RES_SCHA "" VALUE 0x59D5 CONST_0 100.000000 F00166 50.000000 101.000000 FUNCTION_LIST smg /end CHARACTERISTIC
/begin CHARACTERISTIC K_SMG_ETA_RES_AUF "" VALUE 0x59D6 CONST_0 100.000000 F00166 50.000000 101.000000 FUNCTION_LIST smg /end CHARACTERISTIC
/begin CHARACTERISTIC K_SMG_ETA_RES_AUF_P "" VALUE 0x59D7 CONST_0 100.000000 F00361 0.000000 2.000000 FUNCTION_LIST smg /end CHARACTERISTIC
/begin CHARACTERISTIC K_SMG_ETA_RES_RS "" VALUE 0x59D8 CONST_0 100.000000 F00166 50.000000 101.000000 FUNCTION_LIST smg /end CHARACTERISTIC
/begin CHARACTERISTIC K_SMG_ETA_RES_MIN "" VALUE 0x59DA CONST_2 100.000000 F00177 50.000000 100.000000 FUNCTION_LIST smg /end CHARACTERISTIC
/begin CHARACTERISTIC K_SMG_BERG_V_MIN_SCHW "" VALUE 0x59DC CONST_0 100.000000 F00004 0.000000 255.000000 FUNCTION_LIST smg /end CHARACTERISTIC
/begin CHARACTERISTIC K_SMG_BERG_V_MAX_SCHW "" VALUE 0x59DD CONST_0 100.000000 F00004 0.000000 255.000000 FUNCTION_LIST smg /end CHARACTERISTIC
/begin CHARACTERISTIC K_SMG_BERG_MD_KW_SCHW "" VALUE 0x59DE CONST_0 100.000000 F00362 0.000000 255.000000 FUNCTION_LIST smg /end CHARACTERISTIC
/begin CHARACTERISTIC K_SMG_ADAPT_SP_TOEL "" VALUE 0x59DF CONST_0 100.000000 F00014 -48.000000 207.000000 FUNCTION_LIST smg /end CHARACTERISTIC
/begin CHARACTERISTIC K_SMG_ADAPT_SP_DMD_FW "" VALUE 0x59E0 CONST_2 100.000000 F00363 0.000000 6554.000000 FUNCTION_LIST smg /end CHARACTERISTIC
/begin CHARACTERISTIC K_SMG_ADAPT_SP_DM_MAX "" VALUE 0x59E2 CONST_2 100.000000 F00145 0.000000 1000.000000 FUNCTION_LIST smg /end CHARACTERISTIC
/begin CHARACTERISTIC K_SMG_SK_RSCHLUPF_MAX "" VALUE 0x59E4 CONST_0 100.000000 F00352 0.000000 24.000000 FUNCTION_LIST smg /end CHARACTERISTIC
/begin CHARACTERISTIC K_SMG_SK_N_GETR_DELTA "" VALUE 0x59E5 CONST_0 100.000000 F00364 0.000000 510.000000 FUNCTION_LIST smg /end CHARACTERISTIC
/begin CHARACTERISTIC K_SMG_SK_N_GETR_T_MAX "" VALUE 0x59E6 CONST_0 100.000000 F00028 0.000000 25.000000 FUNCTION_LIST smg /end CHARACTERISTIC
/begin CHARACTERISTIC K_SMG_SK_N_ZIEL_DELTA "" VALUE 0x59E7 CONST_0 100.000000 F00364 0.000000 510.000000 FUNCTION_LIST smg /end CHARACTERISTIC
/begin CHARACTERISTIC K_SMG_SK_N_ZIEL_T_MAX "" VALUE 0x59E8 CONST_0 100.000000 F00028 0.000000 25.000000 FUNCTION_LIST smg /end CHARACTERISTIC
/begin CHARACTERISTIC K_SMG_SK_N_BER_DELTA "" VALUE 0x59E9 CONST_0 100.000000 F00364 0.000000 510.000000 FUNCTION_LIST smg /end CHARACTERISTIC
/begin CHARACTERISTIC K_SMG_SK_N_BER_T_MAX "" VALUE 0x59EA CONST_0 100.000000 F00028 0.000000 25.000000 FUNCTION_LIST smg /end CHARACTERISTIC
/begin CHARACTERISTIC K_SMG_SK_N_MAX_EKR "" VALUE 0x59EB CONST_0 100.000000 F00109 0.000000 10000.000000 FUNCTION_LIST smg /end CHARACTERISTIC
/begin CHARACTERISTIC K_SMG_SK_N_MAX_T_EKR "" VALUE 0x59EC CONST_0 100.000000 F00028 0.000000 25.000000 FUNCTION_LIST smg /end CHARACTERISTIC
/begin CHARACTERISTIC K_SMG_SK_MD_CHK_MAX "" VALUE 0x59EE CONST_2 100.000000 F00365 0.000000 6554.000000 FUNCTION_LIST smg /end CHARACTERISTIC
/begin CHARACTERISTIC K_SMG_SK_T_PHASE_MAX "" VALUE 0x59F0 CONST_2 100.000000 F00025 0.000000 655.000000 FUNCTION_LIST smg /end CHARACTERISTIC
/begin CHARACTERISTIC K_SMG_SK_M_OFF_ST_1 "" VALUE 0x59F2 CONST_0 100.000000 F00362 0.000000 255.000000 FUNCTION_LIST smg /end CHARACTERISTIC
/begin CHARACTERISTIC K_SMG_SK_M_OFF_ST_2 "" VALUE 0x59F3 CONST_0 100.000000 F00362 0.000000 255.000000 FUNCTION_LIST smg /end CHARACTERISTIC
/begin CHARACTERISTIC K_SMG_SK_M_OFF_ST_3 "" VALUE 0x59F4 CONST_0 100.000000 F00362 0.000000 255.000000 FUNCTION_LIST smg /end CHARACTERISTIC
/begin CHARACTERISTIC K_SMG_DWF_N_MIN_RS "" VALUE 0x59F6 CONST_2 100.000000 F00007 0.000000 10000.000000 FUNCTION_LIST smg /end CHARACTERISTIC
/begin CHARACTERISTIC K_SMG_DWF_AX_VORWARN "" VALUE 0x59F8 CONST_1 100.000000 F00193 -12.000000 12.000000 FUNCTION_LIST smg /end CHARACTERISTIC
/begin CHARACTERISTIC K_SMG_DWF_AX_FLASH "" VALUE 0x59F9 CONST_1 100.000000 F00193 -12.000000 12.000000 FUNCTION_LIST smg /end CHARACTERISTIC
/begin CHARACTERISTIC K_SMG_DWF_T_TOT "" VALUE 0x59FA CONST_0 100.000000 F00057 0.000000 2550.000000 FUNCTION_LIST smg /end CHARACTERISTIC
/begin CHARACTERISTIC K_SMG_DWF_N_VORWARN "" VALUE 0x59FB CONST_0 100.000000 F00007 0.000000 255.000000 FUNCTION_LIST smg /end CHARACTERISTIC
/begin CHARACTERISTIC K_SMG_DWF_T_VORWARN "" VALUE 0x59FC CONST_0 100.000000 F00057 0.000000 2550.000000 FUNCTION_LIST smg /end CHARACTERISTIC
/begin CHARACTERISTIC K_SMG_DWF_T_VOR_HYS "" VALUE 0x59FD CONST_0 100.000000 F00057 0.000000 2550.000000 FUNCTION_LIST smg /end CHARACTERISTIC
/begin CHARACTERISTIC K_SMG_DWF_N_VOR_HYS "" VALUE 0x59FE CONST_0 100.000000 F00007 0.000000 255.000000 FUNCTION_LIST smg /end CHARACTERISTIC
/begin CHARACTERISTIC K_SMG_DWF_T_FLASH "" VALUE 0x59FF CONST_0 100.000000 F00057 0.000000 2550.000000 FUNCTION_LIST smg /end CHARACTERISTIC
/begin CHARACTERISTIC K_SMG_DWF_DT_FLASH "" VALUE 0x5A00 CONST_0 100.000000 F00057 10.000000 1000.000000 FUNCTION_LIST smg /end CHARACTERISTIC
/begin CHARACTERISTIC K_SMG_DWF_CFG_HS "" VALUE 0x5A01 CONST_0 100.000000 F00366 0.000000 255.000000 FUNCTION_LIST smg /end CHARACTERISTIC
/begin CHARACTERISTIC K_SMG_I_HA "" VALUE 0x5A02 CONST_0 100.000000 F00367 0.000000 4.000000 FUNCTION_LIST smg /end CHARACTERISTIC
/begin CHARACTERISTIC K_SMG_I_GANG_1 "" VALUE 0x5A03 CONST_0 100.000000 F00367 0.000000 4.000000 FUNCTION_LIST smg /end CHARACTERISTIC
/begin CHARACTERISTIC K_SMG_I_GANG_2 "" VALUE 0x5A04 CONST_0 100.000000 F00367 0.000000 4.000000 FUNCTION_LIST smg /end CHARACTERISTIC
/begin CHARACTERISTIC K_SMG_I_GANG_3 "" VALUE 0x5A05 CONST_0 100.000000 F00367 0.000000 4.000000 FUNCTION_LIST smg /end CHARACTERISTIC
/begin CHARACTERISTIC K_SMG_I_GANG_4 "" VALUE 0x5A06 CONST_0 100.000000 F00367 0.000000 4.000000 FUNCTION_LIST smg /end CHARACTERISTIC
/begin CHARACTERISTIC K_SMG_I_GANG_5 "" VALUE 0x5A07 CONST_0 100.000000 F00367 0.000000 4.000000 FUNCTION_LIST smg /end CHARACTERISTIC
/begin CHARACTERISTIC K_SMG_I_GANG_6 "" VALUE 0x5A08 CONST_0 100.000000 F00367 0.000000 4.000000 FUNCTION_LIST smg /end CHARACTERISTIC
/begin CHARACTERISTIC K_SMG_I_GANG_R "" VALUE 0x5A09 CONST_0 100.000000 F00367 0.000000 4.000000 FUNCTION_LIST smg /end CHARACTERISTIC
/begin CHARACTERISTIC K_RESET_CONTROL_S "" VALUE 0x4014 CONST_0 100.000000 F00031 0.000000 255.000000 FUNCTION_LIST System_Kontrolle /end CHARACTERISTIC
/begin CHARACTERISTIC K_PCNTRL_MAX_RESET_S "" VALUE 0x4015 CONST_0 100.000000 F00031 0.000000 255.000000 FUNCTION_LIST System_Kontrolle /end CHARACTERISTIC
/begin CHARACTERISTIC K_DEBUG_CONTROL_S "" VALUE 0x4016 CONST_0 100.000000 F00031 0.000000 255.000000 FUNCTION_LIST System_Kontrolle /end CHARACTERISTIC
/begin CHARACTERISTIC K_PCNTRL_TIMEOUT_S "" VALUE 0x4017 CONST_0 100.000000 F00210 0.000000 5100.000000 FUNCTION_LIST System_Kontrolle /end CHARACTERISTIC
/begin CHARACTERISTIC K_PCNTRL_ZEIT_S "" VALUE 0x4018 CONST_0 100.000000 F00057 0.000000 2550.000000 FUNCTION_LIST System_Kontrolle /end CHARACTERISTIC
/begin CHARACTERISTIC K_PCNTRL_CONTROL_S "" VALUE 0x4019 CONST_0 100.000000 F00381 0.000000 255.000000 FUNCTION_LIST System_Kontrolle /end CHARACTERISTIC
/begin CHARACTERISTIC K_PCNTRL_BITMSK_S "" VALUE 0x401A CONST_2 100.000000 F00031 0.000000 65535.000000 FUNCTION_LIST System_Kontrolle /end CHARACTERISTIC
/begin CHARACTERISTIC K_ED_UBMIN_S "" VALUE 0x401C CONST_0 100.000000 F00018 0.000000 25.000000 FUNCTION_LIST System_Kontrolle /end CHARACTERISTIC
/begin CHARACTERISTIC K_CAN_MESS1 "" VALUE 0x401D CONST_0 100.000000 F00382 0.000000 255.000000 FUNCTION_LIST CAN_Schnittstelle /end CHARACTERISTIC
/begin CHARACTERISTIC K_CAN_MESS2 "" VALUE 0x401E CONST_0 100.000000 F00383 0.000000 255.000000 FUNCTION_LIST CAN_Schnittstelle /end CHARACTERISTIC
/begin CHARACTERISTIC K_CAN_MESS3 "" VALUE 0x401F CONST_0 100.000000 F00384 0.000000 255.000000 FUNCTION_LIST CAN_Schnittstelle /end CHARACTERISTIC
/begin CHARACTERISTIC K_CAN_MESS4 "" VALUE 0x4020 CONST_0 100.000000 F00385 0.000000 255.000000 FUNCTION_LIST CAN_Schnittstelle /end CHARACTERISTIC
/begin CHARACTERISTIC K_CAN_MESS5 "" VALUE 0x4021 CONST_0 100.000000 F00386 0.000000 255.000000 FUNCTION_LIST CAN_Schnittstelle /end CHARACTERISTIC
/begin CHARACTERISTIC K_CAN_MESS6 "" VALUE 0x4022 CONST_0 100.000000 F00387 0.000000 255.000000 FUNCTION_LIST CAN_Schnittstelle /end CHARACTERISTIC
/begin CHARACTERISTIC K_CAN_SEGM1 "" VALUE 0x4023 CONST_0 100.000000 F00388 0.000000 255.000000 FUNCTION_LIST CAN_Schnittstelle /end CHARACTERISTIC
/begin CHARACTERISTIC K_CAN_SEGM2 "" VALUE 0x4024 CONST_0 100.000000 F00389 0.000000 255.000000 FUNCTION_LIST CAN_Schnittstelle /end CHARACTERISTIC
/begin CHARACTERISTIC K_DA_S1 "" VALUE 0x4026 CONST_0 100.000000 F00390 0.000000 255.000000 FUNCTION_LIST D/A_Konfiguration /end CHARACTERISTIC
/begin CHARACTERISTIC K_DA_S2 "" VALUE 0x4027 CONST_0 100.000000 F00390 0.000000 255.000000 FUNCTION_LIST D/A_Konfiguration /end CHARACTERISTIC
/begin CHARACTERISTIC K_DA_S3 "" VALUE 0x4028 CONST_0 100.000000 F00390 0.000000 255.000000 FUNCTION_LIST D/A_Konfiguration /end CHARACTERISTIC
/begin CHARACTERISTIC K_DA_S4 "" VALUE 0x4029 CONST_0 100.000000 F00390 0.000000 255.000000 FUNCTION_LIST D/A_Konfiguration /end CHARACTERISTIC
/begin CHARACTERISTIC K_DA_S5 "" VALUE 0x402A CONST_0 100.000000 F00390 0.000000 255.000000 FUNCTION_LIST D/A_Konfiguration /end CHARACTERISTIC
/begin CHARACTERISTIC K_DA_S6 "" VALUE 0x402B CONST_0 100.000000 F00390 0.000000 255.000000 FUNCTION_LIST D/A_Konfiguration /end CHARACTERISTIC
/begin CHARACTERISTIC K_DA_SEITE_S "" VALUE 0x402C CONST_0 100.000000 F00031 0.000000 255.000000 FUNCTION_LIST D/A_Konfiguration /end CHARACTERISTIC
/begin CHARACTERISTIC K_MIL_MODE_S "" VALUE 0x402D CONST_0 100.000000 F00232 0.000000 255.000000 FUNCTION_LIST Eigendiagnose /end CHARACTERISTIC
/begin CHARACTERISTIC K_MIL_MIN_ERR_CNT_S "" VALUE 0x402E CONST_0 100.000000 F00031 0.000000 255.000000 FUNCTION_LIST Eigendiagnose /end CHARACTERISTIC
/begin CHARACTERISTIC K_TE_ADAPT_TAU "" VALUE 0x4BC0 CONST_2 100.000000 F00305 0.000000 327670.000000 FUNCTION_LIST Tankentlueftung /end CHARACTERISTIC
/begin CHARACTERISTIC K_TEA_AB_VIRTUELL "" VALUE 0x4BC2 CONST_0 100.000000 F00391 163.000000 0.000000 FUNCTION_LIST Tankentlueftung /end CHARACTERISTIC
/begin CHARACTERISTIC K_TE_TMOT "" VALUE 0x4BC3 CONST_0 100.000000 F00014 -48.000000 207.000000 FUNCTION_LIST Tankentlueftung /end CHARACTERISTIC
/begin CHARACTERISTIC K_TE_AUF "" VALUE 0x4BC4 CONST_0 100.000000 F00392 163.000000 0.000000 FUNCTION_LIST Tankentlueftung /end CHARACTERISTIC
/begin CHARACTERISTIC K_TE_ZU_LIMIT "" VALUE 0x4BC5 CONST_0 100.000000 F00391 163.000000 0.000000 FUNCTION_LIST Tankentlueftung /end CHARACTERISTIC
/begin CHARACTERISTIC K_TE_ZU_LERN "" VALUE 0x4BC6 CONST_0 100.000000 F00391 163.000000 0.000000 FUNCTION_LIST Tankentlueftung /end CHARACTERISTIC
/begin CHARACTERISTIC K_TE_TVTE_GA "" VALUE 0x4BC7 CONST_0 100.000000 F00056 0.000000 1.000000 FUNCTION_LIST Tankentlueftung /end CHARACTERISTIC
/begin CHARACTERISTIC K_TEA_AB_SA "" VALUE 0x4BC8 CONST_0 100.000000 F00391 163.000000 0.000000 FUNCTION_LIST Tankentlueftung /end CHARACTERISTIC
/begin CHARACTERISTIC K_TEA_AB_LERN "" VALUE 0x4BC9 CONST_0 100.000000 F00391 163.000000 0.000000 FUNCTION_LIST Tankentlueftung /end CHARACTERISTIC
/begin CHARACTERISTIC K_TE_TVTE_TAU "" VALUE 0x4BCA CONST_2 100.000000 F00393 0.000000 327.000000 FUNCTION_LIST Tankentlueftung /end CHARACTERISTIC
/begin CHARACTERISTIC K_TE_LA_MIN "" VALUE 0x4BCC CONST_2 100.000000 F00100 0.000000 2.000000 FUNCTION_LIST Tankentlueftung /end CHARACTERISTIC
/begin CHARACTERISTIC K_TE_T_LERN "" VALUE 0x4BCE CONST_2 100.000000 F00393 0.000000 655.000000 FUNCTION_LIST Tankentlueftung /end CHARACTERISTIC
/begin CHARACTERISTIC K_TE_T_SPUEL_MIN "" VALUE 0x4BD0 CONST_2 100.000000 F00393 0.000000 655.000000 FUNCTION_LIST Tankentlueftung /end CHARACTERISTIC
/begin CHARACTERISTIC K_TE_T_SPUEL "" VALUE 0x4BD2 CONST_2 100.000000 F00393 0.000000 655.000000 FUNCTION_LIST Tankentlueftung /end CHARACTERISTIC
/begin CHARACTERISTIC K_TE_T_SPUEL_VERL "" VALUE 0x4BD4 CONST_2 100.000000 F00393 0.000000 655.000000 FUNCTION_LIST Tankentlueftung /end CHARACTERISTIC
/begin CHARACTERISTIC K_TEA_FMAX "" VALUE 0x4BD6 CONST_2 100.000000 F00100 1.000000 2.000000 FUNCTION_LIST Tankentlueftung /end CHARACTERISTIC
/begin CHARACTERISTIC K_TEA_FMIN1_LL "" VALUE 0x4BD8 CONST_2 100.000000 F00394 0.000000 1.000000 FUNCTION_LIST Tankentlueftung /end CHARACTERISTIC
/begin CHARACTERISTIC K_TEA_TAU "" VALUE 0x4BDA CONST_2 100.000000 F00393 0.000000 327.000000 FUNCTION_LIST Tankentlueftung /end CHARACTERISTIC
/begin CHARACTERISTIC K_TEA_AB_TLSCH "" VALUE 0x4BDC CONST_0 100.000000 F00391 163.000000 0.000000 FUNCTION_LIST Tankentlueftung /end CHARACTERISTIC
/begin CHARACTERISTIC K_TEA_AB_TLLA "" VALUE 0x4BDD CONST_0 100.000000 F00391 163.000000 0.000000 FUNCTION_LIST Tankentlueftung /end CHARACTERISTIC
/begin CHARACTERISTIC K_TE_AUF1 "" VALUE 0x4BDE CONST_0 100.000000 F00391 163.000000 0.000000 FUNCTION_LIST Tankentlueftung /end CHARACTERISTIC
/begin CHARACTERISTIC K_TE_F_VENTIL_MAX "" VALUE 0x4BE0 CONST_2 100.000000 F00097 0.000000 2.000000 FUNCTION_LIST Tankentlueftung /end CHARACTERISTIC
/begin CHARACTERISTIC K_TE_TV_MIN "" VALUE 0x4BE2 CONST_2 100.000000 F00395 0.000000 210.000000 FUNCTION_LIST Tankentlueftung /end CHARACTERISTIC
/begin CHARACTERISTIC K_TEA_FSETZ_MIN "" VALUE 0x4BE4 CONST_2 100.000000 F00097 0.000000 2.000000 FUNCTION_LIST Tankentlueftung /end CHARACTERISTIC
/begin CHARACTERISTIC K_TEA_LA_SCHW "" VALUE 0x4BE6 CONST_2 100.000000 F00100 0.000000 2.000000 FUNCTION_LIST Tankentlueftung /end CHARACTERISTIC
/begin CHARACTERISTIC K_TEA_LA_ZERO "" VALUE 0x4BE8 CONST_3 100.000000 F00100 0.000000 0.000000 FUNCTION_LIST Tankentlueftung /end CHARACTERISTIC
/begin CHARACTERISTIC K_TEA_FMIN_GRENZW "" VALUE 0x4BEA CONST_2 100.000000 F00285 0.000000 2.000000 FUNCTION_LIST Tankentlueftung /end CHARACTERISTIC
/begin CHARACTERISTIC K_TEA_FSPUEL "" VALUE 0x4BEC CONST_2 100.000000 F00100 0.000000 2.000000 FUNCTION_LIST Tankentlueftung /end CHARACTERISTIC
/begin CHARACTERISTIC K_TEA_FSPUEL_VERL "" VALUE 0x4BEE CONST_2 100.000000 F00100 0.000000 2.000000 FUNCTION_LIST Tankentlueftung /end CHARACTERISTIC
/begin CHARACTERISTIC K_TE_CONFIG "" VALUE 0x4BF0 CONST_0 100.000000 F00396 0.000000 255.000000 FUNCTION_LIST Tankentlueftung /end CHARACTERISTIC
/begin CHARACTERISTIC K_TE_VERL_COUNT "" VALUE 0x4BF1 CONST_0 100.000000 F00013 0.000000 255.000000 FUNCTION_LIST Tankentlueftung /end CHARACTERISTIC
/begin CHARACTERISTIC K_LA_TE_VERZ "" VALUE 0x4BF2 CONST_2 100.000000 F00313 0.000000 66.000000 FUNCTION_LIST Tankentlueftung /end CHARACTERISTIC
/begin CHARACTERISTIC K_TE_TETV_OFFEN_T "" VALUE 0x4BF4 CONST_2 100.000000 F00313 0.000000 66.000000 FUNCTION_LIST Tankentlueftung /end CHARACTERISTIC
/begin CHARACTERISTIC K_TEFC_CFG "" VALUE 0x6EDE CONST_0 100.000000 F00398 0.000000 255.000000 FUNCTION_LIST Tankentlueftung /end CHARACTERISTIC
/begin CHARACTERISTIC K_TEFC_DELAY "" VALUE 0x6EE0 CONST_2 100.000000 F00017 1.000000 65535.000000 FUNCTION_LIST Tankentlueftung /end CHARACTERISTIC
/begin CHARACTERISTIC K_TEFC_N_MIN "" VALUE 0x6EE2 CONST_0 100.000000 F00109 0.000000 10000.000000 FUNCTION_LIST Tankentlueftung /end CHARACTERISTIC
/begin CHARACTERISTIC K_TEFC_N_MAX "" VALUE 0x6EE3 CONST_0 100.000000 F00109 0.000000 10000.000000 FUNCTION_LIST Tankentlueftung /end CHARACTERISTIC
/begin CHARACTERISTIC K_TEFC_RF_MIN "" VALUE 0x6EE4 CONST_0 100.000000 F00116 0.000000 1.000000 FUNCTION_LIST Tankentlueftung /end CHARACTERISTIC
/begin CHARACTERISTIC K_TEFC_RF_MAX "" VALUE 0x6EE5 CONST_0 100.000000 F00116 0.000000 1.000000 FUNCTION_LIST Tankentlueftung /end CHARACTERISTIC
/begin CHARACTERISTIC K_TEFC_TEA_DELAY "" VALUE 0x6EE6 CONST_0 100.000000 F00399 0.000000 51.000000 FUNCTION_LIST Tankentlueftung /end CHARACTERISTIC
/begin CHARACTERISTIC K_TEFC_TEA_MAX "" VALUE 0x6EE8 CONST_2 100.000000 F00100 0.000000 2.000000 FUNCTION_LIST Tankentlueftung /end CHARACTERISTIC
/begin CHARACTERISTIC K_TEFC_TEA_OK "" VALUE 0x6EEA CONST_0 100.000000 F00031 0.000000 255.000000 FUNCTION_LIST Tankentlueftung /end CHARACTERISTIC
/begin CHARACTERISTIC K_TEFC_TEA_ANZ "" VALUE 0x6EEB CONST_0 100.000000 F00031 0.000000 255.000000 FUNCTION_LIST Tankentlueftung /end CHARACTERISTIC
/begin CHARACTERISTIC K_TEFC_UB_DELTA "" VALUE 0x6EEC CONST_0 100.000000 F00018 0.000000 20.000000 FUNCTION_LIST Tankentlueftung /end CHARACTERISTIC
/begin CHARACTERISTIC K_TEFC_TOEL_MIN "" VALUE 0x6EED CONST_0 100.000000 F00014 -48.000000 207.000000 FUNCTION_LIST Tankentlueftung /end CHARACTERISTIC
/begin CHARACTERISTIC K_TEFC_LRW_DELTA "" VALUE 0x6EEE CONST_3 100.000000 F00001 0.000000 1433.000000 FUNCTION_LIST Tankentlueftung /end CHARACTERISTIC
/begin CHARACTERISTIC K_TEFC_LL_ML_MAX "" VALUE 0x6EF0 CONST_0 100.000000 F00095 0.000000 63.000000 FUNCTION_LIST Tankentlueftung /end CHARACTERISTIC
/begin CHARACTERISTIC K_TEFC_LL_DELAY "" VALUE 0x6EF1 CONST_0 100.000000 F00399 0.000000 51.000000 FUNCTION_LIST Tankentlueftung /end CHARACTERISTIC
/begin CHARACTERISTIC K_TEFC_LL_KKOS_EIN_MIN "" VALUE 0x6EF2 CONST_2 100.000000 F00399 0.000000 13107.000000 FUNCTION_LIST Tankentlueftung /end CHARACTERISTIC
/begin CHARACTERISTIC K_TEFC_LL_KKOS_AUS_MAX "" VALUE 0x6EF4 CONST_2 100.000000 F00399 0.000000 13107.000000 FUNCTION_LIST Tankentlueftung /end CHARACTERISTIC
/begin CHARACTERISTIC K_TEFC_RAMPE "" VALUE 0x6EF6 CONST_2 100.000000 F00400 0.000000 100.000000 FUNCTION_LIST Tankentlueftung /end CHARACTERISTIC
/begin CHARACTERISTIC K_TEFC_RAMPE_ABBRUCH "" VALUE 0x6EF8 CONST_2 100.000000 F00401 0.000000 100.000000 FUNCTION_LIST Tankentlueftung /end CHARACTERISTIC
/begin CHARACTERISTIC K_TEFC_TETV_MAX "" VALUE 0x6EFA CONST_2 100.000000 F00290 0.000000 100.000000 FUNCTION_LIST Tankentlueftung /end CHARACTERISTIC
/begin CHARACTERISTIC K_TEFC_LL_DAUER "" VALUE 0x6EFC CONST_0 100.000000 F00399 0.000000 51.000000 FUNCTION_LIST Tankentlueftung /end CHARACTERISTIC
/begin CHARACTERISTIC K_TEFC_LL_DELTA "" VALUE 0x6EFD CONST_0 100.000000 F00352 0.000000 24.000000 FUNCTION_LIST Tankentlueftung /end CHARACTERISTIC
/begin CHARACTERISTIC K_TEFC_LL_ZU_DELTA "" VALUE 0x6EFE CONST_0 100.000000 F00352 0.000000 24.000000 FUNCTION_LIST Tankentlueftung /end CHARACTERISTIC
/begin CHARACTERISTIC K_TEFC_LL_OK "" VALUE 0x6EFF CONST_0 100.000000 F00031 0.000000 255.000000 FUNCTION_LIST Tankentlueftung /end CHARACTERISTIC
/begin CHARACTERISTIC K_TEFC_LL_ANZ "" VALUE 0x6F00 CONST_0 100.000000 F00031 0.000000 255.000000 FUNCTION_LIST Tankentlueftung /end CHARACTERISTIC
/begin CHARACTERISTIC K_TI_START "" VALUE 0x4038 CONST_2 100.000000 F00269 0.000000 65.000000 FUNCTION_LIST Einspritzung /end CHARACTERISTIC
/begin CHARACTERISTIC K_TIENDE_START "" VALUE 0x403A CONST_2 100.000000 F00006 0.000000 6553.000000 FUNCTION_LIST Einspritzung /end CHARACTERISTIC
/begin CHARACTERISTIC K_TI_SCH_NAS "" VALUE 0x403C CONST_2 100.000000 F00085 0.000000 4.000000 FUNCTION_LIST Einspritzung /end CHARACTERISTIC
/begin CHARACTERISTIC K_TI_LL_MIN "" VALUE 0x403E CONST_3 100.000000 F00308 -1.000000 0.000000 FUNCTION_LIST Einspritzung /end CHARACTERISTIC
/begin CHARACTERISTIC K_TI_LL_MAX "" VALUE 0x4040 CONST_3 100.000000 F00308 0.000000 1.000000 FUNCTION_LIST Einspritzung /end CHARACTERISTIC
/begin CHARACTERISTIC K_TI_D_WL "" VALUE 0x4042 CONST_2 100.000000 F00402 0.000000 0.000000 FUNCTION_LIST Einspritzung /end CHARACTERISTIC
/begin CHARACTERISTIC K_TI_GA "" VALUE 0x4044 CONST_0 100.000000 F00056 0.000000 1.000000 FUNCTION_LIST Einspritzung /end CHARACTERISTIC
/begin CHARACTERISTIC K_TI_KATS "" VALUE 0x4046 CONST_2 100.000000 F00403 0.000000 2.000000 FUNCTION_LIST Einspritzung /end CHARACTERISTIC
/begin CHARACTERISTIC K_TI_KATS_FAK_SCHNELL "" VALUE 0x4048 CONST_0 100.000000 F00167 1.000000 5.000000 FUNCTION_LIST Einspritzung /end CHARACTERISTIC
/begin CHARACTERISTIC K_TI_F_KATS_MAX "" VALUE 0x404A CONST_2 100.000000 F00085 0.000000 4.000000 FUNCTION_LIST Einspritzung /end CHARACTERISTIC
/begin CHARACTERISTIC K_TI_KATS_TABG_EIN "" VALUE 0x404C CONST_3 100.000000 F00015 -50.000000 1250.000000 FUNCTION_LIST Einspritzung /end CHARACTERISTIC
/begin CHARACTERISTIC K_TI_KATS_TABG_SCHNELL "" VALUE 0x404E CONST_3 100.000000 F00015 -50.000000 1250.000000 FUNCTION_LIST Einspritzung /end CHARACTERISTIC
/begin CHARACTERISTIC K_TI_KATS_TABG_AUS "" VALUE 0x4050 CONST_3 100.000000 F00015 -50.000000 1250.000000 FUNCTION_LIST Einspritzung /end CHARACTERISTIC
/begin CHARACTERISTIC K_TI_TAU_NAS "" VALUE 0x4052 CONST_0 100.000000 F00003 0.000000 3.000000 FUNCTION_LIST Einspritzung /end CHARACTERISTIC
/begin CHARACTERISTIC K_TI_TMIN_WNAS "" VALUE 0x4053 CONST_0 100.000000 F00250 0.000000 255.000000 FUNCTION_LIST Einspritzung /end CHARACTERISTIC
/begin CHARACTERISTIC K_TI_TMAX_WNAS "" VALUE 0x4054 CONST_0 100.000000 F00250 0.000000 255.000000 FUNCTION_LIST Einspritzung /end CHARACTERISTIC
/begin CHARACTERISTIC K_TI_TMOT_HS "" VALUE 0x4055 CONST_0 100.000000 F00014 -48.000000 207.000000 FUNCTION_LIST Einspritzung /end CHARACTERISTIC
/begin CHARACTERISTIC K_TI_TMOT_KS "" VALUE 0x4056 CONST_0 100.000000 F00014 -48.000000 207.000000 FUNCTION_LIST Einspritzung /end CHARACTERISTIC
/begin CHARACTERISTIC K_TI_WKS_B1 "" VALUE 0x4057 CONST_0 100.000000 F00056 0.000000 1.000000 FUNCTION_LIST Einspritzung /end CHARACTERISTIC
/begin CHARACTERISTIC K_TI_WNAS "" VALUE 0x4058 CONST_0 100.000000 F00099 0.000000 1.000000 FUNCTION_LIST Einspritzung /end CHARACTERISTIC
/begin CHARACTERISTIC K_TIENDE_TMOT "" VALUE 0x4059 CONST_0 100.000000 F00014 -48.000000 207.000000 FUNCTION_LIST Einspritzung /end CHARACTERISTIC
/begin CHARACTERISTIC K_TIENDE_TMOT_HYS "" VALUE 0x405A CONST_0 100.000000 F00015 0.000000 255.000000 FUNCTION_LIST Einspritzung /end CHARACTERISTIC
/begin CHARACTERISTIC K_TI_WL_LA_AB "" VALUE 0x405B CONST_0 100.000000 F00404 0.000000 1.000000 FUNCTION_LIST Einspritzung /end CHARACTERISTIC
/begin CHARACTERISTIC K_T_EKP_ON "" VALUE 0x405C CONST_2 100.000000 F00248 0.000000 65535.000000 FUNCTION_LIST Einspritzung /end CHARACTERISTIC
/begin CHARACTERISTIC K_TI_UB_ED "" VALUE 0x405F CONST_0 100.000000 F00405 0.000000 25.000000 FUNCTION_LIST Einspritzung /end CHARACTERISTIC
/begin CHARACTERISTIC K_TIENDE_TEST_OFFSET "" VALUE 0x4060 CONST_3 100.000000 F00406 -720.000000 720.000000 FUNCTION_LIST Einspritzung /end CHARACTERISTIC
/begin CHARACTERISTIC K_TIENDE_TAU "" VALUE 0x4062 CONST_0 100.000000 F00407 0.000000 5100.000000 FUNCTION_LIST Einspritzung /end CHARACTERISTIC
/begin CHARACTERISTIC K_TIENDE_TAU1 "" VALUE 0x4063 CONST_0 100.000000 F00407 0.000000 5100.000000 FUNCTION_LIST Einspritzung /end CHARACTERISTIC
/begin CHARACTERISTIC K_TI_MIN "" VALUE 0x4064 CONST_2 100.000000 F00308 0.000000 2.000000 FUNCTION_LIST Einspritzung /end CHARACTERISTIC
/begin CHARACTERISTIC K_TI_MAX "" VALUE 0x4066 CONST_2 100.000000 F00308 0.000000 2.000000 FUNCTION_LIST Einspritzung /end CHARACTERISTIC
/begin CHARACTERISTIC K_TI_NO "" VALUE 0x4068 CONST_2 100.000000 F00408 0.000000 65535.000000 FUNCTION_LIST Einspritzung /end CHARACTERISTIC
/begin CHARACTERISTIC K_N_LL_SYNC "" VALUE 0x406A CONST_0 100.000000 F00409 0.000000 10200.000000 FUNCTION_LIST Einspritzung /end CHARACTERISTIC
/begin CHARACTERISTIC K_TIENDE_N_TAU "" VALUE 0x406B CONST_0 100.000000 F00409 0.000000 10200.000000 FUNCTION_LIST Einspritzung /end CHARACTERISTIC
/begin CHARACTERISTIC K_TI_WKS_B2 "" VALUE 0x406C CONST_0 100.000000 F00056 0.000000 1.000000 FUNCTION_LIST Einspritzung /end CHARACTERISTIC
/begin CHARACTERISTIC K_TIENDE_TAU2 "" VALUE 0x406D CONST_0 100.000000 F00198 0.000000 25.000000 FUNCTION_LIST Einspritzung /end CHARACTERISTIC
/begin CHARACTERISTIC K_TI_AUSS_CFG "" VALUE 0x406E CONST_0 100.000000 F00410 0.000000 255.000000 FUNCTION_LIST Einspritzung /end CHARACTERISTIC
/begin CHARACTERISTIC K_TI_AUSS_COUNT "" VALUE 0x406F CONST_0 100.000000 F00336 0.000000 255.000000 FUNCTION_LIST Einspritzung /end CHARACTERISTIC
/begin CHARACTERISTIC K_TI_AUSS_BEREICH "" VALUE 0x4070 CONST_0 100.000000 F00336 0.000000 255.000000 FUNCTION_LIST Einspritzung /end CHARACTERISTIC
/begin CHARACTERISTIC K_TI_AUSS_ZYL "" VALUE 0x4071 CONST_0 100.000000 F00031 0.000000 255.000000 FUNCTION_LIST Einspritzung /end CHARACTERISTIC
/begin CHARACTERISTIC K_TI_PT_KORR_NMAX "" VALUE 0x4072 CONST_2 100.000000 F00007 0.000000 10000.000000 FUNCTION_LIST Einspritzung /end CHARACTERISTIC
/begin CHARACTERISTIC K_N_MAX_VFEHLER "" VALUE 0x4074 CONST_2 100.000000 F00007 0.000000 10000.000000 FUNCTION_LIST Einspritzung /end CHARACTERISTIC
/begin CHARACTERISTIC K_TI_SKS "" VALUE 0x4076 CONST_0 100.000000 F00056 0.000000 1.000000 FUNCTION_LIST Einspritzung /end CHARACTERISTIC
/begin CHARACTERISTIC K_N_MAX_KATS "" VALUE 0x4078 CONST_2 100.000000 F00007 0.000000 10000.000000 FUNCTION_LIST Einspritzung /end CHARACTERISTIC
/begin CHARACTERISTIC K_NMAX_TI_OFFSET "" VALUE 0x43EC CONST_2 100.000000 F00007 0.000000 250.000000 FUNCTION_LIST Einspritzung /end CHARACTERISTIC
/begin CHARACTERISTIC K_TKA_DIAG_MIN "" VALUE 0x7518 CONST_0 100.000000 F00014 -48.000000 207.000000 FUNCTION_LIST Messwerte /end CHARACTERISTIC
/begin CHARACTERISTIC K_TKA_DIAG_MAX "" VALUE 0x7519 CONST_0 100.000000 F00014 -48.000000 207.000000 FUNCTION_LIST Messwerte /end CHARACTERISTIC
/begin CHARACTERISTIC K_TKA_TAU "" VALUE 0x751A CONST_0 100.000000 F00019 0.000000 25500.000000 FUNCTION_LIST Messwerte /end CHARACTERISTIC
/begin CHARACTERISTIC K_NW_DETECT_S "" VALUE 0x4030 CONST_0 100.000000 F00031 0.000000 255.000000 FUNCTION_LIST TPU_Synchronisation /end CHARACTERISTIC
/begin CHARACTERISTIC K_NW_MFMIN_S "" VALUE 0x4031 CONST_0 100.000000 F00031 0.000000 255.000000 FUNCTION_LIST TPU_Synchronisation /end CHARACTERISTIC
/begin CHARACTERISTIC K_NW_MFMAX_S "" VALUE 0x4032 CONST_0 100.000000 F00031 0.000000 255.000000 FUNCTION_LIST TPU_Synchronisation /end CHARACTERISTIC
/begin CHARACTERISTIC K_NW_MFERROR_S "" VALUE 0x4033 CONST_0 100.000000 F00031 0.000000 255.000000 FUNCTION_LIST TPU_Synchronisation /end CHARACTERISTIC
/begin CHARACTERISTIC K_NW_MAX_FAIL_S "" VALUE 0x4034 CONST_0 100.000000 F00031 0.000000 255.000000 FUNCTION_LIST TPU_Synchronisation /end CHARACTERISTIC
/begin CHARACTERISTIC K_TZ_ZKUE_CONTROL "" VALUE 0x7556 CONST_0 100.000000 F00013 0.000000 255.000000 BIT_MASK 0xFF FUNCTION_LIST Zuendung /end CHARACTERISTIC
/begin CHARACTERISTIC K_TZ_ZKUE_SPERR "" VALUE 0x7557 CONST_0 100.000000 F00031 0.000000 255.000000 FUNCTION_LIST Zuendung /end CHARACTERISTIC
/begin CHARACTERISTIC K_TZ_ZKUE_RF_MIN "" VALUE 0x7558 CONST_2 100.000000 F00068 0.000000 2.000000 FUNCTION_LIST Zuendung /end CHARACTERISTIC
/begin CHARACTERISTIC K_UB_DIAG_MIN "" VALUE 0x7510 CONST_0 100.000000 F00018 5.000000 10.000000 FUNCTION_LIST Messwerte /end CHARACTERISTIC
/begin CHARACTERISTIC K_UB_ML_MIN "" VALUE 0x7511 CONST_0 100.000000 F00018 5.000000 20.000000 FUNCTION_LIST Messwerte /end CHARACTERISTIC
/begin CHARACTERISTIC K_UB_DIAG_MAX "" VALUE 0x7512 CONST_0 100.000000 F00018 10.000000 20.000000 FUNCTION_LIST Messwerte /end CHARACTERISTIC
/begin CHARACTERISTIC K_UB_ERSATZ "" VALUE 0x7513 CONST_0 100.000000 F00018 0.000000 20.000000 FUNCTION_LIST Messwerte /end CHARACTERISTIC
/begin CHARACTERISTIC K_UB_TAU "" VALUE 0x7514 CONST_0 100.000000 F00210 0.000000 5100.000000 FUNCTION_LIST Messwerte /end CHARACTERISTIC
/begin CHARACTERISTIC K_UB_START_TIME "" VALUE 0x7515 CONST_0 100.000000 F00017 0.000000 255.000000 FUNCTION_LIST Messwerte /end CHARACTERISTIC
/begin CHARACTERISTIC K_UB_HR_TIME "" VALUE 0x7516 CONST_2 100.000000 F00418 0.000000 63999.000000 FUNCTION_LIST Messwerte /end CHARACTERISTIC
/begin CHARACTERISTIC K_VERS_UP_S "" VALUE 0x4000 CONST_0 100.000000 F00273 0.000000 255.000000 FUNCTION_LIST Versionskontrolle /end CHARACTERISTIC
/begin CHARACTERISTIC K_VERS_NAME_S "" VALUE 0x4001 CONST_0 100.000000 F00419 0.000000 255.000000 FUNCTION_LIST Versionskontrolle /end CHARACTERISTIC
/begin CHARACTERISTIC K_VERS_PROGR_S "" VALUE 0x4002 CONST_2 100.000000 F00031 0.000000 65535.000000 FUNCTION_LIST Versionskontrolle /end CHARACTERISTIC
/begin CHARACTERISTIC K_VERS_DATEN_S "" VALUE 0x4004 CONST_2 100.000000 F00031 0.000000 65535.000000 FUNCTION_LIST Versionskontrolle /end CHARACTERISTIC
/begin CHARACTERISTIC K_ED_CONTROL "" VALUE 0x78A0 CONST_2 100.000000 F00031 0.000000 1.000000 FUNCTION_LIST Eigendiagnose /end CHARACTERISTIC
/begin CHARACTERISTIC K_FSP_CONCEPT "" VALUE 0x78A2 CONST_0 100.000000 F00277 0.000000 1.000000 FUNCTION_LIST Eigendiagnose /end CHARACTERISTIC
/begin CHARACTERISTIC K_FSP_TIMER "" VALUE 0x78A3 CONST_0 100.000000 F00278 0.000000 1.000000 FUNCTION_LIST Eigendiagnose /end CHARACTERISTIC
/begin CHARACTERISTIC K_DS2_VMAX "" VALUE 0x78A4 CONST_0 100.000000 F00004 0.000000 255.000000 FUNCTION_LIST Eigendiagnose /end CHARACTERISTIC
/begin CHARACTERISTIC K_ED_FIL_CTL[129] "" VALUE 0x78C0 CONST_0 100.000000 F00058 0.000000 255.000000 FUNCTION_LIST Fehlerfilter Kontrolle /end CHARACTERISTIC
/begin CHARACTERISTIC K_ED_FIL_CTL[130] "" VALUE 0x78CE CONST_0 100.000000 F00058 0.000000 255.000000 FUNCTION_LIST Fehlerfilter Kontrolle /end CHARACTERISTIC
/begin CHARACTERISTIC K_ED_FIL_CTL[131] "" VALUE 0x78DC CONST_0 100.000000 F00058 0.000000 255.000000 FUNCTION_LIST Fehlerfilter Kontrolle /end CHARACTERISTIC
/begin CHARACTERISTIC K_ED_FIL_CTL[132] "" VALUE 0x78EA CONST_0 100.000000 F00058 0.000000 255.000000 FUNCTION_LIST Fehlerfilter Kontrolle /end CHARACTERISTIC
/begin CHARACTERISTIC K_ED_FIL_CTL[133] "" VALUE 0x78F8 CONST_0 100.000000 F00058 0.000000 255.000000 FUNCTION_LIST Fehlerfilter Kontrolle /end CHARACTERISTIC
/begin CHARACTERISTIC K_ED_FIL_CTL[134] "" VALUE 0x7906 CONST_0 100.000000 F00058 0.000000 255.000000 FUNCTION_LIST Fehlerfilter Kontrolle /end CHARACTERISTIC
/begin CHARACTERISTIC K_ED_FIL_CTL[135] "" VALUE 0x7914 CONST_0 100.000000 F00058 0.000000 255.000000 FUNCTION_LIST Fehlerfilter Kontrolle /end CHARACTERISTIC
/begin CHARACTERISTIC K_ED_FIL_CTL[136] "" VALUE 0x7922 CONST_0 100.000000 F00058 0.000000 255.000000 FUNCTION_LIST Fehlerfilter Kontrolle /end CHARACTERISTIC
/begin CHARACTERISTIC K_ED_FIL_CTL[137] "" VALUE 0x7930 CONST_0 100.000000 F00058 0.000000 255.000000 FUNCTION_LIST Fehlerfilter Kontrolle /end CHARACTERISTIC
/begin CHARACTERISTIC K_ED_FIL_CTL[138] "" VALUE 0x793E CONST_0 100.000000 F00058 0.000000 255.000000 FUNCTION_LIST Fehlerfilter Kontrolle /end CHARACTERISTIC
/begin CHARACTERISTIC K_ED_FIL_CTL[139] "" VALUE 0x794C CONST_0 100.000000 F00058 0.000000 255.000000 FUNCTION_LIST Fehlerfilter Kontrolle /end CHARACTERISTIC
/begin CHARACTERISTIC K_ED_FIL_CTL[140] "" VALUE 0x795A CONST_0 100.000000 F00058 0.000000 255.000000 FUNCTION_LIST Fehlerfilter Kontrolle /end CHARACTERISTIC
/begin CHARACTERISTIC K_ED_FIL_CTL[141] "" VALUE 0x7968 CONST_0 100.000000 F00058 0.000000 255.000000 FUNCTION_LIST Fehlerfilter Kontrolle /end CHARACTERISTIC
/begin CHARACTERISTIC K_ED_FIL_CTL[142] "" VALUE 0x7976 CONST_0 100.000000 F00058 0.000000 255.000000 FUNCTION_LIST Fehlerfilter Kontrolle /end CHARACTERISTIC
/begin CHARACTERISTIC K_ED_FIL_CTL[143] "" VALUE 0x7984 CONST_0 100.000000 F00058 0.000000 255.000000 FUNCTION_LIST Fehlerfilter Kontrolle /end CHARACTERISTIC
/begin CHARACTERISTIC K_ED_FIL_CTL[144] "" VALUE 0x7992 CONST_0 100.000000 F00058 0.000000 255.000000 FUNCTION_LIST Fehlerfilter Kontrolle /end CHARACTERISTIC
/begin CHARACTERISTIC K_ED_FIL_CTL[145] "" VALUE 0x79A0 CONST_0 100.000000 F00058 0.000000 255.000000 FUNCTION_LIST Fehlerfilter Kontrolle /end CHARACTERISTIC
/begin CHARACTERISTIC K_ED_FIL_CTL[146] "" VALUE 0x79AE CONST_0 100.000000 F00058 0.000000 255.000000 FUNCTION_LIST Fehlerfilter Kontrolle /end CHARACTERISTIC
/begin CHARACTERISTIC K_ED_FIL_CTL[147] "" VALUE 0x79BC CONST_0 100.000000 F00058 0.000000 255.000000 FUNCTION_LIST Fehlerfilter Kontrolle /end CHARACTERISTIC
/begin CHARACTERISTIC K_ED_FIL_CTL[148] "" VALUE 0x79CA CONST_0 100.000000 F00058 0.000000 255.000000 FUNCTION_LIST Fehlerfilter Kontrolle /end CHARACTERISTIC
/begin CHARACTERISTIC K_ED_FIL_CTL[149] "" VALUE 0x79D8 CONST_0 100.000000 F00058 0.000000 255.000000 FUNCTION_LIST Fehlerfilter Kontrolle /end CHARACTERISTIC
/begin CHARACTERISTIC K_ED_FIL_CTL[150] "" VALUE 0x79E6 CONST_0 100.000000 F00058 0.000000 255.000000 FUNCTION_LIST Fehlerfilter Kontrolle /end CHARACTERISTIC
/begin CHARACTERISTIC K_ED_FIL_CTL[151] "" VALUE 0x79F4 CONST_0 100.000000 F00058 0.000000 255.000000 FUNCTION_LIST Fehlerfilter Kontrolle /end CHARACTERISTIC
/begin CHARACTERISTIC K_ED_FIL_CTL[152] "" VALUE 0x7A02 CONST_0 100.000000 F00058 0.000000 255.000000 FUNCTION_LIST Fehlerfilter Kontrolle /end CHARACTERISTIC
/begin CHARACTERISTIC K_ED_FIL_CTL[153] "" VALUE 0x7A10 CONST_0 100.000000 F00058 0.000000 255.000000 FUNCTION_LIST Fehlerfilter Kontrolle /end CHARACTERISTIC
/begin CHARACTERISTIC K_ED_FIL_CTL[154] "" VALUE 0x7A1E CONST_0 100.000000 F00058 0.000000 255.000000 FUNCTION_LIST Fehlerfilter Kontrolle /end CHARACTERISTIC
/begin CHARACTERISTIC K_ED_FIL_CTL[155] "" VALUE 0x7A2C CONST_0 100.000000 F00058 0.000000 255.000000 FUNCTION_LIST Fehlerfilter Kontrolle /end CHARACTERISTIC
/begin CHARACTERISTIC K_ED_FIL_CTL[156] "" VALUE 0x7A3A CONST_0 100.000000 F00058 0.000000 255.000000 FUNCTION_LIST Fehlerfilter Kontrolle /end CHARACTERISTIC
/begin CHARACTERISTIC K_ED_FIL_CTL[157] "" VALUE 0x7A48 CONST_0 100.000000 F00058 0.000000 255.000000 FUNCTION_LIST Fehlerfilter Kontrolle /end CHARACTERISTIC
/begin CHARACTERISTIC K_ED_FIL_CTL[158] "" VALUE 0x7A56 CONST_0 100.000000 F00058 0.000000 255.000000 FUNCTION_LIST Fehlerfilter Kontrolle /end CHARACTERISTIC
/begin CHARACTERISTIC K_ED_FIL_CTL[159] "" VALUE 0x7A64 CONST_0 100.000000 F00058 0.000000 255.000000 FUNCTION_LIST Fehlerfilter Kontrolle /end CHARACTERISTIC
/begin CHARACTERISTIC K_ED_FIL_CTL[160] "" VALUE 0x7A72 CONST_0 100.000000 F00058 0.000000 255.000000 FUNCTION_LIST Fehlerfilter Kontrolle /end CHARACTERISTIC
/begin CHARACTERISTIC K_ED_FIL_CTL[161] "" VALUE 0x7A80 CONST_0 100.000000 F00058 0.000000 255.000000 FUNCTION_LIST Fehlerfilter Kontrolle /end CHARACTERISTIC
/begin CHARACTERISTIC K_ED_FIL_CTL[162] "" VALUE 0x7A8E CONST_0 100.000000 F00058 0.000000 255.000000 FUNCTION_LIST Fehlerfilter Kontrolle /end CHARACTERISTIC
/begin CHARACTERISTIC K_ED_FIL_CTL[163] "" VALUE 0x7A9C CONST_0 100.000000 F00058 0.000000 255.000000 FUNCTION_LIST Fehlerfilter Kontrolle /end CHARACTERISTIC
/begin CHARACTERISTIC K_ED_FIL_CTL[164] "" VALUE 0x7AAA CONST_0 100.000000 F00058 0.000000 255.000000 FUNCTION_LIST Fehlerfilter Kontrolle /end CHARACTERISTIC
/begin CHARACTERISTIC K_ED_FIL_CTL[165] "" VALUE 0x7AB8 CONST_0 100.000000 F00058 0.000000 255.000000 FUNCTION_LIST Fehlerfilter Kontrolle /end CHARACTERISTIC
/begin CHARACTERISTIC K_ED_FIL_CTL[166] "" VALUE 0x7AC6 CONST_0 100.000000 F00058 0.000000 255.000000 FUNCTION_LIST Fehlerfilter Kontrolle /end CHARACTERISTIC
/begin CHARACTERISTIC K_ED_FIL_CTL[167] "" VALUE 0x7AD4 CONST_0 100.000000 F00058 0.000000 255.000000 FUNCTION_LIST Fehlerfilter Kontrolle /end CHARACTERISTIC
/begin CHARACTERISTIC K_ED_FIL_CTL[168] "" VALUE 0x7AE2 CONST_0 100.000000 F00058 0.000000 255.000000 FUNCTION_LIST Fehlerfilter Kontrolle /end CHARACTERISTIC
/begin CHARACTERISTIC K_ED_FIL_CTL[169] "" VALUE 0x7AF0 CONST_0 100.000000 F00058 0.000000 255.000000 FUNCTION_LIST Fehlerfilter Kontrolle /end CHARACTERISTIC
/begin CHARACTERISTIC K_ED_FIL_CTL[170] "" VALUE 0x7AFE CONST_0 100.000000 F00058 0.000000 255.000000 FUNCTION_LIST Fehlerfilter Kontrolle /end CHARACTERISTIC
/begin CHARACTERISTIC K_ED_FIL_CTL[171] "" VALUE 0x7B0C CONST_0 100.000000 F00058 0.000000 255.000000 FUNCTION_LIST Fehlerfilter Kontrolle /end CHARACTERISTIC
/begin CHARACTERISTIC K_ED_FIL_CTL[172] "" VALUE 0x7B1A CONST_0 100.000000 F00058 0.000000 255.000000 FUNCTION_LIST Fehlerfilter Kontrolle /end CHARACTERISTIC
/begin CHARACTERISTIC K_ED_FIL_CTL[173] "" VALUE 0x7B28 CONST_0 100.000000 F00058 0.000000 255.000000 FUNCTION_LIST Fehlerfilter Kontrolle /end CHARACTERISTIC
/begin CHARACTERISTIC K_ED_FIL_CTL[174] "" VALUE 0x7B36 CONST_0 100.000000 F00058 0.000000 255.000000 FUNCTION_LIST Fehlerfilter Kontrolle /end CHARACTERISTIC
/begin CHARACTERISTIC K_ED_FIL_CTL[175] "" VALUE 0x7B44 CONST_0 100.000000 F00058 0.000000 255.000000 FUNCTION_LIST Fehlerfilter Kontrolle /end CHARACTERISTIC
/begin CHARACTERISTIC K_ED_FIL_CTL[176] "" VALUE 0x7B52 CONST_0 100.000000 F00058 0.000000 255.000000 FUNCTION_LIST Fehlerfilter Kontrolle /end CHARACTERISTIC
/begin CHARACTERISTIC K_ED_FIL_CTL[177] "" VALUE 0x7B60 CONST_0 100.000000 F00058 0.000000 255.000000 FUNCTION_LIST Fehlerfilter Kontrolle /end CHARACTERISTIC
/begin CHARACTERISTIC K_ED_FIL_CTL[178] "" VALUE 0x7B6E CONST_0 100.000000 F00058 0.000000 255.000000 FUNCTION_LIST Fehlerfilter Kontrolle /end CHARACTERISTIC
/begin CHARACTERISTIC K_ED_FIL_CTL[179] "" VALUE 0x7B7C CONST_0 100.000000 F00058 0.000000 255.000000 FUNCTION_LIST Fehlerfilter Kontrolle /end CHARACTERISTIC
/begin CHARACTERISTIC K_ED_FIL_CTL[180] "" VALUE 0x7B8A CONST_0 100.000000 F00058 0.000000 255.000000 FUNCTION_LIST Fehlerfilter Kontrolle /end CHARACTERISTIC
/begin CHARACTERISTIC K_ED_FIL_CTL[181] "" VALUE 0x7B98 CONST_0 100.000000 F00058 0.000000 255.000000 FUNCTION_LIST Fehlerfilter Kontrolle /end CHARACTERISTIC
/begin CHARACTERISTIC K_ED_FIL_CTL[182] "" VALUE 0x7BA6 CONST_0 100.000000 F00058 0.000000 255.000000 FUNCTION_LIST Fehlerfilter Kontrolle /end CHARACTERISTIC
/begin CHARACTERISTIC K_ED_FIL_CTL[183] "" VALUE 0x7BB4 CONST_0 100.000000 F00058 0.000000 255.000000 FUNCTION_LIST Fehlerfilter Kontrolle /end CHARACTERISTIC
/begin CHARACTERISTIC K_ED_FIL_CTL[184] "" VALUE 0x7BC2 CONST_0 100.000000 F00058 0.000000 255.000000 FUNCTION_LIST Fehlerfilter Kontrolle /end CHARACTERISTIC
/begin CHARACTERISTIC K_ED_FIL_CTL[185] "" VALUE 0x7BD0 CONST_0 100.000000 F00058 0.000000 255.000000 FUNCTION_LIST Fehlerfilter Kontrolle /end CHARACTERISTIC
/begin CHARACTERISTIC K_ED_FIL_CTL[186] "" VALUE 0x7BDE CONST_0 100.000000 F00058 0.000000 255.000000 FUNCTION_LIST Fehlerfilter Kontrolle /end CHARACTERISTIC
/begin CHARACTERISTIC K_ED_FIL_CTL[187] "" VALUE 0x7BEC CONST_0 100.000000 F00058 0.000000 255.000000 FUNCTION_LIST Fehlerfilter Kontrolle /end CHARACTERISTIC
/begin CHARACTERISTIC K_ED_FIL_CTL[188] "" VALUE 0x7BFA CONST_0 100.000000 F00058 0.000000 255.000000 FUNCTION_LIST Fehlerfilter Kontrolle /end CHARACTERISTIC
/begin CHARACTERISTIC K_ED_FIL_CTL[189] "" VALUE 0x7C08 CONST_0 100.000000 F00058 0.000000 255.000000 FUNCTION_LIST Fehlerfilter Kontrolle /end CHARACTERISTIC
/begin CHARACTERISTIC K_ED_FIL_CTL[190] "" VALUE 0x7C16 CONST_0 100.000000 F00058 0.000000 255.000000 FUNCTION_LIST Fehlerfilter Kontrolle /end CHARACTERISTIC
/begin CHARACTERISTIC K_ED_FIL_CTL[191] "" VALUE 0x7C24 CONST_0 100.000000 F00058 0.000000 255.000000 FUNCTION_LIST Fehlerfilter Kontrolle /end CHARACTERISTIC
/begin CHARACTERISTIC K_ED_FIL_CTL[192] "" VALUE 0x7C32 CONST_0 100.000000 F00058 0.000000 255.000000 FUNCTION_LIST Fehlerfilter Kontrolle /end CHARACTERISTIC
/begin CHARACTERISTIC K_ED_FIL_CTL[193] "" VALUE 0x7C40 CONST_0 100.000000 F00058 0.000000 255.000000 FUNCTION_LIST Fehlerfilter Kontrolle /end CHARACTERISTIC
/begin CHARACTERISTIC K_ED_FIL_CTL[194] "" VALUE 0x7C4E CONST_0 100.000000 F00058 0.000000 255.000000 FUNCTION_LIST Fehlerfilter Kontrolle /end CHARACTERISTIC
/begin CHARACTERISTIC K_ED_FIL_CTL[195] "" VALUE 0x7C5C CONST_0 100.000000 F00058 0.000000 255.000000 FUNCTION_LIST Fehlerfilter Kontrolle /end CHARACTERISTIC
/begin CHARACTERISTIC K_ED_FIL_CTL[196] "" VALUE 0x7C6A CONST_0 100.000000 F00058 0.000000 255.000000 FUNCTION_LIST Fehlerfilter Kontrolle /end CHARACTERISTIC
/begin CHARACTERISTIC K_ED_FIL_CTL[197] "" VALUE 0x7C78 CONST_0 100.000000 F00058 0.000000 255.000000 FUNCTION_LIST Fehlerfilter Kontrolle /end CHARACTERISTIC
/begin CHARACTERISTIC K_ED_FIL_CTL[198] "" VALUE 0x7C86 CONST_0 100.000000 F00058 0.000000 255.000000 FUNCTION_LIST Fehlerfilter Kontrolle /end CHARACTERISTIC
/begin CHARACTERISTIC K_ED_FIL_CTL[199] "" VALUE 0x7C94 CONST_0 100.000000 F00058 0.000000 255.000000 FUNCTION_LIST Fehlerfilter Kontrolle /end CHARACTERISTIC
/begin CHARACTERISTIC K_ED_FIL_CTL[200] "" VALUE 0x7CA2 CONST_0 100.000000 F00058 0.000000 255.000000 FUNCTION_LIST Fehlerfilter Kontrolle /end CHARACTERISTIC
/begin CHARACTERISTIC K_ED_FIL_CTL[201] "" VALUE 0x7CB0 CONST_0 100.000000 F00058 0.000000 255.000000 FUNCTION_LIST Fehlerfilter Kontrolle /end CHARACTERISTIC
/begin CHARACTERISTIC K_ED_FIL_CTL[202] "" VALUE 0x7CBE CONST_0 100.000000 F00058 0.000000 255.000000 FUNCTION_LIST Fehlerfilter Kontrolle /end CHARACTERISTIC
/begin CHARACTERISTIC K_ED_FIL_CTL[203] "" VALUE 0x7CCC CONST_0 100.000000 F00058 0.000000 255.000000 FUNCTION_LIST Fehlerfilter Kontrolle /end CHARACTERISTIC
/begin CHARACTERISTIC K_ED_FIL_CTL[204] "" VALUE 0x7CDA CONST_0 100.000000 F00058 0.000000 255.000000 FUNCTION_LIST Fehlerfilter Kontrolle /end CHARACTERISTIC
/begin CHARACTERISTIC K_ED_FIL_CTL[205] "" VALUE 0x7CE8 CONST_0 100.000000 F00058 0.000000 255.000000 FUNCTION_LIST Fehlerfilter Kontrolle /end CHARACTERISTIC
/begin CHARACTERISTIC K_ED_FIL_CTL[206] "" VALUE 0x7CF6 CONST_0 100.000000 F00058 0.000000 255.000000 FUNCTION_LIST Fehlerfilter Kontrolle /end CHARACTERISTIC
/begin CHARACTERISTIC K_ED_FIL_CTL[207] "" VALUE 0x7D04 CONST_0 100.000000 F00058 0.000000 255.000000 FUNCTION_LIST Fehlerfilter Kontrolle /end CHARACTERISTIC
/begin CHARACTERISTIC K_ED_FIL_CTL[208] "" VALUE 0x7D12 CONST_0 100.000000 F00058 0.000000 255.000000 FUNCTION_LIST Fehlerfilter Kontrolle /end CHARACTERISTIC
/begin CHARACTERISTIC K_ED_FIL_CTL[209] "" VALUE 0x7D20 CONST_0 100.000000 F00058 0.000000 255.000000 FUNCTION_LIST Fehlerfilter Kontrolle /end CHARACTERISTIC
/begin CHARACTERISTIC K_ED_FIL_CTL[210] "" VALUE 0x7D2E CONST_0 100.000000 F00058 0.000000 255.000000 FUNCTION_LIST Fehlerfilter Kontrolle /end CHARACTERISTIC
/begin CHARACTERISTIC K_ED_FIL_CTL[211] "" VALUE 0x7D3C CONST_0 100.000000 F00058 0.000000 255.000000 FUNCTION_LIST Fehlerfilter Kontrolle /end CHARACTERISTIC
/begin CHARACTERISTIC K_ED_FIL_CTL[212] "" VALUE 0x7D4A CONST_0 100.000000 F00058 0.000000 255.000000 FUNCTION_LIST Fehlerfilter Kontrolle /end CHARACTERISTIC
/begin CHARACTERISTIC K_ED_FIL_CTL[213] "" VALUE 0x7D58 CONST_0 100.000000 F00058 0.000000 255.000000 FUNCTION_LIST Fehlerfilter Kontrolle /end CHARACTERISTIC
/begin CHARACTERISTIC K_ED_FIL_CTL[214] "" VALUE 0x7D66 CONST_0 100.000000 F00058 0.000000 255.000000 FUNCTION_LIST Fehlerfilter Kontrolle /end CHARACTERISTIC
/begin CHARACTERISTIC K_ED_FIL_CTL[215] "" VALUE 0x7D74 CONST_0 100.000000 F00058 0.000000 255.000000 FUNCTION_LIST Fehlerfilter Kontrolle /end CHARACTERISTIC
/begin CHARACTERISTIC K_ED_FIL_CTL[216] "" VALUE 0x7D82 CONST_0 100.000000 F00058 0.000000 255.000000 FUNCTION_LIST Fehlerfilter Kontrolle /end CHARACTERISTIC
/begin CHARACTERISTIC K_ED_FIL_CTL[217] "" VALUE 0x7D90 CONST_0 100.000000 F00058 0.000000 255.000000 FUNCTION_LIST Fehlerfilter Kontrolle /end CHARACTERISTIC
/begin CHARACTERISTIC K_ED_FIL_CTL[218] "" VALUE 0x7D9E CONST_0 100.000000 F00058 0.000000 255.000000 FUNCTION_LIST Fehlerfilter Kontrolle /end CHARACTERISTIC
/begin CHARACTERISTIC K_ED_FIL_CTL[219] "" VALUE 0x7DAC CONST_0 100.000000 F00058 0.000000 255.000000 FUNCTION_LIST Fehlerfilter Kontrolle /end CHARACTERISTIC
/begin CHARACTERISTIC K_ED_FIL_CTL[220] "" VALUE 0x7DBA CONST_0 100.000000 F00058 0.000000 255.000000 FUNCTION_LIST Fehlerfilter Kontrolle /end CHARACTERISTIC
/begin CHARACTERISTIC K_ED_FIL_CTL[221] "" VALUE 0x7DC8 CONST_0 100.000000 F00058 0.000000 255.000000 FUNCTION_LIST Fehlerfilter Kontrolle /end CHARACTERISTIC
/begin CHARACTERISTIC K_ED_FIL_CTL[222] "" VALUE 0x7DD6 CONST_0 100.000000 F00058 0.000000 255.000000 FUNCTION_LIST Fehlerfilter Kontrolle /end CHARACTERISTIC
/begin CHARACTERISTIC K_ED_FIL_CTL[223] "" VALUE 0x7DE4 CONST_0 100.000000 F00058 0.000000 255.000000 FUNCTION_LIST Fehlerfilter Kontrolle /end CHARACTERISTIC
/begin CHARACTERISTIC K_ED_FIL_CTL[224] "" VALUE 0x7DF2 CONST_0 100.000000 F00058 0.000000 255.000000 FUNCTION_LIST Fehlerfilter Kontrolle /end CHARACTERISTIC
/begin CHARACTERISTIC K_ED_FIL_CTL[225] "" VALUE 0x7E00 CONST_0 100.000000 F00058 0.000000 255.000000 FUNCTION_LIST Fehlerfilter Kontrolle /end CHARACTERISTIC
/begin CHARACTERISTIC K_ED_FIL_CTL[226] "" VALUE 0x7E0E CONST_0 100.000000 F00058 0.000000 255.000000 FUNCTION_LIST Fehlerfilter Kontrolle /end CHARACTERISTIC
/begin CHARACTERISTIC K_ED_FIL_CTL[227] "" VALUE 0x7E1C CONST_0 100.000000 F00058 0.000000 255.000000 FUNCTION_LIST Fehlerfilter Kontrolle /end CHARACTERISTIC
/begin CHARACTERISTIC K_ED_FIL_CTL[228] "" VALUE 0x7E2A CONST_0 100.000000 F00058 0.000000 255.000000 FUNCTION_LIST Fehlerfilter Kontrolle /end CHARACTERISTIC
/begin CHARACTERISTIC K_ED_FIL_CTL[229] "" VALUE 0x7E38 CONST_0 100.000000 F00058 0.000000 255.000000 FUNCTION_LIST Fehlerfilter Kontrolle /end CHARACTERISTIC
/begin CHARACTERISTIC K_ED_FIL_CTL[230] "" VALUE 0x7E46 CONST_0 100.000000 F00058 0.000000 255.000000 FUNCTION_LIST Fehlerfilter Kontrolle /end CHARACTERISTIC
/begin CHARACTERISTIC K_ED_FIL_CTL[231] "" VALUE 0x7E54 CONST_0 100.000000 F00058 0.000000 255.000000 FUNCTION_LIST Fehlerfilter Kontrolle /end CHARACTERISTIC
/begin CHARACTERISTIC K_ED_FIL_CTL[232] "" VALUE 0x7E62 CONST_0 100.000000 F00058 0.000000 255.000000 FUNCTION_LIST Fehlerfilter Kontrolle /end CHARACTERISTIC
/begin CHARACTERISTIC K_ED_FIL_CTL[233] "" VALUE 0x7E70 CONST_0 100.000000 F00058 0.000000 255.000000 FUNCTION_LIST Fehlerfilter Kontrolle /end CHARACTERISTIC
/begin CHARACTERISTIC K_ED_FIL_CTL[234] "" VALUE 0x7E7E CONST_0 100.000000 F00058 0.000000 255.000000 FUNCTION_LIST Fehlerfilter Kontrolle /end CHARACTERISTIC
/begin CHARACTERISTIC K_ED_FIL_CTL[235] "" VALUE 0x7E8C CONST_0 100.000000 F00058 0.000000 255.000000 FUNCTION_LIST Fehlerfilter Kontrolle /end CHARACTERISTIC
/begin CHARACTERISTIC K_ED_FIL_CTL[236] "" VALUE 0x7E9A CONST_0 100.000000 F00058 0.000000 255.000000 FUNCTION_LIST Fehlerfilter Kontrolle /end CHARACTERISTIC
/begin CHARACTERISTIC K_ED_FIL_CTL[237] "" VALUE 0x7EA8 CONST_0 100.000000 F00058 0.000000 255.000000 FUNCTION_LIST Fehlerfilter Kontrolle /end CHARACTERISTIC
/begin CHARACTERISTIC K_ED_FIL_CTL[238] "" VALUE 0x7EB6 CONST_0 100.000000 F00058 0.000000 255.000000 FUNCTION_LIST Fehlerfilter Kontrolle /end CHARACTERISTIC
/begin CHARACTERISTIC K_ED_FIL_CTL[239] "" VALUE 0x7EC4 CONST_0 100.000000 F00058 0.000000 255.000000 FUNCTION_LIST Fehlerfilter Kontrolle /end CHARACTERISTIC
/begin CHARACTERISTIC K_ED_FIL_CTL[240] "" VALUE 0x7ED2 CONST_0 100.000000 F00058 0.000000 255.000000 FUNCTION_LIST Fehlerfilter Kontrolle /end CHARACTERISTIC
/begin CHARACTERISTIC K_ED_FIL_CTL[241] "" VALUE 0x7EE0 CONST_0 100.000000 F00058 0.000000 255.000000 FUNCTION_LIST Fehlerfilter Kontrolle /end CHARACTERISTIC
/begin CHARACTERISTIC K_ED_FIL_CTL[242] "" VALUE 0x7EEE CONST_0 100.000000 F00058 0.000000 255.000000 FUNCTION_LIST Fehlerfilter Kontrolle /end CHARACTERISTIC
/begin CHARACTERISTIC K_ED_FIL_CTL[243] "" VALUE 0x7EFC CONST_0 100.000000 F00058 0.000000 255.000000 FUNCTION_LIST Fehlerfilter Kontrolle /end CHARACTERISTIC
/begin CHARACTERISTIC K_ED_FIL_CTL[244] "" VALUE 0x7F0A CONST_0 100.000000 F00058 0.000000 255.000000 FUNCTION_LIST Fehlerfilter Kontrolle /end CHARACTERISTIC
/begin CHARACTERISTIC K_ED_FIL_CTL[245] "" VALUE 0x7F18 CONST_0 100.000000 F00058 0.000000 255.000000 FUNCTION_LIST Fehlerfilter Kontrolle /end CHARACTERISTIC
/begin CHARACTERISTIC K_ED_FIL_CTL[246] "" VALUE 0x7F26 CONST_0 100.000000 F00058 0.000000 255.000000 FUNCTION_LIST Fehlerfilter Kontrolle /end CHARACTERISTIC
/begin CHARACTERISTIC K_ED_FIL_CTL[247] "" VALUE 0x7F34 CONST_0 100.000000 F00058 0.000000 255.000000 FUNCTION_LIST Fehlerfilter Kontrolle /end CHARACTERISTIC
/begin CHARACTERISTIC K_ED_FIL_CTL[248] "" VALUE 0x7F42 CONST_0 100.000000 F00058 0.000000 255.000000 FUNCTION_LIST Fehlerfilter Kontrolle /end CHARACTERISTIC
/begin CHARACTERISTIC K_ED_FIL_CTL[249] "" VALUE 0x7F50 CONST_0 100.000000 F00058 0.000000 255.000000 FUNCTION_LIST Fehlerfilter Kontrolle /end CHARACTERISTIC
/begin CHARACTERISTIC K_ED_FIL_CTL[250] "" VALUE 0x7F5E CONST_0 100.000000 F00058 0.000000 255.000000 FUNCTION_LIST Fehlerfilter Kontrolle /end CHARACTERISTIC
/begin CHARACTERISTIC K_ED_FIL_CTL[251] "" VALUE 0x7F6C CONST_0 100.000000 F00058 0.000000 255.000000 FUNCTION_LIST Fehlerfilter Kontrolle /end CHARACTERISTIC
/begin CHARACTERISTIC K_ED_FIL_CTL[252] "" VALUE 0x7F7A CONST_0 100.000000 F00058 0.000000 255.000000 FUNCTION_LIST Fehlerfilter Kontrolle /end CHARACTERISTIC
/begin CHARACTERISTIC K_ED_FIL_CTL[253] "" VALUE 0x7F88 CONST_0 100.000000 F00058 0.000000 255.000000 FUNCTION_LIST Fehlerfilter Kontrolle /end CHARACTERISTIC
/begin CHARACTERISTIC K_ED_FIL_CTL[254] "" VALUE 0x7F96 CONST_0 100.000000 F00058 0.000000 255.000000 FUNCTION_LIST Fehlerfilter Kontrolle /end CHARACTERISTIC
/begin CHARACTERISTIC K_ED_FIL_CTL[255] "" VALUE 0x7FA4 CONST_0 100.000000 F00058 0.000000 255.000000 FUNCTION_LIST Fehlerfilter Kontrolle /end CHARACTERISTIC
/begin COMPU_METHOD F00090 "-*-" FORM "%4.2" "-" FORMULA "((x-32768)/16)" /end COMPU_METHOD
/begin COMPU_METHOD F00391 "-*-" FORM "%3.2" "s" FORMULA "(16384/x) * 0.01" /end COMPU_METHOD
/begin COMPU_METHOD F00317 "-*-" FORM "%4.1" "msec" FORMULA "(x*10)/256" /end COMPU_METHOD
/begin COMPU_METHOD F00315 "-*-" FORM "%3.2" "msec" FORMULA "(x*10)/512" /end COMPU_METHOD
/begin COMPU_METHOD F00369 "-*-" FORM "%3.1" "%" FORMULA "(x*100)/128" /end COMPU_METHOD
/begin COMPU_METHOD F00373 "-*-" FORM "%2.0" "%t_END" FORMULA "(x*100)/128" /end COMPU_METHOD
/begin COMPU_METHOD F00418 "-*-" FORM "%5.0" "ms" FORMULA "(x*1000)/1024" /end COMPU_METHOD
/begin COMPU_METHOD F00310 "-*-" FORM "%3.2" "sec" FORMULA "(x*8)/1000" /end COMPU_METHOD
/begin COMPU_METHOD F00328 "-*-" FORM "%2.1" "m/(s*s)" FORMULA "(x-128)/10" /end COMPU_METHOD
/begin COMPU_METHOD F00316 "-*-" FORM "%5.1" "mV" FORMULA "(x-32767)" /end COMPU_METHOD
/begin COMPU_METHOD F00254 "-*-" FORM "%4.1" "m/(s*s)" FORMULA "(x-32768)/10" /end COMPU_METHOD
/begin COMPU_METHOD F00314 "-*-" FORM "%1.4" "kg" FORMULA "(x/3600)/10" /end COMPU_METHOD
/begin COMPU_METHOD F00354 "-*-" FORM "%2.1" "Nm" FORMULA "-x/10" /end COMPU_METHOD
/begin COMPU_METHOD F00392 "-*-" FORM "%3.2" "s" FORMULA "16384/(x*100)" /end COMPU_METHOD
/begin COMPU_METHOD F00299 "-*-" FORM "%3.2" "s" FORMULA "164/x" /end COMPU_METHOD
/begin COMPU_METHOD F00196 "-*-" FORM "%1.2" "s" FORMULA "2.56/x" /end COMPU_METHOD
/begin COMPU_METHOD F00195 "-*-" FORM "%2.1" "s" FORMULA "25.6/x" /end COMPU_METHOD
/begin COMPU_METHOD F00024 "-*-" FORM "%1.2" "s" FORMULA "5.12/x" /end COMPU_METHOD
/begin COMPU_METHOD F00390 "-*-" FORM "%3.0" "-" FORMULA "TXTEQ(x: da_s.equ)" /end COMPU_METHOD
/begin COMPU_METHOD F00419 "-*-" FORM "%3.2" "-" FORMULA "TXTEQ(x: name.equ)" /end COMPU_METHOD
/begin COMPU_METHOD F00318 "-*-" FORM "%1.0" "-" FORMULA "TXTEQ(x:: 0 6 INIT-Werte : 1 5 Flash-Werte)" /end COMPU_METHOD
/begin COMPU_METHOD F00404 "-*-" FORM "%1.0" "-" FORMULA "TXTEQ(x:: 0 6 ohne Abregelung : 1 -5 mit Abregelung)" /end COMPU_METHOD
/begin COMPU_METHOD F00398 "-*-" FORM "%3.2" "-" FORMULA "TXTEQ(x::$0 -1 Ohne KKOS BLS DYN :$1 1 DYN :$2 1 BLS :$3 1 BLS DYN :$4 1 KKOS :$5 1 KKOS DYN :$6 1 KKOS BLS :$7 1 KKOS BLS DYN :ELSE 2 undef. )" /end COMPU_METHOD
/begin COMPU_METHOD F00320 "-*-" FORM "%3.2" "-" FORMULA "TXTEQ(x::$0 -1 Ohne LDP :$1 1 Mit LDP :$2 1 Keine Fehlerheilung :ELSE 3 undef. )" /end COMPU_METHOD
/begin COMPU_METHOD F00332 "-*-" FORM "%3.2" "-" FORMULA "TXTEQ(x::$0 -1 OHNE LU  :$1 1 MIT LU :ELSE 1 undef. )" /end COMPU_METHOD
/begin COMPU_METHOD F00396 "-*-" FORM "%3.2" "-" FORMULA "TXTEQ(x::$0 -1 ohne Spuelzeitverl. :$1 1 Verlaeng. mit Nachtrig. :$2 -2 1x Verlaeng. : ELSE 2 undef. )" /end COMPU_METHOD
/begin COMPU_METHOD F00410 "-*-" FORM "%3.2" "-" FORMULA "TXTEQ(x::$0 -1 statisch  :$1 1 sequentiell :ELSE 1 undef. )" /end COMPU_METHOD
/begin COMPU_METHOD F00297 "-*-" FORM "%3.2" "-" FORMULA "TXTEQ(x::$0 -1 statisch :$1 1 getaktet :ELSE 3 undef. )" /end COMPU_METHOD
/begin COMPU_METHOD F00283 "-*-" FORM "%3.2" "-" FORMULA "TXTEQ(x::$0 1  AR-inaktiv.:ELSE i AR aktiv)" /end COMPU_METHOD
/begin COMPU_METHOD F00353 "-*-" FORM "%3.2" "-" FORMULA "TXTEQ(x::$0 1 aus :$1 1 n-Regler :$2 1 Automatprogs :$4 1 RS-Regler)" /end COMPU_METHOD
/begin COMPU_METHOD F00357 "-*-" FORM "%3.0" "-" FORMULA "TXTEQ(x::$0 1 aus)" /end COMPU_METHOD
/begin COMPU_METHOD F00294 "-*-" FORM "%3.2" "-" FORMULA "TXTEQ(x::$0 1 Fz-Betrieb :$01 1 Pruefstand :$02 1 Rolle)" /end COMPU_METHOD
/begin COMPU_METHOD F00034 "-*-" FORM "%3.2" "-" FORMULA "TXTEQ(x::$0 1 KR inaktiv :$40 1 KR HIP  :$80 1 KR DSP :ELSE 1 undefiniert )" /end COMPU_METHOD
/begin COMPU_METHOD F00342 "-*-" FORM "%3.2" "-" FORMULA "TXTEQ(x::$0 1 MD_TZ nur bei Eingriff:$1 1 MD_TZ immer aktiv :$2 1 MD_TZ SA-2stufig :ELSE 1 undefiniert)" /end COMPU_METHOD
/begin COMPU_METHOD F00037 "-*-" FORM "%3.2" "-" FORMULA "TXTEQ(x::$0 1 Momentenmanager :$01 1 Baudenzug )" /end COMPU_METHOD
/begin COMPU_METHOD F00160 "-*-" FORM "%3.2" "-" FORMULA "TXTEQ(x::$0 1 nicht FLASHEN :$1 1 FLASHEN :else -1 error)" /end COMPU_METHOD
/begin COMPU_METHOD F00366 "-*-" FORM "%3.2" "-" FORMULA "TXTEQ(x::$0 1 ohne SL :$1 0 mit SL :$2 0 SL/F_DYN)" /end COMPU_METHOD
/begin COMPU_METHOD F00012 "-*-" FORM "%3.2" "-" FORMULA "TXTEQ(x::$0 1 Regeln ab Druck  :$1 Regeln ab ML+KATH :ELSE -3 undef. )" /end COMPU_METHOD
/begin COMPU_METHOD F00284 "-*-" FORM "%3.2" "-" FORMULA "TXTEQ(x::$0 3 AUS :$1 1 LU :$2 1 TI :$3 1 TI+LU :$4 1 TZ :$5 1 TZ+LU :$6 1 TZ+TI :$7 1 TZ+TI+LU :ELSE 3 undef. )" /end COMPU_METHOD
/begin COMPU_METHOD F00033 "-*-" FORM "%3.2" "-" FORMULA "TXTEQ(x::$01 1 ECE  :$02 1 US  :$04 1 Golfstaaten )" /end COMPU_METHOD
/begin COMPU_METHOD F00029 "-*-" FORM "%3.2" "-" FORMULA "TXTEQ(x::$08 1 E36  :$10 1 E39  :$20 1 E46 :$40 1 E52 :$80 1 E59 :ELSE 1 undefiniert )" /end COMPU_METHOD
/begin COMPU_METHOD F00273 "-*-" FORM "%3.2" "-" FORMULA "TXTEQ(x::$1 1 Masterprozessor :$2 1 Slaveprozesor :ELSE 1 undefiniert)" /end COMPU_METHOD
/begin COMPU_METHOD F00032 "-*-" FORM "%3.2" "-" FORMULA "TXTEQ(x::$10 1 CAN 10H  :$11 1 CAN 11H  :$27 1 CAN 27H :ELSE 1 undefiniert )" /end COMPU_METHOD
/begin COMPU_METHOD F00293 "-*-" FORM "%3.2" "-" FORMULA "TXTEQ(x::$c 1 S54 :$20 1 S62B36 :$30 1 S62B50 :ELSE 1 undefiniert )" /end COMPU_METHOD
/begin COMPU_METHOD F00035 "-*-" FORM "%3.2" "-" FORMULA "TXTEQ(x::-124 1 Serienstand :$1 1 A-Muster :$2 1 B-Muster :$4 1 C-Muster :ELSE 1 undefiniert )" /end COMPU_METHOD
/begin COMPU_METHOD F00277 "-*-" FORM "%1.0" "-" FORMULA "TXTEQ(x::0 1 1 Satz Umw.Bed. :1 1 3 Saetze Umw.Bed. :ELSE 1 unzulaessige Maske)" /end COMPU_METHOD
/begin COMPU_METHOD F00282 "-*-" FORM "%3.0" "-" FORMULA "TXTEQ(x::0 1 AQ-SK nur auf Anforderung :1 1 AQ-SK immer )" /end COMPU_METHOD
/begin COMPU_METHOD F00278 "-*-" FORM "%1.0" "-" FORMULA "TXTEQ(x::0 1 Betriebsstunde :1 1 Kilometerstand :ELSE 1 unzulaessige Maske)" /end COMPU_METHOD
/begin COMPU_METHOD F00343 "-*-" FORM "%3.0" "-" FORMULA "TXTEQ(x::0 1 Bezug=Istmoment :1 1 Bezug=Sollmoment )" /end COMPU_METHOD
/begin COMPU_METHOD F00382 "-*-" FORM "%3.0" "-" FORMULA "TXTEQ(X::0 1 CAN Mess1 disable :1 1 CAN Mess1 enabled )" /end COMPU_METHOD
/begin COMPU_METHOD F00383 "-*-" FORM "%3.0" "-" FORMULA "TXTEQ(X::0 1 CAN Mess2 disable :1 1 CAN Mess2 enabled )" /end COMPU_METHOD
/begin COMPU_METHOD F00384 "-*-" FORM "%3.0" "-" FORMULA "TXTEQ(X::0 1 CAN Mess3 disable :1 1 CAN Mess1 enabled )" /end COMPU_METHOD
/begin COMPU_METHOD F00385 "-*-" FORM "%3.0" "-" FORMULA "TXTEQ(X::0 1 CAN Mess4 disable :1 1 CAN Mess4 enabled )" /end COMPU_METHOD
/begin COMPU_METHOD F00386 "-*-" FORM "%3.0" "-" FORMULA "TXTEQ(X::0 1 CAN Mess5 disable :1 1 CAN Mess5 enabled )" /end COMPU_METHOD
/begin COMPU_METHOD F00387 "-*-" FORM "%3.0" "-" FORMULA "TXTEQ(X::0 1 CAN Mess6 disable :1 1 CAN Mess6 enabled )" /end COMPU_METHOD
/begin COMPU_METHOD F00388 "-*-" FORM "%3.0" "-" FORMULA "TXTEQ(X::0 1 disable :1 1 LU-Tel 1 :2 1 KR-Tel )" /end COMPU_METHOD
/begin COMPU_METHOD F00389 "-*-" FORM "%3.0" "-" FORMULA "TXTEQ(X::0 1 disable :1 1 LU-Tel 2 :2 1 KR-Tel )" /end COMPU_METHOD
/begin COMPU_METHOD F00344 "-*-" FORM "%3.0" "-" FORMULA "TXTEQ(x::0 1 inaktiv :1 1 KR Kompensation :2 1 KA Kompensation :3 1 KR+KA Komp. )" /end COMPU_METHOD
/begin COMPU_METHOD F00232 "-*-" FORM "%3.0" "-" FORMULA "TXTEQ(x::0 1 keine MIL-Ansteuerung :1 1 MIL bei BMW-Fehler  :2 1 MIL fuer OBD  :4 1 MIL bei OEK-Fehler  :8 1 MIL fuer Japan  :ELSE 1 unzulaessige Maske)" /end COMPU_METHOD
/begin COMPU_METHOD F00330 "-*-" FORM "%3.0" "-" FORMULA "TXTEQ(x::0 1 LLSync gesperrt :1 1 LLSYNC freigegeben)" /end COMPU_METHOD
/begin COMPU_METHOD F00381 "-*-" FORM "%3.2" "-" FORMULA "TXTEQ(x::0 1 nur Ersatzwerte :1 1 SG-Reset )" /end COMPU_METHOD
/begin COMPU_METHOD F00219 "-*-" FORM "%3.0" "-" FORMULA "TXTEQ(x::0 1 SK-Egas abgeschaltet :1 1 SK-Egas aktiv )" /end COMPU_METHOD
/begin COMPU_METHOD F00058 "-*-" FORM "%3.2" "" FORMULA "x" /end COMPU_METHOD
/begin COMPU_METHOD F00093 "-*-" FORM "%2.0" "%" FORMULA "x" /end COMPU_METHOD
/begin COMPU_METHOD F00013 "-*-" FORM "%5.0" "-" FORMULA "x" /end COMPU_METHOD
/begin COMPU_METHOD F00351 "-*-" FORM "%1.0" ".Prog" FORMULA "x" /end COMPU_METHOD
/begin COMPU_METHOD F00161 "-*-" FORM "%3.0" "1" FORMULA "x" /end COMPU_METHOD
/begin COMPU_METHOD F00411 "-*-" FORM "%5.0" "1/No-Udr" FORMULA "x" /end COMPU_METHOD
/begin COMPU_METHOD F00408 "-*-" FORM "%5.0" "1/NO-Umdr." FORMULA "x" /end COMPU_METHOD
/begin COMPU_METHOD F00336 "-*-" FORM "%5.0" "2*U" FORMULA "x" /end COMPU_METHOD
/begin COMPU_METHOD F00286 "-*-" FORM "%3.0" "Auss" FORMULA "x" /end COMPU_METHOD
/begin COMPU_METHOD F00239 "-*-" FORM "%5.0" "digit" FORMULA "x" /end COMPU_METHOD
/begin COMPU_METHOD F00334 "-*-" FORM "%1.0" "Gang" FORMULA "x" /end COMPU_METHOD
/begin COMPU_METHOD F00300 "-*-" FORM "%3.0" "h" FORMULA "x" /end COMPU_METHOD
/begin COMPU_METHOD F00413 "-*-" FORM "%3.0" "ign" FORMULA "x" /end COMPU_METHOD
/begin COMPU_METHOD F00004 "-*-" FORM "%3.0" "km/h" FORMULA "x" /end COMPU_METHOD
/begin COMPU_METHOD F00091 "-*-" FORM "%3.0" "l" FORMULA "x" /end COMPU_METHOD
/begin COMPU_METHOD F00326 "-*-" FORM "%3.0" "mA/V/ms" FORMULA "x" /end COMPU_METHOD
/begin COMPU_METHOD F00223 "-*-" FORM "%3.0" "min" FORMULA "x" /end COMPU_METHOD
/begin COMPU_METHOD F00047 "-*-" FORM "%3.2" "ms" FORMULA "x" /end COMPU_METHOD
/begin COMPU_METHOD F00248 "-*-" FORM "%4.0" "msec" FORMULA "x" /end COMPU_METHOD
/begin COMPU_METHOD F00222 "-*-" FORM "%4.0" "mV" FORMULA "x" /end COMPU_METHOD
/begin COMPU_METHOD F00362 "-*-" FORM "%3.0" "Nm" FORMULA "x" /end COMPU_METHOD
/begin COMPU_METHOD F00281 "-*-" FORM "%5.0" "qmm" FORMULA "x" /end COMPU_METHOD
/begin COMPU_METHOD F00017 "-*-" FORM "%3.0" "s" FORMULA "x" /end COMPU_METHOD
/begin COMPU_METHOD F00250 "-*-" FORM "%3.0" "sec" FORMULA "x" /end COMPU_METHOD
/begin COMPU_METHOD F00265 "-*-" FORM "%3.0" "Segm" FORMULA "x" /end COMPU_METHOD
/begin COMPU_METHOD F00304 "-*-" FORM "%5.0" "U/min" FORMULA "x" /end COMPU_METHOD
/begin COMPU_METHOD F00007 "-*-" FORM "%4.0" "Upm" FORMULA "x" /end COMPU_METHOD
/begin COMPU_METHOD F00142 "-*-" FORM "%4.0" "Upm/s" FORMULA "x" /end COMPU_METHOD
/begin COMPU_METHOD F00243 "-*-" FORM "%3.0" "°C" FORMULA "x" /end COMPU_METHOD
/begin COMPU_METHOD F00015 "-*-" FORM "%3.0" "øC" FORMULA "x" /end COMPU_METHOD
/begin COMPU_METHOD F00011 "-*-" FORM "%2.0" "øKW" FORMULA "x" /end COMPU_METHOD
/begin COMPU_METHOD F00031 "-*-" FORM "%3.2" "-" FORMULA "X" /end COMPU_METHOD
/begin COMPU_METHOD F00321 "-*-" FORM "%3.0" "Diags" FORMULA "X" /end COMPU_METHOD
/begin COMPU_METHOD F00257 "-*-" FORM "%5.2" "mm" FORMULA "X" /end COMPU_METHOD
/begin COMPU_METHOD F00216 "-*-" FORM "%3.2" "ms" FORMULA "X" /end COMPU_METHOD
/begin COMPU_METHOD F00393 "-*-" FORM "%3.2" "s" FORMULA "x * 0.01" /end COMPU_METHOD
/begin COMPU_METHOD F00298 "-*-" FORM "%2.2" "V" FORMULA "x * 0.0636" /end COMPU_METHOD
/begin COMPU_METHOD F00347 "-*-" FORM "%4.0" "Upm/s" FORMULA "x*(-40)" /end COMPU_METHOD
/begin COMPU_METHOD F00008 "-*-" FORM "%3.3" "ms" FORMULA "x*0.00321" /end COMPU_METHOD
/begin COMPU_METHOD F00323 "-*-" FORM "%3.2" "mA" FORMULA "x*0.009" /end COMPU_METHOD
/begin COMPU_METHOD F00001 "-*-" FORM "%1.1" "Grad" FORMULA "x*0.04375" /end COMPU_METHOD
/begin COMPU_METHOD F00046 "-*-" FORM "%3.1" "%" FORMULA "x*0.4" /end COMPU_METHOD
/begin COMPU_METHOD F00322 "-*-" FORM "%3.4" "mA/ms2" FORMULA "x*0.9/256" /end COMPU_METHOD
/begin COMPU_METHOD F00057 "-*-" FORM "%6.0" "ms" FORMULA "x*10" /end COMPU_METHOD
/begin COMPU_METHOD F00305 "-*-" FORM "%6.0" "msec" FORMULA "x*10" /end COMPU_METHOD
/begin COMPU_METHOD F00181 "-*-" FORM "%4.0" "Nm/s" FORMULA "x*10" /end COMPU_METHOD
/begin COMPU_METHOD F00402 "-*-" FORM "%1.3" "%/sec" FORMULA "x*10/65536" /end COMPU_METHOD
/begin COMPU_METHOD F00019 "-*-" FORM "%5.1" "ms" FORMULA "x*100" /end COMPU_METHOD
/begin COMPU_METHOD F00041 "-*-" FORM "%2.1" "%" FORMULA "x*100/250" /end COMPU_METHOD
/begin COMPU_METHOD F00290 "-*-" FORM "%3.2" "%" FORMULA "x*100/32768" /end COMPU_METHOD
/begin COMPU_METHOD F00401 "-*-" FORM "%2.1" "%/10ms" FORMULA "x*100/32768" /end COMPU_METHOD
/begin COMPU_METHOD F00400 "-*-" FORM "%2.1" "%/200ms" FORMULA "x*100/32768" /end COMPU_METHOD
/begin COMPU_METHOD F00325 "-*-" FORM "%2.1" "min" FORMULA "x*1024/60/1000" /end COMPU_METHOD
/begin COMPU_METHOD F00370 "-*-" FORM "%3.0" "-" FORMULA "x*12.8" /end COMPU_METHOD
/begin COMPU_METHOD F00249 "-*-" FORM "%3.2" "msec" FORMULA "x*128/10000" /end COMPU_METHOD
/begin COMPU_METHOD F00287 "-*-" FORM "%4.0" "øC" FORMULA "x*16-50" /end COMPU_METHOD
/begin COMPU_METHOD F00364 "-*-" FORM "%3.0" "Upm" FORMULA "x*2" /end COMPU_METHOD
/begin COMPU_METHOD F00210 "-*-" FORM "%4.0" "ms" FORMULA "x*20" /end COMPU_METHOD
/begin COMPU_METHOD F00407 "-*-" FORM "%4.0" "msec" FORMULA "x*20" /end COMPU_METHOD
/begin COMPU_METHOD F00104 "-*-" FORM "%4.0" "mbar" FORMULA "x*3+500" /end COMPU_METHOD
/begin COMPU_METHOD F00395 "-*-" FORM "%3.2" "msec" FORMULA "x*3.21/1000" /end COMPU_METHOD
/begin COMPU_METHOD F00355 "-*-" FORM "%4.0" "Nm" FORMULA "x*4" /end COMPU_METHOD
/begin COMPU_METHOD F00409 "-*-" FORM "%5.0" "1/min" FORMULA "x*40" /end COMPU_METHOD
/begin COMPU_METHOD F00309 "-*-" FORM "%5.0" "U/min" FORMULA "x*40" /end COMPU_METHOD
/begin COMPU_METHOD F00109 "-*-" FORM "%4.0" "Upm" FORMULA "x*40" /end COMPU_METHOD
/begin COMPU_METHOD F00346 "-*-" FORM "%4.0" "Upm/s" FORMULA "x*40" /end COMPU_METHOD
/begin COMPU_METHOD F00040 "-*-" FORM "%4.0" "%/s" FORMULA "x*5" /end COMPU_METHOD
/begin COMPU_METHOD F00005 "-*-" FORM "%3.0" "øKW" FORMULA "x*6" /end COMPU_METHOD
/begin COMPU_METHOD F00152 "-*-" FORM "%5.2" "-" FORMULA "x-32768" /end COMPU_METHOD
/begin COMPU_METHOD F00303 "-*-" FORM "%3.0" "°C" FORMULA "x-48" /end COMPU_METHOD
/begin COMPU_METHOD F00014 "-*-" FORM "%3.0" "øC" FORMULA "x-48" /end COMPU_METHOD
/begin COMPU_METHOD F00154 "-*-" FORM "%3.2" "-" FORMULA "X-48" /end COMPU_METHOD
/begin COMPU_METHOD F00255 "-*-" FORM "%5.0" "m" FORMULA "x-500" /end COMPU_METHOD
/begin COMPU_METHOD F00048 "-*-" FORM "%3.2" "%" FORMULA "x/10" /end COMPU_METHOD
/begin COMPU_METHOD F00193 "-*-" FORM "%2.1" "m/(s*s)" FORMULA "x/10" /end COMPU_METHOD
/begin COMPU_METHOD F00371 "-*-" FORM "%2.1" "m/s2" FORMULA "x/10" /end COMPU_METHOD
/begin COMPU_METHOD F00350 "-*-" FORM "%4.0" "mm" FORMULA "x/10" /end COMPU_METHOD
/begin COMPU_METHOD F00145 "-*-" FORM "%2.1" "Nm" FORMULA "x/10" /end COMPU_METHOD
/begin COMPU_METHOD F00190 "-*-" FORM "%3.1" "Nm-%" FORMULA "x/10" /end COMPU_METHOD
/begin COMPU_METHOD F00363 "-*-" FORM "%4.0" "Nm/s" FORMULA "x/10" /end COMPU_METHOD
/begin COMPU_METHOD F00365 "-*-" FORM "%4.0" "Nms" FORMULA "x/10" /end COMPU_METHOD
/begin COMPU_METHOD F00331 "-*-" FORM "%4.1" "Ohm" FORMULA "x/10" /end COMPU_METHOD
/begin COMPU_METHOD F00028 "-*-" FORM "%2.1" "s" FORMULA "x/10" /end COMPU_METHOD
/begin COMPU_METHOD F00198 "-*-" FORM "%2.1" "sec" FORMULA "x/10" /end COMPU_METHOD
/begin COMPU_METHOD F00018 "-*-" FORM "%2.1" "V" FORMULA "x/10" /end COMPU_METHOD
/begin COMPU_METHOD F00405 "-*-" FORM "%2.1" "Volt" FORMULA "x/10" /end COMPU_METHOD
/begin COMPU_METHOD F00406 "-*-" FORM "%3.1" "°KW" FORMULA "x/10" /end COMPU_METHOD
/begin COMPU_METHOD F00045 "-*-" FORM "%2.1" "ø" FORMULA "x/10" /end COMPU_METHOD
/begin COMPU_METHOD F00333 "-*-" FORM "%2.1" "ø/Segm" FORMULA "x/10" /end COMPU_METHOD
/begin COMPU_METHOD F00006 "-*-" FORM "%2.1" "øKW" FORMULA "x/10" /end COMPU_METHOD
/begin COMPU_METHOD F00010 "-*-" FORM "%2.1" "s" FORMULA "X/10" /end COMPU_METHOD
/begin COMPU_METHOD F00352 "-*-" FORM "%1.1" "%" FORMULA "x/10.24" /end COMPU_METHOD
/begin COMPU_METHOD F00345 "-*-" FORM "%3.2" "10E-4" FORMULA "x/100" /end COMPU_METHOD
/begin COMPU_METHOD F00359 "-*-" FORM "%1.2" "Nm/Upm" FORMULA "x/100" /end COMPU_METHOD
/begin COMPU_METHOD F00027 "-*-" FORM "%1.1" "s" FORMULA "x/100" /end COMPU_METHOD
/begin COMPU_METHOD F00025 "-*-" FORM "%3.1" "sec" FORMULA "x/100" /end COMPU_METHOD
/begin COMPU_METHOD F00068 "-*-" FORM "%1.3" "-" FORMULA "x/1000" /end COMPU_METHOD
/begin COMPU_METHOD F00269 "-*-" FORM "%2.2" "ms" FORMULA "x/1000" /end COMPU_METHOD
/begin COMPU_METHOD F00308 "-*-" FORM "%1.2" "msec" FORMULA "x/1000" /end COMPU_METHOD
/begin COMPU_METHOD F00360 "-*-" FORM "%1.3" "Nm/Upm" FORMULA "x/1000" /end COMPU_METHOD
/begin COMPU_METHOD F00009 "-*-" FORM "%2.1" "s" FORMULA "x/1000" /end COMPU_METHOD
/begin COMPU_METHOD F00313 "-*-" FORM "%2.2" "sec" FORMULA "x/1000" /end COMPU_METHOD
/begin COMPU_METHOD F00060 "-*-" FORM "%1.4" "-" FORMULA "x/10000" /end COMPU_METHOD
/begin COMPU_METHOD F00358 "-*-" FORM "%1.4" "Nms/Upm" FORMULA "x/10000" /end COMPU_METHOD
/begin COMPU_METHOD F00361 "-*-" FORM "%1.2" "%/Nm" FORMULA "x/102.4" /end COMPU_METHOD
/begin COMPU_METHOD F00103 "-*-" FORM "%3.2" "V" FORMULA "X/1023*5" /end COMPU_METHOD
/begin COMPU_METHOD F00192 "-*-" FORM "%2.2" "" FORMULA "x/1024" /end COMPU_METHOD
/begin COMPU_METHOD F00085 "-*-" FORM "%1.3" "-" FORMULA "x/1024" /end COMPU_METHOD
/begin COMPU_METHOD F00307 "-*-" FORM "%2.3" "mV/digit" FORMULA "x/1024" /end COMPU_METHOD
/begin COMPU_METHOD F00016 "-*-" FORM "%7.3" "s" FORMULA "x/1024" /end COMPU_METHOD
/begin COMPU_METHOD F00356 "-*-" FORM "%1.2" "" FORMULA "x/128" /end COMPU_METHOD
/begin COMPU_METHOD F00056 "-*-" FORM "%1.2" "-" FORMULA "x/128" /end COMPU_METHOD
/begin COMPU_METHOD F00349 "-*-" FORM "%1.2" "Nms2" FORMULA "x/128" /end COMPU_METHOD
/begin COMPU_METHOD F00166 "-*-" FORM "%2.1" "%" FORMULA "x/128*100" /end COMPU_METHOD
/begin COMPU_METHOD F00167 "-*-" FORM "%2.2" "-" FORMULA "x/16" /end COMPU_METHOD
/begin COMPU_METHOD F00079 "-*-" FORM "%4.0" "km/h" FORMULA "x/16" /end COMPU_METHOD
/begin COMPU_METHOD F00412 "-*-" FORM "%4.2" "sec" FORMULA "x/16" /end COMPU_METHOD
/begin COMPU_METHOD F00097 "-*-" FORM "%1.4" "-" FORMULA "x/16384" /end COMPU_METHOD
/begin COMPU_METHOD F00288 "-*-" FORM "%3.2" "1/s" FORMULA "x/164" /end COMPU_METHOD
/begin COMPU_METHOD F00092 "-*-" FORM "%3.1" "U/kmh" FORMULA "x/2" /end COMPU_METHOD
/begin COMPU_METHOD F00116 "-*-" FORM "%1.3" "-" FORMULA "x/200" /end COMPU_METHOD
/begin COMPU_METHOD F00324 "-*-" FORM "%1.2" "" FORMULA "x/255" /end COMPU_METHOD
/begin COMPU_METHOD F00285 "-*-" FORM "%3.2" "-" FORMULA "x/255" /end COMPU_METHOD
/begin COMPU_METHOD F00099 "-*-" FORM "%1.2" "-" FORMULA "x/256" /end COMPU_METHOD
/begin COMPU_METHOD F00158 "-*-" FORM "%3.2" "kg/h" FORMULA "x/256" /end COMPU_METHOD
/begin COMPU_METHOD F00153 "-*-" FORM "%2.2" "-" FORMULA "X/256" /end COMPU_METHOD
/begin COMPU_METHOD F00335 "-*-" FORM "%1.2" "0/oo" FORMULA "x/256/16.384" /end COMPU_METHOD
/begin COMPU_METHOD F00403 "-*-" FORM "%1.4" "1/°KW" FORMULA "x/26214" /end COMPU_METHOD
/begin COMPU_METHOD F00131 "-*-" FORM "%1.2" "-" FORMULA "x/32" /end COMPU_METHOD
/begin COMPU_METHOD F00319 "-*-" FORM "%1.3" "-" FORMULA "x/32640" /end COMPU_METHOD
/begin COMPU_METHOD F00394 "-*-" FORM "%1.2" "-" FORMULA "x/32767" /end COMPU_METHOD
/begin COMPU_METHOD F00100 "-*-" FORM "%1.2" "-" FORMULA "x/32768" /end COMPU_METHOD
/begin COMPU_METHOD F00095 "-*-" FORM "%2.1" "kg/h" FORMULA "x/4" /end COMPU_METHOD
/begin COMPU_METHOD F00146 "-*-" FORM "%2.1" "kg/h" FORMULA "x/40" /end COMPU_METHOD
/begin COMPU_METHOD F00399 "-*-" FORM "%2.1" "s" FORMULA "x/5" /end COMPU_METHOD
/begin COMPU_METHOD F00159 "-*-" FORM "%2.1" "%" FORMULA "x/50" /end COMPU_METHOD
/begin COMPU_METHOD F00082 "-*-" FORM "%1.3" "s" FORMULA "x/50" /end COMPU_METHOD
/begin COMPU_METHOD F00367 "-*-" FORM "%1.2" "-" FORMULA "x/60" /end COMPU_METHOD
/begin COMPU_METHOD F00306 "-*-" FORM "%4.2" "min" FORMULA "x/60" /end COMPU_METHOD
/begin COMPU_METHOD F00003 "-*-" FORM "%1.2" "-" FORMULA "x/64" /end COMPU_METHOD
/begin COMPU_METHOD F00327 "-*-" FORM "%2.2" "V" FORMULA "x/640" /end COMPU_METHOD
/begin COMPU_METHOD F00329 "-*-" FORM "%1.3" "%" FORMULA "x/655.36" /end COMPU_METHOD
/begin COMPU_METHOD F00177 "-*-" FORM "%2.1" "%" FORMULA "x/65535*100" /end COMPU_METHOD
/begin MEASUREMENT ad_tabg "-" UWORD F00013 1 1.000000 0.000000 1023.000000 /end MEASUREMENT
/begin MEASUREMENT ad_tan "-" UWORD F00013 1 1.000000 0.000000 1023.000000 /end MEASUREMENT
/begin MEASUREMENT ad_tdme "-" UWORD F00013 1 1.000000 0.000000 1023.000000 /end MEASUREMENT
/begin MEASUREMENT ad_tka "-" UWORD F00013 1 1.000000 0.000000 1023.000000 /end MEASUREMENT
/begin MEASUREMENT ad_tmot "-" UWORD F00013 1 1.000000 0.000000 1023.000000 /end MEASUREMENT
/begin MEASUREMENT afz "-" UWORD F00254 1 1.000000 -3276.000000 3276.000000 /end MEASUREMENT
/begin MEASUREMENT aq_rel "-" UWORD F00290 1 1.000000 0.000000 120.000000 /end MEASUREMENT
/begin MEASUREMENT asc_ay "-" UBYTE F00328 1 1.000000 -12.000000 12.000000 /end MEASUREMENT
/begin MEASUREMENT ax "-" UBYTE F00371 1 1.000000 0.000000 25.000000 /end MEASUREMENT
/begin MEASUREMENT ax_berg "-" UBYTE F00371 1 1.000000 0.000000 25.000000 /end MEASUREMENT
/begin MEASUREMENT can_fst "-" UBYTE F00091 1 1.000000 0.000000 255.000000 /end MEASUREMENT
/begin MEASUREMENT can_lw "-" UWORD F00001 1 1.000000 0.000000 1433.000000 /end MEASUREMENT
/begin MEASUREMENT can_lws_u "-" UWORD F00001 1 1.000000 0.000000 1433.000000 /end MEASUREMENT
/begin MEASUREMENT dam "-" UWORD F00085 1 1.000000 0.000000 5.000000 /end MEASUREMENT
/begin MEASUREMENT day "-" UBYTE F00371 1 1.000000 0.000000 25.000000 /end MEASUREMENT
/begin MEASUREMENT dn "-" UWORD F00142 1 1.000000 0.000000 10000.000000 /end MEASUREMENT
/begin MEASUREMENT dn40 "-" UBYTE F00347 1 1.000000 0.000000 -5080.000000 /end MEASUREMENT
/begin MEASUREMENT dpr_lb_llr "-" UWORD F00153 1 1.000000 0.000000 100.000000 /end MEASUREMENT
/begin MEASUREMENT d_ax "-" UWORD F00193 1 1.000000 0.000000 12.000000 /end MEASUREMENT
/begin MEASUREMENT d_mdrel "-" UWORD F00040 1 1.000000 0.000000 327675.000000 /end MEASUREMENT
/begin MEASUREMENT d_md_fw "-" UWORD F00145 1 1.000000 0.000000 1000.000000 /end MEASUREMENT
/begin MEASUREMENT d_n "-" UWORD F00152 1 1.000000 -32768.000000 32767.000000 /end MEASUREMENT
/begin MEASUREMENT edk_delta "-" UWORD F00048 1 1.000000 0.000000 100.000000 /end MEASUREMENT
/begin MEASUREMENT edk_soll "-" UWORD F00048 1 1.000000 0.000000 100.000000 /end MEASUREMENT
/begin MEASUREMENT faktor "-" UBYTE F00056 1 1.000000 0.000000 1.000000 /end MEASUREMENT
/begin MEASUREMENT fgr_vdelta "-" UWORD F00090 1 1.000000 -2048.000000 2047.000000 /end MEASUREMENT
/begin MEASUREMENT fr_rf_delta "-" UWORD F00060 1 1.000000 0.000000 0.000000 /end MEASUREMENT
/begin MEASUREMENT FW "-" UBYTE F00093 1 1.000000 0.000000 255.000000 /end MEASUREMENT
/begin MEASUREMENT gang "-" UBYTE F00013 1 1.000000 0.000000 10.000000 /end MEASUREMENT
/begin MEASUREMENT HFM-SPANNUNG "-" UWORD F00103 1 1.000000 0.000000 320.000000 /end MEASUREMENT
/begin MEASUREMENT Istgang "-" UBYTE F00031 1 1.000000 0.000000 255.000000 /end MEASUREMENT
/begin MEASUREMENT Kennung "-" UBYTE F00013 1 1.000000 0.000000 255.000000 /end MEASUREMENT
/begin MEASUREMENT ki "-" UBYTE F00013 1 1.000000 0.000000 12.000000 /end MEASUREMENT
/begin MEASUREMENT KI_AB "-" UBYTE F00031 1 1.000000 1.000000 12.000000 /end MEASUREMENT
/begin MEASUREMENT KI_SCHA "-" UBYTE F00031 1 1.000000 1.000000 12.000000 /end MEASUREMENT
/begin MEASUREMENT konv_gr "-" UBYTE F00013 1 1.000000 0.000000 255.000000 /end MEASUREMENT
/begin MEASUREMENT ldp_ub_fil "-" UWORD F00327 1 1.000000 0.000000 25.000000 /end MEASUREMENT
/begin MEASUREMENT lfr.dn "-" UWORD F00007 1 1.000000 0.000000 10000.000000 /end MEASUREMENT
/begin MEASUREMENT lls_tv "-" UWORD F00159 1 1.000000 0.000000 100.000000 /end MEASUREMENT
/begin MEASUREMENT ll_abw "-" UWORD F00329 1 1.000000 0.000000 2.000000 /end MEASUREMENT
/begin MEASUREMENT lshv_r1 "-" UWORD F00331 1 1.000000 0.000000 100.000000 /end MEASUREMENT
/begin MEASUREMENT lu_adap_cnt "-" UWORD F00336 1 1.000000 0.000000 65535.000000 /end MEASUREMENT
/begin MEASUREMENT md "-" UWORD F00190 1 1.000000 0.000000 1000.000000 /end MEASUREMENT
/begin MEASUREMENT md_eta_ne "-" UWORD F00177 1 1.000000 0.000000 100.000000 /end MEASUREMENT
/begin MEASUREMENT md_fw "-" UWORD F00145 1 1.000000 0.000000 1000.000000 /end MEASUREMENT
/begin MEASUREMENT md_fw_filter "-" UWORD F00145 1 1.000000 0.000000 1000.000000 /end MEASUREMENT
/begin MEASUREMENT md_kw "-" UBYTE F00370 1 1.000000 0.000000 600.000000 /end MEASUREMENT
/begin MEASUREMENT md_la_ist "-" UBYTE F00056 1 1.000000 0.000000 1.000000 /end MEASUREMENT
/begin MEASUREMENT md_rel "-" UWORD F00048 1 1.000000 0.000000 100.000000 /end MEASUREMENT
/begin MEASUREMENT ml "-" UWORD F00095 1 1.000000 0.000000 1400.000000 /end MEASUREMENT
/begin MEASUREMENT ml_lls "-" UWORD F00146 1 1.000000 0.000000 1400.000000 /end MEASUREMENT
/begin MEASUREMENT ml_soll "-" UWORD F00158 1 1.000000 0.000000 120.000000 /end MEASUREMENT
/begin MEASUREMENT m_k_1 "-" UWORD F00145 1 1.000000 0.000000 6554.000000 /end MEASUREMENT
/begin MEASUREMENT n "-" UWORD F00007 1 1.000000 0.000000 10000.000000 /end MEASUREMENT
/begin MEASUREMENT n40 "-" UBYTE F00109 1 1.000000 0.000000 10000.000000 /end MEASUREMENT
/begin MEASUREMENT no-Zaehler "-" UWORD F00411 1 1.000000 0.000000 65535.000000 /end MEASUREMENT
/begin MEASUREMENT n_diff "-" UBYTE F00109 1 1.000000 0.000000 10000.000000 /end MEASUREMENT
/begin MEASUREMENT n_soll "-" UBYTE F00109 1 1.000000 0.000000 10200.000000 /end MEASUREMENT
/begin MEASUREMENT n_ziel "-" UBYTE F00109 1 1.000000 0.000000 10000.000000 /end MEASUREMENT
/begin MEASUREMENT off_time "-" UWORD F00412 1 1.000000 0.000000 4095.000000 /end MEASUREMENT
/begin MEASUREMENT pwg "-" UWORD F00048 1 1.000000 0.000000 100.000000 /end MEASUREMENT
/begin MEASUREMENT pwg1_2 "-" UWORD F00048 1 1.000000 0.000000 120.000000 /end MEASUREMENT
/begin MEASUREMENT pwgroh "-" UBYTE F00046 1 1.000000 0.000000 100.000000 /end MEASUREMENT
/begin MEASUREMENT p_umg "-" UBYTE F00104 1 1.000000 500.000000 1150.000000 /end MEASUREMENT
/begin MEASUREMENT p_umg_hoehe "-" UWORD F00255 1 1.000000 -500.000000 65035.000000 /end MEASUREMENT
/begin MEASUREMENT p_umg_ver "-" UWORD F00100 1 1.000000 0.000000 2.000000 /end MEASUREMENT
/begin MEASUREMENT rel_fw "-" UBYTE F00369 1 1.000000 0.000000 199.000000 /end MEASUREMENT
/begin MEASUREMENT rf "-" UWORD F00060 1 1.000000 0.000000 2.000000 /end MEASUREMENT
/begin MEASUREMENT rf5 "-" UBYTE F00116 1 1.000000 0.000000 1.000000 /end MEASUREMENT
/begin MEASUREMENT RF_PT_KORR "-" UBYTE F00056 1 1.000000 0.000000 1.000000 /end MEASUREMENT
/begin MEASUREMENT rschlupf "-" UBYTE F00093 1 1.000000 0.000000 100.000000 /end MEASUREMENT
/begin MEASUREMENT sectimer "-" UWORD F00017 1 1.000000 0.000000 65535.000000 /end MEASUREMENT
/begin MEASUREMENT sk_stufe "-" UWORD F00031 1 1.000000 0.000000 3.000000 /end MEASUREMENT
/begin MEASUREMENT stufe "-" UWORD F00031 1 1.000000 0.000000 5.000000 /end MEASUREMENT
/begin MEASUREMENT tabg_stand "-" UWORD F00223 1 1.000000 0.000000 65535.000000 /end MEASUREMENT
/begin MEASUREMENT tan "-" UWORD F00014 1 1.000000 -48.000000 207.000000 /end MEASUREMENT
/begin MEASUREMENT TEMPDIF "-" UBYTE F00243 1 1.000000 0.000000 255.000000 /end MEASUREMENT
/begin MEASUREMENT ti_we_ign "-" UBYTE F00413 1 1.000000 0.000000 255.000000 /end MEASUREMENT
/begin MEASUREMENT tka "-" UBYTE F00014 1 1.000000 -48.000000 207.000000 /end MEASUREMENT
/begin MEASUREMENT tkatm "-" UBYTE F00287 1 1.000000 -50.000000 1250.000000 /end MEASUREMENT
/begin MEASUREMENT tkatm_stand "-" UWORD F00223 1 1.000000 0.000000 65535.000000 /end MEASUREMENT
/begin MEASUREMENT tmot "-" UWORD F00014 1 1.000000 -48.000000 207.000000 /end MEASUREMENT
/begin MEASUREMENT tmot_start "-" UBYTE F00014 1 1.000000 -48.000000 207.000000 /end MEASUREMENT
/begin MEASUREMENT toel "-" UWORD F00014 1 1.000000 -48.000000 207.000000 /end MEASUREMENT
/begin MEASUREMENT toel_max "-" UBYTE F00303 1 1.000000 -48.000000 180.000000 /end MEASUREMENT
/begin MEASUREMENT toel_wanne "-" UWORD F00154 1 1.000000 -48.000000 130.000000 /end MEASUREMENT
/begin MEASUREMENT tog_heiz "-" UWORD F00249 1 1.000000 0.000000 80.000000 /end MEASUREMENT
/begin MEASUREMENT tog_n "-" UBYTE F00109 1 1.000000 0.000000 10000.000000 /end MEASUREMENT
/begin MEASUREMENT tog_niveau "-" UWORD F00257 1 1.000000 0.000000 65535.000000 /end MEASUREMENT
/begin MEASUREMENT t_ml "-" UWORD F00017 1 1.000000 0.000000 65535.000000 /end MEASUREMENT
/begin MEASUREMENT t_NORM "-" UBYTE F00373 1 1.000000 0.000000 100.000000 /end MEASUREMENT
/begin MEASUREMENT ub "-" UBYTE F00018 1 1.000000 0.000000 20.000000 /end MEASUREMENT
/begin MEASUREMENT usn_dif "-" UWORD F00316 1 1.000000 -32767.000000 32768.000000 /end MEASUREMENT
/begin MEASUREMENT v "-" UBYTE F00004 1 1.000000 0.000000 255.000000 /end MEASUREMENT
/begin MEASUREMENT v_asc "-" UWORD F00079 1 1.000000 0.000000 360.000000 /end MEASUREMENT
/begin MEASUREMENT wdk "-" UWORD F00048 1 1.000000 0.000000 100.000000 /end MEASUREMENT
/begin MEASUREMENT wdk1_2 "-" UWORD F00048 1 1.000000 0.000000 120.000000 /end MEASUREMENT
/begin MEASUREMENT x "-" UWORD F00031 1 1.000000 0.000000 65535.000000 /end MEASUREMENT
/begin MEASUREMENT y "-" UWORD F00031 1 1.000000 0.000000 65535.000000 /end MEASUREMENT
/begin MEASUREMENT zeit "-" UWORD F00017 1 1.000000 0.000000 65535.000000 /end MEASUREMENT
/begin MEASUREMENT zeit_we "-" UWORD F00216 1 1.000000 0.000000 65535.000000 /end MEASUREMENT
/begin RECORD_LAYOUT CONST_0 /* unsigned byte */ FNC_VALUES 0 UBYTE ROW_DIR DIRECT /end RECORD_LAYOUT
/begin RECORD_LAYOUT CONST_1 /* signed byte */ FNC_VALUES 0 SBYTE ROW_DIR DIRECT /end RECORD_LAYOUT
/begin RECORD_LAYOUT CONST_2 /* unsigned word */ FNC_VALUES 0 UWORD ROW_DIR DIRECT /end RECORD_LAYOUT
/begin RECORD_LAYOUT CONST_3 /* signed word */ FNC_VALUES 0 SWORD ROW_DIR DIRECT /end RECORD_LAYOUT
/begin RECORD_LAYOUT CONST_5 /* signed long */ FNC_VALUES 0 SLONG ROW_DIR DIRECT /end RECORD_LAYOUT
/end MODULE
