/begin MODULE 52_V508.A2L "52_V508.A2L"
/begin MOD_COMMON "BMSCOMMON" /* Definition der Standard-Byteorder */ BYTE_ORDER LITTLE_ENDIAN /* Motorola byte order */ /end MOD_COMMON
/begin CHARACTERISTIC KL_AQ_ABS_WDK "-" CURVE 0x6FEA VALUE_KL_AQ_ABS_WDK 100.000000 F00281 0.000000 20000.000000
 /begin AXIS_DESCR /* wdk */ COM_AXIS wdk F00048 8 0.000000 100.000000 AXIS_PTS_REF KL_AQ_ABS_WDK_wdk_AXIS /end AXIS_DESCR
 FUNCTION_LIST Relativer_Oeffnungsquerschnitt /end CHARACTERISTIC
/begin RECORD_LAYOUT VALUE_KL_AQ_ABS_WDK FNC_VALUES 0 UWORD ROW_DIR DIRECT /end RECORD_LAYOUT
/begin AXIS_PTS KL_AQ_ABS_WDK_wdk_AXIS "-" 0x6FDA wdk KL_AQ_ABS_WDK_wdk_AXIS 100.000000 F00048 8 0.000000 100.000000 /end AXIS_PTS
/begin RECORD_LAYOUT KL_AQ_ABS_WDK_wdk_AXIS FIX_NO_AXIS_PTS_X 8 AXIS_PTS_X 0 UWORD INDEX_INCR DIRECT /end RECORD_LAYOUT
/begin CHARACTERISTIC KF_AR_NGRAD1 "-" MAP 0x5852 VALUE_KF_AR_NGRAD1 100.000000 F00142 -10000.000000 10000.000000
 /begin AXIS_DESCR COM_AXIS n F00007 6 0.000000 10000.000000 AXIS_PTS_REF KF_AR_NGRAD1_n_AXIS /end AXIS_DESCR
 /begin AXIS_DESCR COM_AXIS rf F00068 6 0.000000 2.000000 AXIS_PTS_REF KF_AR_NGRAD1_rf_AXIS /end AXIS_DESCR
 FUNCTION_LIST ANTIRUCKELFUNKTION /end CHARACTERISTIC
/begin RECORD_LAYOUT VALUE_KF_AR_NGRAD1 FNC_VALUES 0 SWORD ROW_DIR DIRECT /end RECORD_LAYOUT
/begin AXIS_PTS KF_AR_NGRAD1_n_AXIS "-" 0x583A n KF_AR_NGRAD1_n_AXIS 100.000000 F00007 6 0.000000 10000.000000 /end AXIS_PTS
/begin RECORD_LAYOUT KF_AR_NGRAD1_n_AXIS FIX_NO_AXIS_PTS_X 6 AXIS_PTS_X 0 UWORD INDEX_INCR DIRECT /end RECORD_LAYOUT
/begin AXIS_PTS KF_AR_NGRAD1_rf_AXIS "-" 0x5846 rf KF_AR_NGRAD1_rf_AXIS 100.000000 F00068 6 0.000000 2.000000 /end AXIS_PTS
/begin RECORD_LAYOUT KF_AR_NGRAD1_rf_AXIS FIX_NO_AXIS_PTS_Y 6 AXIS_PTS_Y 0 UWORD INDEX_INCR DIRECT /end RECORD_LAYOUT
/begin CHARACTERISTIC KF_AR_NGRAD2 "-" MAP 0x58B4 VALUE_KF_AR_NGRAD2 100.000000 F00142 -10000.000000 10000.000000
 /begin AXIS_DESCR COM_AXIS n F00007 6 0.000000 10000.000000 AXIS_PTS_REF KF_AR_NGRAD2_n_AXIS /end AXIS_DESCR
 /begin AXIS_DESCR COM_AXIS rf F00068 6 0.000000 2.000000 AXIS_PTS_REF KF_AR_NGRAD2_rf_AXIS /end AXIS_DESCR
 FUNCTION_LIST ANTIRUCKELFUNKTION /end CHARACTERISTIC
/begin RECORD_LAYOUT VALUE_KF_AR_NGRAD2 FNC_VALUES 0 SWORD ROW_DIR DIRECT /end RECORD_LAYOUT
/begin AXIS_PTS KF_AR_NGRAD2_n_AXIS "-" 0x589C n KF_AR_NGRAD2_n_AXIS 100.000000 F00007 6 0.000000 10000.000000 /end AXIS_PTS
/begin RECORD_LAYOUT KF_AR_NGRAD2_n_AXIS FIX_NO_AXIS_PTS_X 6 AXIS_PTS_X 0 UWORD INDEX_INCR DIRECT /end RECORD_LAYOUT
/begin AXIS_PTS KF_AR_NGRAD2_rf_AXIS "-" 0x58A8 rf KF_AR_NGRAD2_rf_AXIS 100.000000 F00068 6 0.000000 2.000000 /end AXIS_PTS
/begin RECORD_LAYOUT KF_AR_NGRAD2_rf_AXIS FIX_NO_AXIS_PTS_Y 6 AXIS_PTS_Y 0 UWORD INDEX_INCR DIRECT /end RECORD_LAYOUT
/begin CHARACTERISTIC KF_AR_MD "-" MAP 0x5916 VALUE_KF_AR_MD 100.000000 F00145 -1000.000000 1000.000000
 /begin AXIS_DESCR COM_AXIS n F00007 6 0.000000 10000.000000 AXIS_PTS_REF KF_AR_MD_n_AXIS /end AXIS_DESCR
 /begin AXIS_DESCR COM_AXIS dn F00142 6 0.000000 65535.000000 AXIS_PTS_REF KF_AR_MD_dn_AXIS /end AXIS_DESCR
 FUNCTION_LIST ANTIRUCKELFUNKTION /end CHARACTERISTIC
/begin RECORD_LAYOUT VALUE_KF_AR_MD FNC_VALUES 0 SWORD ROW_DIR DIRECT /end RECORD_LAYOUT
/begin AXIS_PTS KF_AR_MD_n_AXIS "-" 0x58FE n KF_AR_MD_n_AXIS 100.000000 F00007 6 0.000000 10000.000000 /end AXIS_PTS
/begin RECORD_LAYOUT KF_AR_MD_n_AXIS FIX_NO_AXIS_PTS_X 6 AXIS_PTS_X 0 UWORD INDEX_INCR DIRECT /end RECORD_LAYOUT
/begin AXIS_PTS KF_AR_MD_dn_AXIS "-" 0x590A dn KF_AR_MD_dn_AXIS 100.000000 F00142 6 0.000000 65535.000000 /end AXIS_PTS
/begin RECORD_LAYOUT KF_AR_MD_dn_AXIS FIX_NO_AXIS_PTS_Y 6 AXIS_PTS_Y 0 UWORD INDEX_INCR DIRECT /end RECORD_LAYOUT
/begin CHARACTERISTIC KL_AUSS_WICHT_TKAT "-" CURVE 0x6672 VALUE_KL_AUSS_WICHT_TKAT 100.000000 F00131 0.000000 7.000000
 /begin AXIS_DESCR /* tkatm */ COM_AXIS tkatm F00287 4 -50.000000 1250.000000 AXIS_PTS_REF KL_AUSS_WICHT_TKAT_tkatm_AXIS /end AXIS_DESCR
 FUNCTION_LIST Aussetzerkennung /end CHARACTERISTIC
/begin RECORD_LAYOUT VALUE_KL_AUSS_WICHT_TKAT FNC_VALUES 0 UBYTE ROW_DIR DIRECT /end RECORD_LAYOUT
/begin AXIS_PTS KL_AUSS_WICHT_TKAT_tkatm_AXIS "-" 0x666E tkatm KL_AUSS_WICHT_TKAT_tkatm_AXIS 100.000000 F00287 4 -50.000000 1250.000000 /end AXIS_PTS
/begin RECORD_LAYOUT KL_AUSS_WICHT_TKAT_tkatm_AXIS FIX_NO_AXIS_PTS_X 4 AXIS_PTS_X 0 UBYTE INDEX_INCR DIRECT /end RECORD_LAYOUT
/begin CHARACTERISTIC KF_AUSS_WICHT_KS "-" MAP 0x6684 VALUE_KF_AUSS_WICHT_KS 100.000000 F00285 0.000000 1.000000
 /begin AXIS_DESCR COM_AXIS n40 F00109 6 0.000000 10000.000000 AXIS_PTS_REF KF_AUSS_WICHT_KS_n40_AXIS /end AXIS_DESCR
 /begin AXIS_DESCR COM_AXIS rf5 F00116 6 0.000000 1.000000 AXIS_PTS_REF KF_AUSS_WICHT_KS_rf5_AXIS /end AXIS_DESCR
 FUNCTION_LIST Aussetzerkennung /end CHARACTERISTIC
/begin RECORD_LAYOUT VALUE_KF_AUSS_WICHT_KS FNC_VALUES 0 UBYTE ROW_DIR DIRECT /end RECORD_LAYOUT
/begin AXIS_PTS KF_AUSS_WICHT_KS_n40_AXIS "-" 0x6678 n40 KF_AUSS_WICHT_KS_n40_AXIS 100.000000 F00109 6 0.000000 10000.000000 /end AXIS_PTS
/begin RECORD_LAYOUT KF_AUSS_WICHT_KS_n40_AXIS FIX_NO_AXIS_PTS_X 6 AXIS_PTS_X 0 UBYTE INDEX_INCR DIRECT /end RECORD_LAYOUT
/begin AXIS_PTS KF_AUSS_WICHT_KS_rf5_AXIS "-" 0x667E rf5 KF_AUSS_WICHT_KS_rf5_AXIS 100.000000 F00116 6 0.000000 1.000000 /end AXIS_PTS
/begin RECORD_LAYOUT KF_AUSS_WICHT_KS_rf5_AXIS FIX_NO_AXIS_PTS_Y 6 AXIS_PTS_Y 0 UBYTE INDEX_INCR DIRECT /end RECORD_LAYOUT
/begin CHARACTERISTIC KL_AVAN1_TOEL_KP "-" CURVE 0x5216 VALUE_KL_AVAN1_TOEL_KP 100.000000 F00289 0.000000 16.000000
 /begin AXIS_DESCR COM_AXIS toel F00014 8 -48.000000 207.000000 AXIS_PTS_REF KL_AVAN1_TOEL_KP_toel_AXIS /end AXIS_DESCR
 FUNCTION_LIST Vanos /end CHARACTERISTIC
/begin RECORD_LAYOUT VALUE_KL_AVAN1_TOEL_KP FNC_VALUES 0 UBYTE ROW_DIR DIRECT /end RECORD_LAYOUT
/begin AXIS_PTS KL_AVAN1_TOEL_KP_toel_AXIS "-" 0x520E toel KL_AVAN1_TOEL_KP_toel_AXIS 100.000000 F00014 8 -48.000000 207.000000 /end AXIS_PTS
/begin RECORD_LAYOUT KL_AVAN1_TOEL_KP_toel_AXIS FIX_NO_AXIS_PTS_X 8 AXIS_PTS_X 0 UBYTE INDEX_INCR DIRECT /end RECORD_LAYOUT
/begin CHARACTERISTIC KL_AVAN1_SOLL_NOISE "-" CURVE 0x5225 VALUE_KL_AVAN1_SOLL_NOISE 100.000000 F00011 -20.000000 80.000000
 /begin AXIS_DESCR COM_AXIS n40 F00109 5 0.000000 10000.000000 AXIS_PTS_REF KL_AVAN1_SOLL_NOISE_n40_AXIS /end AXIS_DESCR
 FUNCTION_LIST Vanos /end CHARACTERISTIC
/begin RECORD_LAYOUT VALUE_KL_AVAN1_SOLL_NOISE FNC_VALUES 0 SBYTE ROW_DIR DIRECT /end RECORD_LAYOUT
/begin AXIS_PTS KL_AVAN1_SOLL_NOISE_n40_AXIS "-" 0x5220 n40 KL_AVAN1_SOLL_NOISE_n40_AXIS 100.000000 F00109 5 0.000000 10000.000000 /end AXIS_PTS
/begin RECORD_LAYOUT KL_AVAN1_SOLL_NOISE_n40_AXIS FIX_NO_AXIS_PTS_X 5 AXIS_PTS_X 0 UBYTE INDEX_INCR DIRECT /end RECORD_LAYOUT
/begin CHARACTERISTIC KF_AVAN1_SOLL "-" MAP 0x526C VALUE_KF_AVAN1_SOLL 100.000000 F00011 -20.000000 80.000000
 /begin AXIS_DESCR COM_AXIS n F00007 16 0.000000 10000.000000 AXIS_PTS_REF KF_AVAN1_SOLL_n_AXIS /end AXIS_DESCR
 /begin AXIS_DESCR COM_AXIS aq_rel F00290 16 0.000000 120.000000 AXIS_PTS_REF KF_AVAN1_SOLL_aq_rel_AXIS /end AXIS_DESCR
 FUNCTION_LIST Vanos /end CHARACTERISTIC
/begin RECORD_LAYOUT VALUE_KF_AVAN1_SOLL FNC_VALUES 0 SBYTE ROW_DIR DIRECT /end RECORD_LAYOUT
/begin AXIS_PTS KF_AVAN1_SOLL_n_AXIS "-" 0x522C n KF_AVAN1_SOLL_n_AXIS 100.000000 F00007 16 0.000000 10000.000000 /end AXIS_PTS
/begin RECORD_LAYOUT KF_AVAN1_SOLL_n_AXIS FIX_NO_AXIS_PTS_X 16 AXIS_PTS_X 0 UWORD INDEX_INCR DIRECT /end RECORD_LAYOUT
/begin AXIS_PTS KF_AVAN1_SOLL_aq_rel_AXIS "-" 0x524C aq_rel KF_AVAN1_SOLL_aq_rel_AXIS 100.000000 F00290 16 0.000000 120.000000 /end AXIS_PTS
/begin RECORD_LAYOUT KF_AVAN1_SOLL_aq_rel_AXIS FIX_NO_AXIS_PTS_Y 16 AXIS_PTS_Y 0 UWORD INDEX_INCR DIRECT /end RECORD_LAYOUT
/begin CHARACTERISTIC KF_AVAN1_SOLL_KATH "-" MAP 0x53AE VALUE_KF_AVAN1_SOLL_KATH 100.000000 F00011 -20.000000 80.000000
 /begin AXIS_DESCR COM_AXIS n F00007 16 0.000000 10000.000000 AXIS_PTS_REF KF_AVAN1_SOLL_KATH_n_AXIS /end AXIS_DESCR
 /begin AXIS_DESCR COM_AXIS aq_rel F00290 16 0.000000 120.000000 AXIS_PTS_REF KF_AVAN1_SOLL_KATH_aq_rel_AXIS /end AXIS_DESCR
 FUNCTION_LIST Vanos /end CHARACTERISTIC
/begin RECORD_LAYOUT VALUE_KF_AVAN1_SOLL_KATH FNC_VALUES 0 SBYTE ROW_DIR DIRECT /end RECORD_LAYOUT
/begin AXIS_PTS KF_AVAN1_SOLL_KATH_n_AXIS "-" 0x536E n KF_AVAN1_SOLL_KATH_n_AXIS 100.000000 F00007 16 0.000000 10000.000000 /end AXIS_PTS
/begin RECORD_LAYOUT KF_AVAN1_SOLL_KATH_n_AXIS FIX_NO_AXIS_PTS_X 16 AXIS_PTS_X 0 UWORD INDEX_INCR DIRECT /end RECORD_LAYOUT
/begin AXIS_PTS KF_AVAN1_SOLL_KATH_aq_rel_AXIS "-" 0x538E aq_rel KF_AVAN1_SOLL_KATH_aq_rel_AXIS 100.000000 F00290 16 0.000000 120.000000 /end AXIS_PTS
/begin RECORD_LAYOUT KF_AVAN1_SOLL_KATH_aq_rel_AXIS FIX_NO_AXIS_PTS_Y 16 AXIS_PTS_Y 0 UWORD INDEX_INCR DIRECT /end RECORD_LAYOUT
/begin CHARACTERISTIC KF_AVAN1_SOLL_DMAX "-" MAP 0x54C8 VALUE_KF_AVAN1_SOLL_DMAX 100.000000 F00291 -20.000000 80.000000
 /begin AXIS_DESCR COM_AXIS n F00007 6 0.000000 10000.000000 AXIS_PTS_REF KF_AVAN1_SOLL_DMAX_n_AXIS /end AXIS_DESCR
 /begin AXIS_DESCR COM_AXIS aq_rel F00290 6 0.000000 120.000000 AXIS_PTS_REF KF_AVAN1_SOLL_DMAX_aq_rel_AXIS /end AXIS_DESCR
 FUNCTION_LIST Vanos /end CHARACTERISTIC
/begin RECORD_LAYOUT VALUE_KF_AVAN1_SOLL_DMAX FNC_VALUES 0 SWORD ROW_DIR DIRECT /end RECORD_LAYOUT
/begin AXIS_PTS KF_AVAN1_SOLL_DMAX_n_AXIS "-" 0x54B0 n KF_AVAN1_SOLL_DMAX_n_AXIS 100.000000 F00007 6 0.000000 10000.000000 /end AXIS_PTS
/begin RECORD_LAYOUT KF_AVAN1_SOLL_DMAX_n_AXIS FIX_NO_AXIS_PTS_X 6 AXIS_PTS_X 0 UWORD INDEX_INCR DIRECT /end RECORD_LAYOUT
/begin AXIS_PTS KF_AVAN1_SOLL_DMAX_aq_rel_AXIS "-" 0x54BC aq_rel KF_AVAN1_SOLL_DMAX_aq_rel_AXIS 100.000000 F00290 6 0.000000 120.000000 /end AXIS_PTS
/begin RECORD_LAYOUT KF_AVAN1_SOLL_DMAX_aq_rel_AXIS FIX_NO_AXIS_PTS_Y 6 AXIS_PTS_Y 0 UWORD INDEX_INCR DIRECT /end RECORD_LAYOUT
/begin CHARACTERISTIC KL_BA_DAM_POS "-" CURVE 0x7578 VALUE_KL_BA_DAM_POS 100.000000 F00085 0.000000 2.000000
 /begin AXIS_DESCR /* dam */ COM_AXIS dam F00085 6 0.000000 5.000000 AXIS_PTS_REF KL_BA_DAM_POS_dam_AXIS /end AXIS_DESCR
 FUNCTION_LIST BA /end CHARACTERISTIC
/begin RECORD_LAYOUT VALUE_KL_BA_DAM_POS FNC_VALUES 0 UWORD ROW_DIR DIRECT /end RECORD_LAYOUT
/begin AXIS_PTS KL_BA_DAM_POS_dam_AXIS "-" 0x756C dam KL_BA_DAM_POS_dam_AXIS 100.000000 F00085 6 0.000000 5.000000 /end AXIS_PTS
/begin RECORD_LAYOUT KL_BA_DAM_POS_dam_AXIS FIX_NO_AXIS_PTS_X 6 AXIS_PTS_X 0 UWORD INDEX_INCR DIRECT /end RECORD_LAYOUT
/begin CHARACTERISTIC KL_BA_FAKT_RED_TMOT "-" CURVE 0x75F4 VALUE_KL_BA_FAKT_RED_TMOT 100.000000 F00085 0.000000 2.000000
 /begin AXIS_DESCR COM_AXIS tmot F00014 6 -48.000000 207.000000 AXIS_PTS_REF KL_BA_FAKT_RED_TMOT_tmot_AXIS /end AXIS_DESCR
 FUNCTION_LIST BA /end CHARACTERISTIC
/begin RECORD_LAYOUT VALUE_KL_BA_FAKT_RED_TMOT FNC_VALUES 0 UWORD ROW_DIR DIRECT /end RECORD_LAYOUT
/begin AXIS_PTS KL_BA_FAKT_RED_TMOT_tmot_AXIS "-" 0x75E8 tmot KL_BA_FAKT_RED_TMOT_tmot_AXIS 100.000000 F00014 6 -48.000000 207.000000 /end AXIS_PTS
/begin RECORD_LAYOUT KL_BA_FAKT_RED_TMOT_tmot_AXIS FIX_NO_AXIS_PTS_X 6 AXIS_PTS_X 0 UWORD INDEX_INCR DIRECT /end RECORD_LAYOUT
/begin CHARACTERISTIC KL_BA_FAKT_ZEIT "-" CURVE 0x7612 VALUE_KL_BA_FAKT_ZEIT 100.000000 F00085 0.000000 2.000000
 /begin AXIS_DESCR /* zeit_we */ COM_AXIS zeit_we F00216 8 0.000000 65535.000000 AXIS_PTS_REF KL_BA_FAKT_ZEIT_zeit_we_AXIS /end AXIS_DESCR
 FUNCTION_LIST BA /end CHARACTERISTIC
/begin RECORD_LAYOUT VALUE_KL_BA_FAKT_ZEIT FNC_VALUES 0 UWORD ROW_DIR DIRECT /end RECORD_LAYOUT
/begin AXIS_PTS KL_BA_FAKT_ZEIT_zeit_we_AXIS "-" 0x7602 zeit_we KL_BA_FAKT_ZEIT_zeit_we_AXIS 100.000000 F00216 8 0.000000 65535.000000 /end AXIS_PTS
/begin RECORD_LAYOUT KL_BA_FAKT_ZEIT_zeit_we_AXIS FIX_NO_AXIS_PTS_X 8 AXIS_PTS_X 0 UWORD INDEX_INCR DIRECT /end RECORD_LAYOUT
/begin CHARACTERISTIC KL_BA_DAM_NEG "-" CURVE 0x7630 VALUE_KL_BA_DAM_NEG 100.000000 F00085 0.000000 2.000000
 /begin AXIS_DESCR /* dam */ COM_AXIS dam F00085 6 0.000000 5.000000 AXIS_PTS_REF KL_BA_DAM_NEG_dam_AXIS /end AXIS_DESCR
 FUNCTION_LIST BA /end CHARACTERISTIC
/begin RECORD_LAYOUT VALUE_KL_BA_DAM_NEG FNC_VALUES 0 UWORD ROW_DIR DIRECT /end RECORD_LAYOUT
/begin AXIS_PTS KL_BA_DAM_NEG_dam_AXIS "-" 0x7624 dam KL_BA_DAM_NEG_dam_AXIS 100.000000 F00085 6 0.000000 5.000000 /end AXIS_PTS
/begin RECORD_LAYOUT KL_BA_DAM_NEG_dam_AXIS FIX_NO_AXIS_PTS_X 6 AXIS_PTS_X 0 UWORD INDEX_INCR DIRECT /end RECORD_LAYOUT
/begin CHARACTERISTIC KL_BA_AQ_DELTA_NEG "-" CURVE 0x77D0 VALUE_KL_BA_AQ_DELTA_NEG 100.000000 F00292 -100.000000 99.000000
 /begin AXIS_DESCR COM_AXIS aq_rel F00290 3 0.000000 120.000000 AXIS_PTS_REF KL_BA_AQ_DELTA_NEG_aq_rel_AXIS /end AXIS_DESCR
 FUNCTION_LIST BA /end CHARACTERISTIC
/begin RECORD_LAYOUT VALUE_KL_BA_AQ_DELTA_NEG FNC_VALUES 0 SWORD ROW_DIR DIRECT /end RECORD_LAYOUT
/begin AXIS_PTS KL_BA_AQ_DELTA_NEG_aq_rel_AXIS "-" 0x77CA aq_rel KL_BA_AQ_DELTA_NEG_aq_rel_AXIS 100.000000 F00290 3 0.000000 120.000000 /end AXIS_PTS
/begin RECORD_LAYOUT KL_BA_AQ_DELTA_NEG_aq_rel_AXIS FIX_NO_AXIS_PTS_X 3 AXIS_PTS_X 0 UWORD INDEX_INCR DIRECT /end RECORD_LAYOUT
/begin CHARACTERISTIC KL_BA_AQ_DELTA_POS "-" CURVE 0x77DE VALUE_KL_BA_AQ_DELTA_POS 100.000000 F00292 -100.000000 99.000000
 /begin AXIS_DESCR COM_AXIS aq_rel F00290 3 0.000000 120.000000 AXIS_PTS_REF KL_BA_AQ_DELTA_POS_aq_rel_AXIS /end AXIS_DESCR
 FUNCTION_LIST BA /end CHARACTERISTIC
/begin RECORD_LAYOUT VALUE_KL_BA_AQ_DELTA_POS FNC_VALUES 0 SWORD ROW_DIR DIRECT /end RECORD_LAYOUT
/begin AXIS_PTS KL_BA_AQ_DELTA_POS_aq_rel_AXIS "-" 0x77D8 aq_rel KL_BA_AQ_DELTA_POS_aq_rel_AXIS 100.000000 F00290 3 0.000000 120.000000 /end AXIS_PTS
/begin RECORD_LAYOUT KL_BA_AQ_DELTA_POS_aq_rel_AXIS FIX_NO_AXIS_PTS_X 3 AXIS_PTS_X 0 UWORD INDEX_INCR DIRECT /end RECORD_LAYOUT
/begin CHARACTERISTIC KL_BA_IGN_NEG_TMOT "-" CURVE 0x77EA VALUE_KL_BA_IGN_NEG_TMOT 100.000000 F00031 0.000000 255.000000
 /begin AXIS_DESCR COM_AXIS tmot F00014 4 -48.000000 207.000000 AXIS_PTS_REF KL_BA_IGN_NEG_TMOT_tmot_AXIS /end AXIS_DESCR
 FUNCTION_LIST BA /end CHARACTERISTIC
/begin RECORD_LAYOUT VALUE_KL_BA_IGN_NEG_TMOT FNC_VALUES 0 UBYTE ROW_DIR DIRECT /end RECORD_LAYOUT
/begin AXIS_PTS KL_BA_IGN_NEG_TMOT_tmot_AXIS "-" 0x77E6 tmot KL_BA_IGN_NEG_TMOT_tmot_AXIS 100.000000 F00014 4 -48.000000 207.000000 /end AXIS_PTS
/begin RECORD_LAYOUT KL_BA_IGN_NEG_TMOT_tmot_AXIS FIX_NO_AXIS_PTS_X 4 AXIS_PTS_X 0 UBYTE INDEX_INCR DIRECT /end RECORD_LAYOUT
/begin CHARACTERISTIC KL_BA_IGN_RED_NEG_TM "-" CURVE 0x77F4 VALUE_KL_BA_IGN_RED_NEG_TM 100.000000 F00031 0.000000 255.000000
 /begin AXIS_DESCR COM_AXIS tmot F00014 4 -48.000000 207.000000 AXIS_PTS_REF KL_BA_IGN_RED_NEG_TM_tmot_AXIS /end AXIS_DESCR
 FUNCTION_LIST BA /end CHARACTERISTIC
/begin RECORD_LAYOUT VALUE_KL_BA_IGN_RED_NEG_TM FNC_VALUES 0 UBYTE ROW_DIR DIRECT /end RECORD_LAYOUT
/begin AXIS_PTS KL_BA_IGN_RED_NEG_TM_tmot_AXIS "-" 0x77F0 tmot KL_BA_IGN_RED_NEG_TM_tmot_AXIS 100.000000 F00014 4 -48.000000 207.000000 /end AXIS_PTS
/begin RECORD_LAYOUT KL_BA_IGN_RED_NEG_TM_tmot_AXIS FIX_NO_AXIS_PTS_X 4 AXIS_PTS_X 0 UBYTE INDEX_INCR DIRECT /end RECORD_LAYOUT
/begin CHARACTERISTIC KL_BA_IGN_POS_TMOT "-" CURVE 0x77FE VALUE_KL_BA_IGN_POS_TMOT 100.000000 F00031 0.000000 255.000000
 /begin AXIS_DESCR COM_AXIS tmot F00014 4 -48.000000 207.000000 AXIS_PTS_REF KL_BA_IGN_POS_TMOT_tmot_AXIS /end AXIS_DESCR
 FUNCTION_LIST BA /end CHARACTERISTIC
/begin RECORD_LAYOUT VALUE_KL_BA_IGN_POS_TMOT FNC_VALUES 0 UBYTE ROW_DIR DIRECT /end RECORD_LAYOUT
/begin AXIS_PTS KL_BA_IGN_POS_TMOT_tmot_AXIS "-" 0x77FA tmot KL_BA_IGN_POS_TMOT_tmot_AXIS 100.000000 F00014 4 -48.000000 207.000000 /end AXIS_PTS
/begin RECORD_LAYOUT KL_BA_IGN_POS_TMOT_tmot_AXIS FIX_NO_AXIS_PTS_X 4 AXIS_PTS_X 0 UBYTE INDEX_INCR DIRECT /end RECORD_LAYOUT
/begin CHARACTERISTIC KL_BA_IGN_RED_POS_TM "-" CURVE 0x7808 VALUE_KL_BA_IGN_RED_POS_TM 100.000000 F00031 0.000000 255.000000
 /begin AXIS_DESCR COM_AXIS tmot F00014 4 -48.000000 207.000000 AXIS_PTS_REF KL_BA_IGN_RED_POS_TM_tmot_AXIS /end AXIS_DESCR
 FUNCTION_LIST BA /end CHARACTERISTIC
/begin RECORD_LAYOUT VALUE_KL_BA_IGN_RED_POS_TM FNC_VALUES 0 UBYTE ROW_DIR DIRECT /end RECORD_LAYOUT
/begin AXIS_PTS KL_BA_IGN_RED_POS_TM_tmot_AXIS "-" 0x7804 tmot KL_BA_IGN_RED_POS_TM_tmot_AXIS 100.000000 F00014 4 -48.000000 207.000000 /end AXIS_PTS
/begin RECORD_LAYOUT KL_BA_IGN_RED_POS_TM_tmot_AXIS FIX_NO_AXIS_PTS_X 4 AXIS_PTS_X 0 UBYTE INDEX_INCR DIRECT /end RECORD_LAYOUT
/begin CHARACTERISTIC KF_BA_FAKT_TMOT_TAN "-" MAP 0x759E VALUE_KF_BA_FAKT_TMOT_TAN 100.000000 F00085 0.000000 2.000000
 /begin AXIS_DESCR COM_AXIS tmot F00014 6 -48.000000 207.000000 AXIS_PTS_REF KF_BA_FAKT_TMOT_TAN_tmot_AXIS /end AXIS_DESCR
 /begin AXIS_DESCR COM_AXIS tan F00014 6 -48.000000 207.000000 AXIS_PTS_REF KF_BA_FAKT_TMOT_TAN_tan_AXIS /end AXIS_DESCR
 FUNCTION_LIST BA /end CHARACTERISTIC
/begin RECORD_LAYOUT VALUE_KF_BA_FAKT_TMOT_TAN FNC_VALUES 0 UWORD ROW_DIR DIRECT /end RECORD_LAYOUT
/begin AXIS_PTS KF_BA_FAKT_TMOT_TAN_tmot_AXIS "-" 0x7586 tmot KF_BA_FAKT_TMOT_TAN_tmot_AXIS 100.000000 F00014 6 -48.000000 207.000000 /end AXIS_PTS
/begin RECORD_LAYOUT KF_BA_FAKT_TMOT_TAN_tmot_AXIS FIX_NO_AXIS_PTS_X 6 AXIS_PTS_X 0 UWORD INDEX_INCR DIRECT /end RECORD_LAYOUT
/begin AXIS_PTS KF_BA_FAKT_TMOT_TAN_tan_AXIS "-" 0x7592 tan KF_BA_FAKT_TMOT_TAN_tan_AXIS 100.000000 F00014 6 -48.000000 207.000000 /end AXIS_PTS
/begin RECORD_LAYOUT KF_BA_FAKT_TMOT_TAN_tan_AXIS FIX_NO_AXIS_PTS_Y 6 AXIS_PTS_Y 0 UWORD INDEX_INCR DIRECT /end RECORD_LAYOUT
/begin CHARACTERISTIC KF_BA_FAKT_RED_POS_T "-" MAP 0x764E VALUE_KF_BA_FAKT_RED_POS_T 100.000000 F00085 0.000000 2.000000
 /begin AXIS_DESCR COM_AXIS tmot F00014 4 -48.000000 207.000000 AXIS_PTS_REF KF_BA_FAKT_RED_POS_T_tmot_AXIS /end AXIS_DESCR
 /begin AXIS_DESCR COM_AXIS n F00007 4 0.000000 10000.000000 AXIS_PTS_REF KF_BA_FAKT_RED_POS_T_n_AXIS /end AXIS_DESCR
 FUNCTION_LIST BA /end CHARACTERISTIC
/begin RECORD_LAYOUT VALUE_KF_BA_FAKT_RED_POS_T FNC_VALUES 0 UWORD ROW_DIR DIRECT /end RECORD_LAYOUT
/begin AXIS_PTS KF_BA_FAKT_RED_POS_T_tmot_AXIS "-" 0x763E tmot KF_BA_FAKT_RED_POS_T_tmot_AXIS 100.000000 F00014 4 -48.000000 207.000000 /end AXIS_PTS
/begin RECORD_LAYOUT KF_BA_FAKT_RED_POS_T_tmot_AXIS FIX_NO_AXIS_PTS_X 4 AXIS_PTS_X 0 UWORD INDEX_INCR DIRECT /end RECORD_LAYOUT
/begin AXIS_PTS KF_BA_FAKT_RED_POS_T_n_AXIS "-" 0x7646 n KF_BA_FAKT_RED_POS_T_n_AXIS 100.000000 F00007 4 0.000000 10000.000000 /end AXIS_PTS
/begin RECORD_LAYOUT KF_BA_FAKT_RED_POS_T_n_AXIS FIX_NO_AXIS_PTS_Y 4 AXIS_PTS_Y 0 UWORD INDEX_INCR DIRECT /end RECORD_LAYOUT
/begin CHARACTERISTIC KF_BA_FAKT_RED_NEG_T "-" MAP 0x7680 VALUE_KF_BA_FAKT_RED_NEG_T 100.000000 F00085 0.000000 2.000000
 /begin AXIS_DESCR COM_AXIS tmot F00014 4 -48.000000 207.000000 AXIS_PTS_REF KF_BA_FAKT_RED_NEG_T_tmot_AXIS /end AXIS_DESCR
 /begin AXIS_DESCR COM_AXIS n F00007 4 0.000000 10000.000000 AXIS_PTS_REF KF_BA_FAKT_RED_NEG_T_n_AXIS /end AXIS_DESCR
 FUNCTION_LIST BA /end CHARACTERISTIC
/begin RECORD_LAYOUT VALUE_KF_BA_FAKT_RED_NEG_T FNC_VALUES 0 UWORD ROW_DIR DIRECT /end RECORD_LAYOUT
/begin AXIS_PTS KF_BA_FAKT_RED_NEG_T_tmot_AXIS "-" 0x7670 tmot KF_BA_FAKT_RED_NEG_T_tmot_AXIS 100.000000 F00014 4 -48.000000 207.000000 /end AXIS_PTS
/begin RECORD_LAYOUT KF_BA_FAKT_RED_NEG_T_tmot_AXIS FIX_NO_AXIS_PTS_X 4 AXIS_PTS_X 0 UWORD INDEX_INCR DIRECT /end RECORD_LAYOUT
/begin AXIS_PTS KF_BA_FAKT_RED_NEG_T_n_AXIS "-" 0x7678 n KF_BA_FAKT_RED_NEG_T_n_AXIS 100.000000 F00007 4 0.000000 10000.000000 /end AXIS_PTS
/begin RECORD_LAYOUT KF_BA_FAKT_RED_NEG_T_n_AXIS FIX_NO_AXIS_PTS_Y 4 AXIS_PTS_Y 0 UWORD INDEX_INCR DIRECT /end RECORD_LAYOUT
/begin CHARACTERISTIC KF_BA_FAKT_RF_N "-" MAP 0x76BA VALUE_KF_BA_FAKT_RF_N 100.000000 F00085 0.000000 4.000000
 /begin AXIS_DESCR COM_AXIS rf F00068 6 0.000000 2.000000 AXIS_PTS_REF KF_BA_FAKT_RF_N_rf_AXIS /end AXIS_DESCR
 /begin AXIS_DESCR COM_AXIS n F00007 6 0.000000 10000.000000 AXIS_PTS_REF KF_BA_FAKT_RF_N_n_AXIS /end AXIS_DESCR
 FUNCTION_LIST BA /end CHARACTERISTIC
/begin RECORD_LAYOUT VALUE_KF_BA_FAKT_RF_N FNC_VALUES 0 UWORD ROW_DIR DIRECT /end RECORD_LAYOUT
/begin AXIS_PTS KF_BA_FAKT_RF_N_rf_AXIS "-" 0x76A2 rf KF_BA_FAKT_RF_N_rf_AXIS 100.000000 F00068 6 0.000000 2.000000 /end AXIS_PTS
/begin RECORD_LAYOUT KF_BA_FAKT_RF_N_rf_AXIS FIX_NO_AXIS_PTS_X 6 AXIS_PTS_X 0 UWORD INDEX_INCR DIRECT /end RECORD_LAYOUT
/begin AXIS_PTS KF_BA_FAKT_RF_N_n_AXIS "-" 0x76AE n KF_BA_FAKT_RF_N_n_AXIS 100.000000 F00007 6 0.000000 10000.000000 /end AXIS_PTS
/begin RECORD_LAYOUT KF_BA_FAKT_RF_N_n_AXIS FIX_NO_AXIS_PTS_Y 6 AXIS_PTS_Y 0 UWORD INDEX_INCR DIRECT /end RECORD_LAYOUT
/begin CHARACTERISTIC KF_BA_FAKT_RF_N_NEG "-" MAP 0x771C VALUE_KF_BA_FAKT_RF_N_NEG 100.000000 F00085 0.000000 4.000000
 /begin AXIS_DESCR COM_AXIS rf F00068 6 0.000000 2.000000 AXIS_PTS_REF KF_BA_FAKT_RF_N_NEG_rf_AXIS /end AXIS_DESCR
 /begin AXIS_DESCR COM_AXIS n F00007 6 0.000000 10000.000000 AXIS_PTS_REF KF_BA_FAKT_RF_N_NEG_n_AXIS /end AXIS_DESCR
 FUNCTION_LIST BA /end CHARACTERISTIC
/begin RECORD_LAYOUT VALUE_KF_BA_FAKT_RF_N_NEG FNC_VALUES 0 UWORD ROW_DIR DIRECT /end RECORD_LAYOUT
/begin AXIS_PTS KF_BA_FAKT_RF_N_NEG_rf_AXIS "-" 0x7704 rf KF_BA_FAKT_RF_N_NEG_rf_AXIS 100.000000 F00068 6 0.000000 2.000000 /end AXIS_PTS
/begin RECORD_LAYOUT KF_BA_FAKT_RF_N_NEG_rf_AXIS FIX_NO_AXIS_PTS_X 6 AXIS_PTS_X 0 UWORD INDEX_INCR DIRECT /end RECORD_LAYOUT
/begin AXIS_PTS KF_BA_FAKT_RF_N_NEG_n_AXIS "-" 0x7710 n KF_BA_FAKT_RF_N_NEG_n_AXIS 100.000000 F00007 6 0.000000 10000.000000 /end AXIS_PTS
/begin RECORD_LAYOUT KF_BA_FAKT_RF_N_NEG_n_AXIS FIX_NO_AXIS_PTS_Y 6 AXIS_PTS_Y 0 UWORD INDEX_INCR DIRECT /end RECORD_LAYOUT
/begin CHARACTERISTIC KF_BA_POS_TMOT_N "-" MAP 0x7776 VALUE_KF_BA_POS_TMOT_N 100.000000 F00085 0.000000 2.000000
 /begin AXIS_DESCR COM_AXIS tmot F00014 4 -48.000000 207.000000 AXIS_PTS_REF KF_BA_POS_TMOT_N_tmot_AXIS /end AXIS_DESCR
 /begin AXIS_DESCR COM_AXIS n F00007 4 0.000000 10000.000000 AXIS_PTS_REF KF_BA_POS_TMOT_N_n_AXIS /end AXIS_DESCR
 FUNCTION_LIST BA /end CHARACTERISTIC
/begin RECORD_LAYOUT VALUE_KF_BA_POS_TMOT_N FNC_VALUES 0 UWORD ROW_DIR DIRECT /end RECORD_LAYOUT
/begin AXIS_PTS KF_BA_POS_TMOT_N_tmot_AXIS "-" 0x7766 tmot KF_BA_POS_TMOT_N_tmot_AXIS 100.000000 F00014 4 -48.000000 207.000000 /end AXIS_PTS
/begin RECORD_LAYOUT KF_BA_POS_TMOT_N_tmot_AXIS FIX_NO_AXIS_PTS_X 4 AXIS_PTS_X 0 UWORD INDEX_INCR DIRECT /end RECORD_LAYOUT
/begin AXIS_PTS KF_BA_POS_TMOT_N_n_AXIS "-" 0x776E n KF_BA_POS_TMOT_N_n_AXIS 100.000000 F00007 4 0.000000 10000.000000 /end AXIS_PTS
/begin RECORD_LAYOUT KF_BA_POS_TMOT_N_n_AXIS FIX_NO_AXIS_PTS_Y 4 AXIS_PTS_Y 0 UWORD INDEX_INCR DIRECT /end RECORD_LAYOUT
/begin CHARACTERISTIC KF_BA_NEG_TMOT_N "-" MAP 0x77A8 VALUE_KF_BA_NEG_TMOT_N 100.000000 F00085 0.000000 2.000000
 /begin AXIS_DESCR COM_AXIS tmot F00014 4 -48.000000 207.000000 AXIS_PTS_REF KF_BA_NEG_TMOT_N_tmot_AXIS /end AXIS_DESCR
 /begin AXIS_DESCR COM_AXIS n F00007 4 0.000000 10000.000000 AXIS_PTS_REF KF_BA_NEG_TMOT_N_n_AXIS /end AXIS_DESCR
 FUNCTION_LIST BA /end CHARACTERISTIC
/begin RECORD_LAYOUT VALUE_KF_BA_NEG_TMOT_N FNC_VALUES 0 UWORD ROW_DIR DIRECT /end RECORD_LAYOUT
/begin AXIS_PTS KF_BA_NEG_TMOT_N_tmot_AXIS "-" 0x7798 tmot KF_BA_NEG_TMOT_N_tmot_AXIS 100.000000 F00014 4 -48.000000 207.000000 /end AXIS_PTS
/begin RECORD_LAYOUT KF_BA_NEG_TMOT_N_tmot_AXIS FIX_NO_AXIS_PTS_X 4 AXIS_PTS_X 0 UWORD INDEX_INCR DIRECT /end RECORD_LAYOUT
/begin AXIS_PTS KF_BA_NEG_TMOT_N_n_AXIS "-" 0x77A0 n KF_BA_NEG_TMOT_N_n_AXIS 100.000000 F00007 4 0.000000 10000.000000 /end AXIS_PTS
/begin RECORD_LAYOUT KF_BA_NEG_TMOT_N_n_AXIS FIX_NO_AXIS_PTS_Y 4 AXIS_PTS_Y 0 UWORD INDEX_INCR DIRECT /end RECORD_LAYOUT
/begin CHARACTERISTIC KL_DKBA_TRIGGER "-" CURVE 0x5524 VALUE_KL_DKBA_TRIGGER 100.000000 F00295 0.000000 2.000000
 /begin AXIS_DESCR COM_AXIS n F00007 8 0.000000 10000.000000 AXIS_PTS_REF KL_DKBA_TRIGGER_n_AXIS /end AXIS_DESCR
 FUNCTION_LIST DKBA /end CHARACTERISTIC
/begin RECORD_LAYOUT VALUE_KL_DKBA_TRIGGER FNC_VALUES 0 SWORD ROW_DIR DIRECT /end RECORD_LAYOUT
/begin AXIS_PTS KL_DKBA_TRIGGER_n_AXIS "-" 0x5514 n KL_DKBA_TRIGGER_n_AXIS 100.000000 F00007 8 0.000000 10000.000000 /end AXIS_PTS
/begin RECORD_LAYOUT KL_DKBA_TRIGGER_n_AXIS FIX_NO_AXIS_PTS_X 8 AXIS_PTS_X 0 UWORD INDEX_INCR DIRECT /end RECORD_LAYOUT
/begin CHARACTERISTIC KL_DKBA_TMOT "-" CURVE 0x5542 VALUE_KL_DKBA_TMOT 100.000000 F00085 0.000000 2.000000
 /begin AXIS_DESCR COM_AXIS tmot F00014 6 -48.000000 207.000000 AXIS_PTS_REF KL_DKBA_TMOT_tmot_AXIS /end AXIS_DESCR
 FUNCTION_LIST DKBA /end CHARACTERISTIC
/begin RECORD_LAYOUT VALUE_KL_DKBA_TMOT FNC_VALUES 0 UWORD ROW_DIR DIRECT /end RECORD_LAYOUT
/begin AXIS_PTS KL_DKBA_TMOT_tmot_AXIS "-" 0x5536 tmot KL_DKBA_TMOT_tmot_AXIS 100.000000 F00014 6 -48.000000 207.000000 /end AXIS_PTS
/begin RECORD_LAYOUT KL_DKBA_TMOT_tmot_AXIS FIX_NO_AXIS_PTS_X 6 AXIS_PTS_X 0 UWORD INDEX_INCR DIRECT /end RECORD_LAYOUT
/begin CHARACTERISTIC KL_DKBA_AQ_REL "-" CURVE 0x555C VALUE_KL_DKBA_AQ_REL 100.000000 F00296 -100.000000 99.000000
 /begin AXIS_DESCR COM_AXIS aq_rel F00290 6 0.000000 120.000000 AXIS_PTS_REF KL_DKBA_AQ_REL_aq_rel_AXIS /end AXIS_DESCR
 FUNCTION_LIST DKBA /end CHARACTERISTIC
/begin RECORD_LAYOUT VALUE_KL_DKBA_AQ_REL FNC_VALUES 0 SWORD ROW_DIR DIRECT /end RECORD_LAYOUT
/begin AXIS_PTS KL_DKBA_AQ_REL_aq_rel_AXIS "-" 0x5550 aq_rel KL_DKBA_AQ_REL_aq_rel_AXIS 100.000000 F00290 6 0.000000 120.000000 /end AXIS_PTS
/begin RECORD_LAYOUT KL_DKBA_AQ_REL_aq_rel_AXIS FIX_NO_AXIS_PTS_X 6 AXIS_PTS_X 0 UWORD INDEX_INCR DIRECT /end RECORD_LAYOUT
/begin CHARACTERISTIC KF_DKBA_SOFT_RF_N "-" MAP 0x557A VALUE_KF_DKBA_SOFT_RF_N 100.000000 F00085 0.000000 10.000000
 /begin AXIS_DESCR COM_AXIS rf F00068 4 0.000000 2.000000 AXIS_PTS_REF KF_DKBA_SOFT_RF_N_rf_AXIS /end AXIS_DESCR
 /begin AXIS_DESCR COM_AXIS n F00007 4 0.000000 10000.000000 AXIS_PTS_REF KF_DKBA_SOFT_RF_N_n_AXIS /end AXIS_DESCR
 FUNCTION_LIST DKBA /end CHARACTERISTIC
/begin RECORD_LAYOUT VALUE_KF_DKBA_SOFT_RF_N FNC_VALUES 0 UWORD ROW_DIR DIRECT /end RECORD_LAYOUT
/begin AXIS_PTS KF_DKBA_SOFT_RF_N_rf_AXIS "-" 0x556A rf KF_DKBA_SOFT_RF_N_rf_AXIS 100.000000 F00068 4 0.000000 2.000000 /end AXIS_PTS
/begin RECORD_LAYOUT KF_DKBA_SOFT_RF_N_rf_AXIS FIX_NO_AXIS_PTS_X 4 AXIS_PTS_X 0 UWORD INDEX_INCR DIRECT /end RECORD_LAYOUT
/begin AXIS_PTS KF_DKBA_SOFT_RF_N_n_AXIS "-" 0x5572 n KF_DKBA_SOFT_RF_N_n_AXIS 100.000000 F00007 4 0.000000 10000.000000 /end AXIS_PTS
/begin RECORD_LAYOUT KF_DKBA_SOFT_RF_N_n_AXIS FIX_NO_AXIS_PTS_Y 4 AXIS_PTS_Y 0 UWORD INDEX_INCR DIRECT /end RECORD_LAYOUT
/begin CHARACTERISTIC KF_DKBA_HARD_RF_N "-" MAP 0x55AC VALUE_KF_DKBA_HARD_RF_N 100.000000 F00085 0.000000 10.000000
 /begin AXIS_DESCR COM_AXIS rf F00068 4 0.000000 2.000000 AXIS_PTS_REF KF_DKBA_HARD_RF_N_rf_AXIS /end AXIS_DESCR
 /begin AXIS_DESCR COM_AXIS n F00007 4 0.000000 10000.000000 AXIS_PTS_REF KF_DKBA_HARD_RF_N_n_AXIS /end AXIS_DESCR
 FUNCTION_LIST DKBA /end CHARACTERISTIC
/begin RECORD_LAYOUT VALUE_KF_DKBA_HARD_RF_N FNC_VALUES 0 UWORD ROW_DIR DIRECT /end RECORD_LAYOUT
/begin AXIS_PTS KF_DKBA_HARD_RF_N_rf_AXIS "-" 0x559C rf KF_DKBA_HARD_RF_N_rf_AXIS 100.000000 F00068 4 0.000000 2.000000 /end AXIS_PTS
/begin RECORD_LAYOUT KF_DKBA_HARD_RF_N_rf_AXIS FIX_NO_AXIS_PTS_X 4 AXIS_PTS_X 0 UWORD INDEX_INCR DIRECT /end RECORD_LAYOUT
/begin AXIS_PTS KF_DKBA_HARD_RF_N_n_AXIS "-" 0x55A4 n KF_DKBA_HARD_RF_N_n_AXIS 100.000000 F00007 4 0.000000 10000.000000 /end AXIS_PTS
/begin RECORD_LAYOUT KF_DKBA_HARD_RF_N_n_AXIS FIX_NO_AXIS_PTS_Y 4 AXIS_PTS_Y 0 UWORD INDEX_INCR DIRECT /end RECORD_LAYOUT
/begin CHARACTERISTIC KF_RF_N_AQ_REL "-" MAP 0x560A VALUE_KF_RF_N_AQ_REL 100.000000 F00068 0.000000 2.000000
 /begin AXIS_DESCR COM_AXIS n F00007 18 0.000000 10000.000000 AXIS_PTS_REF KF_RF_N_AQ_REL_n_AXIS /end AXIS_DESCR
 /begin AXIS_DESCR COM_AXIS aq_rel F00290 12 0.000000 120.000000 AXIS_PTS_REF KF_RF_N_AQ_REL_aq_rel_AXIS /end AXIS_DESCR
 FUNCTION_LIST DKBA /end CHARACTERISTIC
/begin RECORD_LAYOUT VALUE_KF_RF_N_AQ_REL FNC_VALUES 0 UWORD ROW_DIR DIRECT /end RECORD_LAYOUT
/begin AXIS_PTS KF_RF_N_AQ_REL_n_AXIS "-" 0x55CE n KF_RF_N_AQ_REL_n_AXIS 100.000000 F00007 18 0.000000 10000.000000 /end AXIS_PTS
/begin RECORD_LAYOUT KF_RF_N_AQ_REL_n_AXIS FIX_NO_AXIS_PTS_X 18 AXIS_PTS_X 0 UWORD INDEX_INCR DIRECT /end RECORD_LAYOUT
/begin AXIS_PTS KF_RF_N_AQ_REL_aq_rel_AXIS "-" 0x55F2 aq_rel KF_RF_N_AQ_REL_aq_rel_AXIS 100.000000 F00290 12 0.000000 120.000000 /end AXIS_PTS
/begin RECORD_LAYOUT KF_RF_N_AQ_REL_aq_rel_AXIS FIX_NO_AXIS_PTS_Y 12 AXIS_PTS_Y 0 UWORD INDEX_INCR DIRECT /end RECORD_LAYOUT
/begin CHARACTERISTIC KL_EKP_UB_KORR "-" CURVE 0x708C VALUE_KL_EKP_UB_KORR 100.000000 F00056 0.000000 1.000000
 /begin AXIS_DESCR COM_AXIS ub F00018 4 0.000000 20.000000 AXIS_PTS_REF KL_EKP_UB_KORR_ub_AXIS /end AXIS_DESCR
 FUNCTION_LIST Kraftstoffpumpe /end CHARACTERISTIC
/begin RECORD_LAYOUT VALUE_KL_EKP_UB_KORR FNC_VALUES 0 UBYTE ROW_DIR DIRECT /end RECORD_LAYOUT
/begin AXIS_PTS KL_EKP_UB_KORR_ub_AXIS "-" 0x7088 ub KL_EKP_UB_KORR_ub_AXIS 100.000000 F00018 4 0.000000 20.000000 /end AXIS_PTS
/begin RECORD_LAYOUT KL_EKP_UB_KORR_ub_AXIS FIX_NO_AXIS_PTS_X 4 AXIS_PTS_X 0 UBYTE INDEX_INCR DIRECT /end RECORD_LAYOUT
/begin CHARACTERISTIC KF_EKP_TV "-" MAP 0x7066 VALUE_KF_EKP_TV 100.000000 F00191 0.000000 100.000000
 /begin AXIS_DESCR COM_AXIS n F00007 4 0.000000 10000.000000 AXIS_PTS_REF KF_EKP_TV_n_AXIS /end AXIS_DESCR
 /begin AXIS_DESCR COM_AXIS ml F00095 4 0.000000 1400.000000 AXIS_PTS_REF KF_EKP_TV_ml_AXIS /end AXIS_DESCR
 FUNCTION_LIST Kraftstoffpumpe /end CHARACTERISTIC
/begin RECORD_LAYOUT VALUE_KF_EKP_TV FNC_VALUES 0 UWORD ROW_DIR DIRECT /end RECORD_LAYOUT
/begin AXIS_PTS KF_EKP_TV_n_AXIS "-" 0x7056 n KF_EKP_TV_n_AXIS 100.000000 F00007 4 0.000000 10000.000000 /end AXIS_PTS
/begin RECORD_LAYOUT KF_EKP_TV_n_AXIS FIX_NO_AXIS_PTS_X 4 AXIS_PTS_X 0 UWORD INDEX_INCR DIRECT /end RECORD_LAYOUT
/begin AXIS_PTS KF_EKP_TV_ml_AXIS "-" 0x705E ml KF_EKP_TV_ml_AXIS 100.000000 F00095 4 0.000000 1400.000000 /end AXIS_PTS
/begin RECORD_LAYOUT KF_EKP_TV_ml_AXIS FIX_NO_AXIS_PTS_Y 4 AXIS_PTS_Y 0 UWORD INDEX_INCR DIRECT /end RECORD_LAYOUT
/begin CHARACTERISTIC KL_ELU_TKA "-" CURVE 0x7034 VALUE_KL_ELU_TKA 100.000000 F00093 0.000000 255.000000
 /begin AXIS_DESCR /* tka */ COM_AXIS tka F00014 6 -48.000000 207.000000 AXIS_PTS_REF KL_ELU_TKA_tka_AXIS /end AXIS_DESCR
 FUNCTION_LIST Elektroluefter /end CHARACTERISTIC
/begin RECORD_LAYOUT VALUE_KL_ELU_TKA FNC_VALUES 0 UBYTE ROW_DIR DIRECT /end RECORD_LAYOUT
/begin AXIS_PTS KL_ELU_TKA_tka_AXIS "-" 0x702E tka KL_ELU_TKA_tka_AXIS 100.000000 F00014 6 -48.000000 207.000000 /end AXIS_PTS
/begin RECORD_LAYOUT KL_ELU_TKA_tka_AXIS FIX_NO_AXIS_PTS_X 6 AXIS_PTS_X 0 UBYTE INDEX_INCR DIRECT /end RECORD_LAYOUT
/begin CHARACTERISTIC KL_ELU_V "-" CURVE 0x7042 VALUE_KL_ELU_V 100.000000 F00056 0.000000 1.000000
 /begin AXIS_DESCR COM_AXIS v F00004 6 0.000000 255.000000 AXIS_PTS_REF KL_ELU_V_v_AXIS /end AXIS_DESCR
 FUNCTION_LIST Elektroluefter /end CHARACTERISTIC
/begin RECORD_LAYOUT VALUE_KL_ELU_V FNC_VALUES 0 UBYTE ROW_DIR DIRECT /end RECORD_LAYOUT
/begin AXIS_PTS KL_ELU_V_v_AXIS "-" 0x703C v KL_ELU_V_v_AXIS 100.000000 F00004 6 0.000000 255.000000 /end AXIS_PTS
/begin RECORD_LAYOUT KL_ELU_V_v_AXIS FIX_NO_AXIS_PTS_X 6 AXIS_PTS_X 0 UBYTE INDEX_INCR DIRECT /end RECORD_LAYOUT
/begin CHARACTERISTIC KL_EVAN1_TOEL_KP "-" CURVE 0x4E82 VALUE_KL_EVAN1_TOEL_KP 100.000000 F00289 0.000000 16.000000
 /begin AXIS_DESCR COM_AXIS toel F00014 8 -48.000000 207.000000 AXIS_PTS_REF KL_EVAN1_TOEL_KP_toel_AXIS /end AXIS_DESCR
 FUNCTION_LIST Vanos /end CHARACTERISTIC
/begin RECORD_LAYOUT VALUE_KL_EVAN1_TOEL_KP FNC_VALUES 0 UBYTE ROW_DIR DIRECT /end RECORD_LAYOUT
/begin AXIS_PTS KL_EVAN1_TOEL_KP_toel_AXIS "-" 0x4E7A toel KL_EVAN1_TOEL_KP_toel_AXIS 100.000000 F00014 8 -48.000000 207.000000 /end AXIS_PTS
/begin RECORD_LAYOUT KL_EVAN1_TOEL_KP_toel_AXIS FIX_NO_AXIS_PTS_X 8 AXIS_PTS_X 0 UBYTE INDEX_INCR DIRECT /end RECORD_LAYOUT
/begin CHARACTERISTIC KL_EVAN1_SOLL_NOISE "-" CURVE 0x4E91 VALUE_KL_EVAN1_SOLL_NOISE 100.000000 F00011 -20.000000 80.000000
 /begin AXIS_DESCR COM_AXIS n40 F00109 5 0.000000 10000.000000 AXIS_PTS_REF KL_EVAN1_SOLL_NOISE_n40_AXIS /end AXIS_DESCR
 FUNCTION_LIST Vanos /end CHARACTERISTIC
/begin RECORD_LAYOUT VALUE_KL_EVAN1_SOLL_NOISE FNC_VALUES 0 SBYTE ROW_DIR DIRECT /end RECORD_LAYOUT
/begin AXIS_PTS KL_EVAN1_SOLL_NOISE_n40_AXIS "-" 0x4E8C n40 KL_EVAN1_SOLL_NOISE_n40_AXIS 100.000000 F00109 5 0.000000 10000.000000 /end AXIS_PTS
/begin RECORD_LAYOUT KL_EVAN1_SOLL_NOISE_n40_AXIS FIX_NO_AXIS_PTS_X 5 AXIS_PTS_X 0 UBYTE INDEX_INCR DIRECT /end RECORD_LAYOUT
/begin CHARACTERISTIC KL_EVAN_SOLL_BEGR "-" CURVE 0x4EA2 VALUE_KL_EVAN_SOLL_BEGR 100.000000 F00006 -20.000000 80.000000
 /begin AXIS_DESCR COM_AXIS n F00007 5 0.000000 10000.000000 AXIS_PTS_REF KL_EVAN_SOLL_BEGR_n_AXIS /end AXIS_DESCR
 FUNCTION_LIST Vanos /end CHARACTERISTIC
/begin RECORD_LAYOUT VALUE_KL_EVAN_SOLL_BEGR FNC_VALUES 0 SWORD ROW_DIR DIRECT /end RECORD_LAYOUT
/begin AXIS_PTS KL_EVAN_SOLL_BEGR_n_AXIS "-" 0x4E98 n KL_EVAN_SOLL_BEGR_n_AXIS 100.000000 F00007 5 0.000000 10000.000000 /end AXIS_PTS
/begin RECORD_LAYOUT KL_EVAN_SOLL_BEGR_n_AXIS FIX_NO_AXIS_PTS_X 5 AXIS_PTS_X 0 UWORD INDEX_INCR DIRECT /end RECORD_LAYOUT
/begin CHARACTERISTIC KL_VAN_KATH_TMOT "-" CURVE 0x4EC2 VALUE_KL_VAN_KATH_TMOT 100.000000 F00017 0.000000 3600.000000
 /begin AXIS_DESCR COM_AXIS tmot F00014 10 -48.000000 207.000000 AXIS_PTS_REF KL_VAN_KATH_TMOT_tmot_AXIS /end AXIS_DESCR
 FUNCTION_LIST Vanos /end CHARACTERISTIC
/begin RECORD_LAYOUT VALUE_KL_VAN_KATH_TMOT FNC_VALUES 0 UWORD ROW_DIR DIRECT /end RECORD_LAYOUT
/begin AXIS_PTS KL_VAN_KATH_TMOT_tmot_AXIS "-" 0x4EAE tmot KL_VAN_KATH_TMOT_tmot_AXIS 100.000000 F00014 10 -48.000000 207.000000 /end AXIS_PTS
/begin RECORD_LAYOUT KL_VAN_KATH_TMOT_tmot_AXIS FIX_NO_AXIS_PTS_X 10 AXIS_PTS_X 0 UWORD INDEX_INCR DIRECT /end RECORD_LAYOUT
/begin CHARACTERISTIC KL_EVAN_BEGR_DAUER "-" CURVE 0x4EE4 VALUE_KL_EVAN_BEGR_DAUER 100.000000 F00027 0.000000 655.000000
 /begin AXIS_DESCR COM_AXIS tan F00014 6 -48.000000 207.000000 AXIS_PTS_REF KL_EVAN_BEGR_DAUER_tan_AXIS /end AXIS_DESCR
 FUNCTION_LIST Vanos /end CHARACTERISTIC
/begin RECORD_LAYOUT VALUE_KL_EVAN_BEGR_DAUER FNC_VALUES 0 UWORD ROW_DIR DIRECT /end RECORD_LAYOUT
/begin AXIS_PTS KL_EVAN_BEGR_DAUER_tan_AXIS "-" 0x4ED8 tan KL_EVAN_BEGR_DAUER_tan_AXIS 100.000000 F00014 6 -48.000000 207.000000 /end AXIS_PTS
/begin RECORD_LAYOUT KL_EVAN_BEGR_DAUER_tan_AXIS FIX_NO_AXIS_PTS_X 6 AXIS_PTS_X 0 UWORD INDEX_INCR DIRECT /end RECORD_LAYOUT
/begin CHARACTERISTIC KL_VAN_VENTIL_UB "-" CURVE 0x4EF7 VALUE_KL_VAN_VENTIL_UB 100.000000 F00301 0.000000 1.000000
 /begin AXIS_DESCR COM_AXIS ub F00018 5 0.000000 20.000000 AXIS_PTS_REF KL_VAN_VENTIL_UB_ub_AXIS /end AXIS_DESCR
 FUNCTION_LIST Vanos /end CHARACTERISTIC
/begin RECORD_LAYOUT VALUE_KL_VAN_VENTIL_UB FNC_VALUES 0 UBYTE ROW_DIR DIRECT /end RECORD_LAYOUT
/begin AXIS_PTS KL_VAN_VENTIL_UB_ub_AXIS "-" 0x4EF2 ub KL_VAN_VENTIL_UB_ub_AXIS 100.000000 F00018 5 0.000000 20.000000 /end AXIS_PTS
/begin RECORD_LAYOUT KL_VAN_VENTIL_UB_ub_AXIS FIX_NO_AXIS_PTS_X 5 AXIS_PTS_X 0 UBYTE INDEX_INCR DIRECT /end RECORD_LAYOUT
/begin CHARACTERISTIC KL_EVAN_T_DRUCK "-" CURVE 0x4F01 VALUE_KL_EVAN_T_DRUCK 100.000000 F00302 0.000000 510.000000
 /begin AXIS_DESCR COM_AXIS tmot_start F00014 3 -48.000000 207.000000 AXIS_PTS_REF KL_EVAN_T_DRUCK_tmot_start_AXIS /end AXIS_DESCR
 FUNCTION_LIST Vanos /end CHARACTERISTIC
/begin RECORD_LAYOUT VALUE_KL_EVAN_T_DRUCK FNC_VALUES 0 UBYTE ROW_DIR DIRECT /end RECORD_LAYOUT
/begin AXIS_PTS KL_EVAN_T_DRUCK_tmot_start_AXIS "-" 0x4EFE tmot_start KL_EVAN_T_DRUCK_tmot_start_AXIS 100.000000 F00014 3 -48.000000 207.000000 /end AXIS_PTS
/begin RECORD_LAYOUT KL_EVAN_T_DRUCK_tmot_start_AXIS FIX_NO_AXIS_PTS_X 3 AXIS_PTS_X 0 UBYTE INDEX_INCR DIRECT /end RECORD_LAYOUT
/begin CHARACTERISTIC KF_EVAN1_SOLL "-" MAP 0x4F46 VALUE_KF_EVAN1_SOLL 100.000000 F00011 -20.000000 80.000000
 /begin AXIS_DESCR COM_AXIS n F00007 16 0.000000 10000.000000 AXIS_PTS_REF KF_EVAN1_SOLL_n_AXIS /end AXIS_DESCR
 /begin AXIS_DESCR COM_AXIS aq_rel F00290 16 0.000000 120.000000 AXIS_PTS_REF KF_EVAN1_SOLL_aq_rel_AXIS /end AXIS_DESCR
 FUNCTION_LIST Vanos /end CHARACTERISTIC
/begin RECORD_LAYOUT VALUE_KF_EVAN1_SOLL FNC_VALUES 0 SBYTE ROW_DIR DIRECT /end RECORD_LAYOUT
/begin AXIS_PTS KF_EVAN1_SOLL_n_AXIS "-" 0x4F06 n KF_EVAN1_SOLL_n_AXIS 100.000000 F00007 16 0.000000 10000.000000 /end AXIS_PTS
/begin RECORD_LAYOUT KF_EVAN1_SOLL_n_AXIS FIX_NO_AXIS_PTS_X 16 AXIS_PTS_X 0 UWORD INDEX_INCR DIRECT /end RECORD_LAYOUT
/begin AXIS_PTS KF_EVAN1_SOLL_aq_rel_AXIS "-" 0x4F26 aq_rel KF_EVAN1_SOLL_aq_rel_AXIS 100.000000 F00290 16 0.000000 120.000000 /end AXIS_PTS
/begin RECORD_LAYOUT KF_EVAN1_SOLL_aq_rel_AXIS FIX_NO_AXIS_PTS_Y 16 AXIS_PTS_Y 0 UWORD INDEX_INCR DIRECT /end RECORD_LAYOUT
/begin CHARACTERISTIC KF_EVAN1_SOLL_KATH "-" MAP 0x5088 VALUE_KF_EVAN1_SOLL_KATH 100.000000 F00011 -20.000000 80.000000
 /begin AXIS_DESCR COM_AXIS n F00007 16 0.000000 10000.000000 AXIS_PTS_REF KF_EVAN1_SOLL_KATH_n_AXIS /end AXIS_DESCR
 /begin AXIS_DESCR COM_AXIS aq_rel F00290 16 0.000000 120.000000 AXIS_PTS_REF KF_EVAN1_SOLL_KATH_aq_rel_AXIS /end AXIS_DESCR
 FUNCTION_LIST Vanos /end CHARACTERISTIC
/begin RECORD_LAYOUT VALUE_KF_EVAN1_SOLL_KATH FNC_VALUES 0 SBYTE ROW_DIR DIRECT /end RECORD_LAYOUT
/begin AXIS_PTS KF_EVAN1_SOLL_KATH_n_AXIS "-" 0x5048 n KF_EVAN1_SOLL_KATH_n_AXIS 100.000000 F00007 16 0.000000 10000.000000 /end AXIS_PTS
/begin RECORD_LAYOUT KF_EVAN1_SOLL_KATH_n_AXIS FIX_NO_AXIS_PTS_X 16 AXIS_PTS_X 0 UWORD INDEX_INCR DIRECT /end RECORD_LAYOUT
/begin AXIS_PTS KF_EVAN1_SOLL_KATH_aq_rel_AXIS "-" 0x5068 aq_rel KF_EVAN1_SOLL_KATH_aq_rel_AXIS 100.000000 F00290 16 0.000000 120.000000 /end AXIS_PTS
/begin RECORD_LAYOUT KF_EVAN1_SOLL_KATH_aq_rel_AXIS FIX_NO_AXIS_PTS_Y 16 AXIS_PTS_Y 0 UWORD INDEX_INCR DIRECT /end RECORD_LAYOUT
/begin CHARACTERISTIC KF_EVAN1_SOLL_DMAX "-" MAP 0x51A2 VALUE_KF_EVAN1_SOLL_DMAX 100.000000 F00291 -20.000000 80.000000
 /begin AXIS_DESCR COM_AXIS n F00007 6 0.000000 10000.000000 AXIS_PTS_REF KF_EVAN1_SOLL_DMAX_n_AXIS /end AXIS_DESCR
 /begin AXIS_DESCR COM_AXIS aq_rel F00290 6 0.000000 120.000000 AXIS_PTS_REF KF_EVAN1_SOLL_DMAX_aq_rel_AXIS /end AXIS_DESCR
 FUNCTION_LIST Vanos /end CHARACTERISTIC
/begin RECORD_LAYOUT VALUE_KF_EVAN1_SOLL_DMAX FNC_VALUES 0 SWORD ROW_DIR DIRECT /end RECORD_LAYOUT
/begin AXIS_PTS KF_EVAN1_SOLL_DMAX_n_AXIS "-" 0x518A n KF_EVAN1_SOLL_DMAX_n_AXIS 100.000000 F00007 6 0.000000 10000.000000 /end AXIS_PTS
/begin RECORD_LAYOUT KF_EVAN1_SOLL_DMAX_n_AXIS FIX_NO_AXIS_PTS_X 6 AXIS_PTS_X 0 UWORD INDEX_INCR DIRECT /end RECORD_LAYOUT
/begin AXIS_PTS KF_EVAN1_SOLL_DMAX_aq_rel_AXIS "-" 0x5196 aq_rel KF_EVAN1_SOLL_DMAX_aq_rel_AXIS 100.000000 F00290 6 0.000000 120.000000 /end AXIS_PTS
/begin RECORD_LAYOUT KF_EVAN1_SOLL_DMAX_aq_rel_AXIS FIX_NO_AXIS_PTS_Y 6 AXIS_PTS_Y 0 UWORD INDEX_INCR DIRECT /end RECORD_LAYOUT
/begin CHARACTERISTIC KL_LA_N "-" CURVE 0x71B6 VALUE_KL_LA_N 100.000000 F00068 0.000000 2.000000
 /begin AXIS_DESCR COM_AXIS n F00007 7 0.000000 10000.000000 AXIS_PTS_REF KL_LA_N_n_AXIS /end AXIS_DESCR
 FUNCTION_LIST Lambda /end CHARACTERISTIC
/begin RECORD_LAYOUT VALUE_KL_LA_N FNC_VALUES 0 UWORD ROW_DIR DIRECT /end RECORD_LAYOUT
/begin AXIS_PTS KL_LA_N_n_AXIS "-" 0x71A8 n KL_LA_N_n_AXIS 100.000000 F00007 7 0.000000 10000.000000 /end AXIS_PTS
/begin RECORD_LAYOUT KL_LA_N_n_AXIS FIX_NO_AXIS_PTS_X 7 AXIS_PTS_X 0 UWORD INDEX_INCR DIRECT /end RECORD_LAYOUT
/begin CHARACTERISTIC KL_LA_RESET_TAN "-" CURVE 0x71CE VALUE_KL_LA_RESET_TAN 100.000000 F00100 0.000000 1.000000
 /begin AXIS_DESCR COM_AXIS tan F00014 4 -48.000000 207.000000 AXIS_PTS_REF KL_LA_RESET_TAN_tan_AXIS /end AXIS_DESCR
 FUNCTION_LIST Lambda /end CHARACTERISTIC
/begin RECORD_LAYOUT VALUE_KL_LA_RESET_TAN FNC_VALUES 0 UWORD ROW_DIR DIRECT /end RECORD_LAYOUT
/begin AXIS_PTS KL_LA_RESET_TAN_tan_AXIS "-" 0x71C6 tan KL_LA_RESET_TAN_tan_AXIS 100.000000 F00014 4 -48.000000 207.000000 /end AXIS_PTS
/begin RECORD_LAYOUT KL_LA_RESET_TAN_tan_AXIS FIX_NO_AXIS_PTS_X 4 AXIS_PTS_X 0 UWORD INDEX_INCR DIRECT /end RECORD_LAYOUT
/begin CHARACTERISTIC KL_LAA_N "-" CURVE 0x71E2 VALUE_KL_LAA_N 100.000000 F00068 0.000000 2.000000
 /begin AXIS_DESCR COM_AXIS n F00007 5 0.000000 10000.000000 AXIS_PTS_REF KL_LAA_N_n_AXIS /end AXIS_DESCR
 FUNCTION_LIST Lambda /end CHARACTERISTIC
/begin RECORD_LAYOUT VALUE_KL_LAA_N FNC_VALUES 0 UWORD ROW_DIR DIRECT /end RECORD_LAYOUT
/begin AXIS_PTS KL_LAA_N_n_AXIS "-" 0x71D8 n KL_LAA_N_n_AXIS 100.000000 F00007 5 0.000000 10000.000000 /end AXIS_PTS
/begin RECORD_LAYOUT KL_LAA_N_n_AXIS FIX_NO_AXIS_PTS_X 5 AXIS_PTS_X 0 UWORD INDEX_INCR DIRECT /end RECORD_LAYOUT
/begin CHARACTERISTIC KL_LA_TV_OF_KS_TML "-" CURVE 0x71F6 VALUE_KL_LA_TV_OF_KS_TML 100.000000 F00305 -1280.000000 1270.000000
 /begin AXIS_DESCR COM_AXIS t_ml F00017 4 0.000000 65535.000000 AXIS_PTS_REF KL_LA_TV_OF_KS_TML_t_ml_AXIS /end AXIS_DESCR
 FUNCTION_LIST Lambda /end CHARACTERISTIC
/begin RECORD_LAYOUT VALUE_KL_LA_TV_OF_KS_TML FNC_VALUES 0 SWORD ROW_DIR DIRECT /end RECORD_LAYOUT
/begin AXIS_PTS KL_LA_TV_OF_KS_TML_t_ml_AXIS "-" 0x71EE t_ml KL_LA_TV_OF_KS_TML_t_ml_AXIS 100.000000 F00017 4 0.000000 65535.000000 /end AXIS_PTS
/begin RECORD_LAYOUT KL_LA_TV_OF_KS_TML_t_ml_AXIS FIX_NO_AXIS_PTS_X 4 AXIS_PTS_X 0 UWORD INDEX_INCR DIRECT /end RECORD_LAYOUT
/begin CHARACTERISTIC KL_KSD_T_MOT "-" CURVE 0x7206 VALUE_KL_KSD_T_MOT 100.000000 F00310 0.000000 524.000000
 /begin AXIS_DESCR COM_AXIS tmot_start F00303 3 -48.000000 207.000000 AXIS_PTS_REF KL_KSD_T_MOT_tmot_start_AXIS /end AXIS_DESCR
 FUNCTION_LIST Lambda /end CHARACTERISTIC
/begin RECORD_LAYOUT VALUE_KL_KSD_T_MOT FNC_VALUES 0 UWORD ROW_DIR DIRECT /end RECORD_LAYOUT
/begin AXIS_PTS KL_KSD_T_MOT_tmot_start_AXIS "-" 0x7200 tmot_start KL_KSD_T_MOT_tmot_start_AXIS 100.000000 F00303 3 -48.000000 207.000000 /end AXIS_PTS
/begin RECORD_LAYOUT KL_KSD_T_MOT_tmot_start_AXIS FIX_NO_AXIS_PTS_X 3 AXIS_PTS_X 0 UWORD INDEX_INCR DIRECT /end RECORD_LAYOUT
/begin CHARACTERISTIC KL_KSD_OEL_INC "-" CURVE 0x7212 VALUE_KL_KSD_OEL_INC 100.000000 F00013 0.000000 255.000000
 /begin AXIS_DESCR COM_AXIS tmot_start F00014 4 -48.000000 207.000000 AXIS_PTS_REF KL_KSD_OEL_INC_tmot_start_AXIS /end AXIS_DESCR
 FUNCTION_LIST Lambda /end CHARACTERISTIC
/begin RECORD_LAYOUT VALUE_KL_KSD_OEL_INC FNC_VALUES 0 UBYTE ROW_DIR DIRECT /end RECORD_LAYOUT
/begin AXIS_PTS KL_KSD_OEL_INC_tmot_start_AXIS "-" 0x720E tmot_start KL_KSD_OEL_INC_tmot_start_AXIS 100.000000 F00014 4 -48.000000 207.000000 /end AXIS_PTS
/begin RECORD_LAYOUT KL_KSD_OEL_INC_tmot_start_AXIS FIX_NO_AXIS_PTS_X 4 AXIS_PTS_X 0 UBYTE INDEX_INCR DIRECT /end RECORD_LAYOUT
/begin CHARACTERISTIC KL_KSD_OEL_DEC "-" CURVE 0x721C VALUE_KL_KSD_OEL_DEC 100.000000 F00013 0.000000 255.000000
 /begin AXIS_DESCR /* toel_max */ COM_AXIS toel_max F00303 4 -48.000000 180.000000 AXIS_PTS_REF KL_KSD_OEL_DEC_toel_max_AXIS /end AXIS_DESCR
 FUNCTION_LIST Lambda /end CHARACTERISTIC
/begin RECORD_LAYOUT VALUE_KL_KSD_OEL_DEC FNC_VALUES 0 UBYTE ROW_DIR DIRECT /end RECORD_LAYOUT
/begin AXIS_PTS KL_KSD_OEL_DEC_toel_max_AXIS "-" 0x7218 toel_max KL_KSD_OEL_DEC_toel_max_AXIS 100.000000 F00303 4 -48.000000 180.000000 /end AXIS_PTS
/begin RECORD_LAYOUT KL_KSD_OEL_DEC_toel_max_AXIS FIX_NO_AXIS_PTS_X 4 AXIS_PTS_X 0 UBYTE INDEX_INCR DIRECT /end RECORD_LAYOUT
/begin CHARACTERISTIC KL_LA_TV_OF_HS_TML "-" CURVE 0x722A VALUE_KL_LA_TV_OF_HS_TML 100.000000 F00305 -1280.000000 1270.000000
 /begin AXIS_DESCR COM_AXIS t_ml F00017 4 0.000000 65535.000000 AXIS_PTS_REF KL_LA_TV_OF_HS_TML_t_ml_AXIS /end AXIS_DESCR
 FUNCTION_LIST Lambda /end CHARACTERISTIC
/begin RECORD_LAYOUT VALUE_KL_LA_TV_OF_HS_TML FNC_VALUES 0 SWORD ROW_DIR DIRECT /end RECORD_LAYOUT
/begin AXIS_PTS KL_LA_TV_OF_HS_TML_t_ml_AXIS "-" 0x7222 t_ml KL_LA_TV_OF_HS_TML_t_ml_AXIS 100.000000 F00017 4 0.000000 65535.000000 /end AXIS_PTS
/begin RECORD_LAYOUT KL_LA_TV_OF_HS_TML_t_ml_AXIS FIX_NO_AXIS_PTS_X 4 AXIS_PTS_X 0 UWORD INDEX_INCR DIRECT /end RECORD_LAYOUT
/begin CHARACTERISTIC KF_LA_KP_POS "-" MAP 0x7248 VALUE_KF_LA_KP_POS 100.000000 F00311 0.000000 0.000000
 /begin AXIS_DESCR COM_AXIS n F00007 5 0.000000 10000.000000 AXIS_PTS_REF KF_LA_KP_POS_n_AXIS /end AXIS_DESCR
 /begin AXIS_DESCR COM_AXIS rf F00068 5 0.000000 2.000000 AXIS_PTS_REF KF_LA_KP_POS_rf_AXIS /end AXIS_DESCR
 FUNCTION_LIST Lambda /end CHARACTERISTIC
/begin RECORD_LAYOUT VALUE_KF_LA_KP_POS FNC_VALUES 0 UBYTE ROW_DIR DIRECT /end RECORD_LAYOUT
/begin AXIS_PTS KF_LA_KP_POS_n_AXIS "-" 0x7234 n KF_LA_KP_POS_n_AXIS 100.000000 F00007 5 0.000000 10000.000000 /end AXIS_PTS
/begin RECORD_LAYOUT KF_LA_KP_POS_n_AXIS FIX_NO_AXIS_PTS_X 5 AXIS_PTS_X 0 UWORD INDEX_INCR DIRECT /end RECORD_LAYOUT
/begin AXIS_PTS KF_LA_KP_POS_rf_AXIS "-" 0x723E rf KF_LA_KP_POS_rf_AXIS 100.000000 F00068 5 0.000000 2.000000 /end AXIS_PTS
/begin RECORD_LAYOUT KF_LA_KP_POS_rf_AXIS FIX_NO_AXIS_PTS_Y 5 AXIS_PTS_Y 0 UWORD INDEX_INCR DIRECT /end RECORD_LAYOUT
/begin CHARACTERISTIC KF_LA_KP_NEG "-" MAP 0x7278 VALUE_KF_LA_KP_NEG 100.000000 F00311 0.000000 0.000000
 /begin AXIS_DESCR COM_AXIS n F00007 5 0.000000 10000.000000 AXIS_PTS_REF KF_LA_KP_NEG_n_AXIS /end AXIS_DESCR
 /begin AXIS_DESCR COM_AXIS rf F00068 5 0.000000 2.000000 AXIS_PTS_REF KF_LA_KP_NEG_rf_AXIS /end AXIS_DESCR
 FUNCTION_LIST Lambda /end CHARACTERISTIC
/begin RECORD_LAYOUT VALUE_KF_LA_KP_NEG FNC_VALUES 0 UBYTE ROW_DIR DIRECT /end RECORD_LAYOUT
/begin AXIS_PTS KF_LA_KP_NEG_n_AXIS "-" 0x7264 n KF_LA_KP_NEG_n_AXIS 100.000000 F00007 5 0.000000 10000.000000 /end AXIS_PTS
/begin RECORD_LAYOUT KF_LA_KP_NEG_n_AXIS FIX_NO_AXIS_PTS_X 5 AXIS_PTS_X 0 UWORD INDEX_INCR DIRECT /end RECORD_LAYOUT
/begin AXIS_PTS KF_LA_KP_NEG_rf_AXIS "-" 0x726E rf KF_LA_KP_NEG_rf_AXIS 100.000000 F00068 5 0.000000 2.000000 /end AXIS_PTS
/begin RECORD_LAYOUT KF_LA_KP_NEG_rf_AXIS FIX_NO_AXIS_PTS_Y 5 AXIS_PTS_Y 0 UWORD INDEX_INCR DIRECT /end RECORD_LAYOUT
/begin CHARACTERISTIC KF_LA_KI_POS "-" MAP 0x72A8 VALUE_KF_LA_KI_POS 100.000000 F00312 0.000000 0.000000
 /begin AXIS_DESCR COM_AXIS n F00007 5 0.000000 10000.000000 AXIS_PTS_REF KF_LA_KI_POS_n_AXIS /end AXIS_DESCR
 /begin AXIS_DESCR COM_AXIS rf F00068 5 0.000000 2.000000 AXIS_PTS_REF KF_LA_KI_POS_rf_AXIS /end AXIS_DESCR
 FUNCTION_LIST Lambda /end CHARACTERISTIC
/begin RECORD_LAYOUT VALUE_KF_LA_KI_POS FNC_VALUES 0 UBYTE ROW_DIR DIRECT /end RECORD_LAYOUT
/begin AXIS_PTS KF_LA_KI_POS_n_AXIS "-" 0x7294 n KF_LA_KI_POS_n_AXIS 100.000000 F00007 5 0.000000 10000.000000 /end AXIS_PTS
/begin RECORD_LAYOUT KF_LA_KI_POS_n_AXIS FIX_NO_AXIS_PTS_X 5 AXIS_PTS_X 0 UWORD INDEX_INCR DIRECT /end RECORD_LAYOUT
/begin AXIS_PTS KF_LA_KI_POS_rf_AXIS "-" 0x729E rf KF_LA_KI_POS_rf_AXIS 100.000000 F00068 5 0.000000 2.000000 /end AXIS_PTS
/begin RECORD_LAYOUT KF_LA_KI_POS_rf_AXIS FIX_NO_AXIS_PTS_Y 5 AXIS_PTS_Y 0 UWORD INDEX_INCR DIRECT /end RECORD_LAYOUT
/begin CHARACTERISTIC KF_LA_KI_NEG "-" MAP 0x72D8 VALUE_KF_LA_KI_NEG 100.000000 F00312 0.000000 0.000000
 /begin AXIS_DESCR COM_AXIS n F00007 5 0.000000 10000.000000 AXIS_PTS_REF KF_LA_KI_NEG_n_AXIS /end AXIS_DESCR
 /begin AXIS_DESCR COM_AXIS rf F00068 5 0.000000 2.000000 AXIS_PTS_REF KF_LA_KI_NEG_rf_AXIS /end AXIS_DESCR
 FUNCTION_LIST Lambda /end CHARACTERISTIC
/begin RECORD_LAYOUT VALUE_KF_LA_KI_NEG FNC_VALUES 0 UBYTE ROW_DIR DIRECT /end RECORD_LAYOUT
/begin AXIS_PTS KF_LA_KI_NEG_n_AXIS "-" 0x72C4 n KF_LA_KI_NEG_n_AXIS 100.000000 F00007 5 0.000000 10000.000000 /end AXIS_PTS
/begin RECORD_LAYOUT KF_LA_KI_NEG_n_AXIS FIX_NO_AXIS_PTS_X 5 AXIS_PTS_X 0 UWORD INDEX_INCR DIRECT /end RECORD_LAYOUT
/begin AXIS_PTS KF_LA_KI_NEG_rf_AXIS "-" 0x72CE rf KF_LA_KI_NEG_rf_AXIS 100.000000 F00068 5 0.000000 2.000000 /end AXIS_PTS
/begin RECORD_LAYOUT KF_LA_KI_NEG_rf_AXIS FIX_NO_AXIS_PTS_Y 5 AXIS_PTS_Y 0 UWORD INDEX_INCR DIRECT /end RECORD_LAYOUT
/begin CHARACTERISTIC KF_LA_TV "-" MAP 0x7308 VALUE_KF_LA_TV 100.000000 F00305 -1280.000000 1270.000000
 /begin AXIS_DESCR COM_AXIS n F00007 5 0.000000 10000.000000 AXIS_PTS_REF KF_LA_TV_n_AXIS /end AXIS_DESCR
 /begin AXIS_DESCR COM_AXIS rf F00068 5 0.000000 2.000000 AXIS_PTS_REF KF_LA_TV_rf_AXIS /end AXIS_DESCR
 FUNCTION_LIST Lambda /end CHARACTERISTIC
/begin RECORD_LAYOUT VALUE_KF_LA_TV FNC_VALUES 0 SBYTE ROW_DIR DIRECT /end RECORD_LAYOUT
/begin AXIS_PTS KF_LA_TV_n_AXIS "-" 0x72F4 n KF_LA_TV_n_AXIS 100.000000 F00007 5 0.000000 10000.000000 /end AXIS_PTS
/begin RECORD_LAYOUT KF_LA_TV_n_AXIS FIX_NO_AXIS_PTS_X 5 AXIS_PTS_X 0 UWORD INDEX_INCR DIRECT /end RECORD_LAYOUT
/begin AXIS_PTS KF_LA_TV_rf_AXIS "-" 0x72FE rf KF_LA_TV_rf_AXIS 100.000000 F00068 5 0.000000 2.000000 /end AXIS_PTS
/begin RECORD_LAYOUT KF_LA_TV_rf_AXIS FIX_NO_AXIS_PTS_Y 5 AXIS_PTS_Y 0 UWORD INDEX_INCR DIRECT /end RECORD_LAYOUT
/begin CHARACTERISTIC KF_LASV_TAU "-" MAP 0x7334 VALUE_KF_LASV_TAU 100.000000 F00305 0.000000 655350.000000
 /begin AXIS_DESCR COM_AXIS n F00007 4 0.000000 10000.000000 AXIS_PTS_REF KF_LASV_TAU_n_AXIS /end AXIS_DESCR
 /begin AXIS_DESCR COM_AXIS rf F00068 4 0.000000 2.000000 AXIS_PTS_REF KF_LASV_TAU_rf_AXIS /end AXIS_DESCR
 FUNCTION_LIST Lambda /end CHARACTERISTIC
/begin RECORD_LAYOUT VALUE_KF_LASV_TAU FNC_VALUES 0 UWORD ROW_DIR DIRECT /end RECORD_LAYOUT
/begin AXIS_PTS KF_LASV_TAU_n_AXIS "-" 0x7324 n KF_LASV_TAU_n_AXIS 100.000000 F00007 4 0.000000 10000.000000 /end AXIS_PTS
/begin RECORD_LAYOUT KF_LASV_TAU_n_AXIS FIX_NO_AXIS_PTS_X 4 AXIS_PTS_X 0 UWORD INDEX_INCR DIRECT /end RECORD_LAYOUT
/begin AXIS_PTS KF_LASV_TAU_rf_AXIS "-" 0x732C rf KF_LASV_TAU_rf_AXIS 100.000000 F00068 4 0.000000 2.000000 /end AXIS_PTS
/begin RECORD_LAYOUT KF_LASV_TAU_rf_AXIS FIX_NO_AXIS_PTS_Y 4 AXIS_PTS_Y 0 UWORD INDEX_INCR DIRECT /end RECORD_LAYOUT
/begin CHARACTERISTIC KL_LANK_P_TV "-" CURVE 0x6756 VALUE_KL_LANK_P_TV 100.000000 F00315 -640.000000 639.000000
 /begin AXIS_DESCR /* usn_dif */ COM_AXIS usn_dif F00316 12 -32767.000000 32768.000000 AXIS_PTS_REF KL_LANK_P_TV_usn_dif_AXIS /end AXIS_DESCR
 FUNCTION_LIST Lambda /end CHARACTERISTIC
/begin RECORD_LAYOUT VALUE_KL_LANK_P_TV FNC_VALUES 0 SWORD ROW_DIR DIRECT /end RECORD_LAYOUT
/begin AXIS_PTS KL_LANK_P_TV_usn_dif_AXIS "-" 0x673E usn_dif KL_LANK_P_TV_usn_dif_AXIS 100.000000 F00316 12 -32767.000000 32768.000000 /end AXIS_PTS
/begin RECORD_LAYOUT KL_LANK_P_TV_usn_dif_AXIS FIX_NO_AXIS_PTS_X 12 AXIS_PTS_X 0 UWORD INDEX_INCR DIRECT /end RECORD_LAYOUT
/begin CHARACTERISTIC KL_LANK_I_TV "-" CURVE 0x6788 VALUE_KL_LANK_I_TV 100.000000 F00315 -640.000000 639.000000
 /begin AXIS_DESCR /* usn_dif */ COM_AXIS usn_dif F00316 12 -32767.000000 32768.000000 AXIS_PTS_REF KL_LANK_I_TV_usn_dif_AXIS /end AXIS_DESCR
 FUNCTION_LIST Lambda /end CHARACTERISTIC
/begin RECORD_LAYOUT VALUE_KL_LANK_I_TV FNC_VALUES 0 SWORD ROW_DIR DIRECT /end RECORD_LAYOUT
/begin AXIS_PTS KL_LANK_I_TV_usn_dif_AXIS "-" 0x6770 usn_dif KL_LANK_I_TV_usn_dif_AXIS 100.000000 F00316 12 -32767.000000 32768.000000 /end AXIS_PTS
/begin RECORD_LAYOUT KL_LANK_I_TV_usn_dif_AXIS FIX_NO_AXIS_PTS_X 12 AXIS_PTS_X 0 UWORD INDEX_INCR DIRECT /end RECORD_LAYOUT
/begin CHARACTERISTIC KL_LANK_I_ML_FAK "-" CURVE 0x67AE VALUE_KL_LANK_I_ML_FAK 100.000000 F00056 0.000000 1.000000
 /begin AXIS_DESCR COM_AXIS ml F00095 6 0.000000 1400.000000 AXIS_PTS_REF KL_LANK_I_ML_FAK_ml_AXIS /end AXIS_DESCR
 FUNCTION_LIST Lambda /end CHARACTERISTIC
/begin RECORD_LAYOUT VALUE_KL_LANK_I_ML_FAK FNC_VALUES 0 UWORD ROW_DIR DIRECT /end RECORD_LAYOUT
/begin AXIS_PTS KL_LANK_I_ML_FAK_ml_AXIS "-" 0x67A2 ml KL_LANK_I_ML_FAK_ml_AXIS 100.000000 F00095 6 0.000000 1400.000000 /end AXIS_PTS
/begin RECORD_LAYOUT KL_LANK_I_ML_FAK_ml_AXIS FIX_NO_AXIS_PTS_X 6 AXIS_PTS_X 0 UWORD INDEX_INCR DIRECT /end RECORD_LAYOUT
/begin CHARACTERISTIC KL_LANK_P_ML_FAK "-" CURVE 0x67C8 VALUE_KL_LANK_P_ML_FAK 100.000000 F00056 0.000000 1.000000
 /begin AXIS_DESCR COM_AXIS ml F00095 6 0.000000 1400.000000 AXIS_PTS_REF KL_LANK_P_ML_FAK_ml_AXIS /end AXIS_DESCR
 FUNCTION_LIST Lambda /end CHARACTERISTIC
/begin RECORD_LAYOUT VALUE_KL_LANK_P_ML_FAK FNC_VALUES 0 UWORD ROW_DIR DIRECT /end RECORD_LAYOUT
/begin AXIS_PTS KL_LANK_P_ML_FAK_ml_AXIS "-" 0x67BC ml KL_LANK_P_ML_FAK_ml_AXIS 100.000000 F00095 6 0.000000 1400.000000 /end AXIS_PTS
/begin RECORD_LAYOUT KL_LANK_P_ML_FAK_ml_AXIS FIX_NO_AXIS_PTS_X 6 AXIS_PTS_X 0 UWORD INDEX_INCR DIRECT /end RECORD_LAYOUT
/begin CHARACTERISTIC KL_LANK_P_KAT_KONV "-" CURVE 0x67DA VALUE_KL_LANK_P_KAT_KONV 100.000000 F00099 0.000000 1.000000
 /begin AXIS_DESCR /* konv_gr */ COM_AXIS konv_gr F00013 4 0.000000 255.000000 AXIS_PTS_REF KL_LANK_P_KAT_KONV_konv_gr_AXIS /end AXIS_DESCR
 FUNCTION_LIST Lambda /end CHARACTERISTIC
/begin RECORD_LAYOUT VALUE_KL_LANK_P_KAT_KONV FNC_VALUES 0 UBYTE ROW_DIR DIRECT /end RECORD_LAYOUT
/begin AXIS_PTS KL_LANK_P_KAT_KONV_konv_gr_AXIS "-" 0x67D6 konv_gr KL_LANK_P_KAT_KONV_konv_gr_AXIS 100.000000 F00013 4 0.000000 255.000000 /end AXIS_PTS
/begin RECORD_LAYOUT KL_LANK_P_KAT_KONV_konv_gr_AXIS FIX_NO_AXIS_PTS_X 4 AXIS_PTS_X 0 UBYTE INDEX_INCR DIRECT /end RECORD_LAYOUT
/begin CHARACTERISTIC KF_LANK_USN_SOLL "-" MAP 0x67F0 VALUE_KF_LANK_USN_SOLL 100.000000 F00222 0.000000 65535.000000
 /begin AXIS_DESCR COM_AXIS n F00007 4 0.000000 10000.000000 AXIS_PTS_REF KF_LANK_USN_SOLL_n_AXIS /end AXIS_DESCR
 /begin AXIS_DESCR COM_AXIS rf F00068 4 0.000000 2.000000 AXIS_PTS_REF KF_LANK_USN_SOLL_rf_AXIS /end AXIS_DESCR
 FUNCTION_LIST Lambda /end CHARACTERISTIC
/begin RECORD_LAYOUT VALUE_KF_LANK_USN_SOLL FNC_VALUES 0 UWORD ROW_DIR DIRECT /end RECORD_LAYOUT
/begin AXIS_PTS KF_LANK_USN_SOLL_n_AXIS "-" 0x67E0 n KF_LANK_USN_SOLL_n_AXIS 100.000000 F00007 4 0.000000 10000.000000 /end AXIS_PTS
/begin RECORD_LAYOUT KF_LANK_USN_SOLL_n_AXIS FIX_NO_AXIS_PTS_X 4 AXIS_PTS_X 0 UWORD INDEX_INCR DIRECT /end RECORD_LAYOUT
/begin AXIS_PTS KF_LANK_USN_SOLL_rf_AXIS "-" 0x67E8 rf KF_LANK_USN_SOLL_rf_AXIS 100.000000 F00068 4 0.000000 2.000000 /end AXIS_PTS
/begin RECORD_LAYOUT KF_LANK_USN_SOLL_rf_AXIS FIX_NO_AXIS_PTS_Y 4 AXIS_PTS_Y 0 UWORD INDEX_INCR DIRECT /end RECORD_LAYOUT
/begin CHARACTERISTIC KF_LANK_FAK_N_RF "-" MAP 0x6832 VALUE_KF_LANK_FAK_N_RF 100.000000 F00056 0.000000 1.000000
 /begin AXIS_DESCR COM_AXIS n F00007 8 0.000000 10000.000000 AXIS_PTS_REF KF_LANK_FAK_N_RF_n_AXIS /end AXIS_DESCR
 /begin AXIS_DESCR COM_AXIS rf F00068 8 0.000000 2.000000 AXIS_PTS_REF KF_LANK_FAK_N_RF_rf_AXIS /end AXIS_DESCR
 FUNCTION_LIST Lambda /end CHARACTERISTIC
/begin RECORD_LAYOUT VALUE_KF_LANK_FAK_N_RF FNC_VALUES 0 UBYTE ROW_DIR DIRECT /end RECORD_LAYOUT
/begin AXIS_PTS KF_LANK_FAK_N_RF_n_AXIS "-" 0x6812 n KF_LANK_FAK_N_RF_n_AXIS 100.000000 F00007 8 0.000000 10000.000000 /end AXIS_PTS
/begin RECORD_LAYOUT KF_LANK_FAK_N_RF_n_AXIS FIX_NO_AXIS_PTS_X 8 AXIS_PTS_X 0 UWORD INDEX_INCR DIRECT /end RECORD_LAYOUT
/begin AXIS_PTS KF_LANK_FAK_N_RF_rf_AXIS "-" 0x6822 rf KF_LANK_FAK_N_RF_rf_AXIS 100.000000 F00068 8 0.000000 2.000000 /end AXIS_PTS
/begin RECORD_LAYOUT KF_LANK_FAK_N_RF_rf_AXIS FIX_NO_AXIS_PTS_Y 8 AXIS_PTS_Y 0 UWORD INDEX_INCR DIRECT /end RECORD_LAYOUT
/begin CHARACTERISTIC KF_LANK_TAU_L "-" MAP 0x6884 VALUE_KF_LANK_TAU_L 100.000000 F00305 0.000000 655350.000000
 /begin AXIS_DESCR COM_AXIS n F00007 4 0.000000 10000.000000 AXIS_PTS_REF KF_LANK_TAU_L_n_AXIS /end AXIS_DESCR
 /begin AXIS_DESCR COM_AXIS rf F00068 4 0.000000 2.000000 AXIS_PTS_REF KF_LANK_TAU_L_rf_AXIS /end AXIS_DESCR
 FUNCTION_LIST Lambda /end CHARACTERISTIC
/begin RECORD_LAYOUT VALUE_KF_LANK_TAU_L FNC_VALUES 0 UWORD ROW_DIR DIRECT /end RECORD_LAYOUT
/begin AXIS_PTS KF_LANK_TAU_L_n_AXIS "-" 0x6874 n KF_LANK_TAU_L_n_AXIS 100.000000 F00007 4 0.000000 10000.000000 /end AXIS_PTS
/begin RECORD_LAYOUT KF_LANK_TAU_L_n_AXIS FIX_NO_AXIS_PTS_X 4 AXIS_PTS_X 0 UWORD INDEX_INCR DIRECT /end RECORD_LAYOUT
/begin AXIS_PTS KF_LANK_TAU_L_rf_AXIS "-" 0x687C rf KF_LANK_TAU_L_rf_AXIS 100.000000 F00068 4 0.000000 2.000000 /end AXIS_PTS
/begin RECORD_LAYOUT KF_LANK_TAU_L_rf_AXIS FIX_NO_AXIS_PTS_Y 4 AXIS_PTS_Y 0 UWORD INDEX_INCR DIRECT /end RECORD_LAYOUT
/begin CHARACTERISTIC KL_LA_KA_TV_ML "-" CURVE 0x7438 VALUE_KL_LA_KA_TV_ML 100.000000 F00305 0.000000 1270.000000
 /begin AXIS_DESCR COM_AXIS ml F00095 5 0.000000 1400.000000 AXIS_PTS_REF KL_LA_KA_TV_ML_ml_AXIS /end AXIS_DESCR
 FUNCTION_LIST Lambda-OBD /end CHARACTERISTIC
/begin RECORD_LAYOUT VALUE_KL_LA_KA_TV_ML FNC_VALUES 0 UWORD ROW_DIR DIRECT /end RECORD_LAYOUT
/begin AXIS_PTS KL_LA_KA_TV_ML_ml_AXIS "-" 0x742E ml KL_LA_KA_TV_ML_ml_AXIS 100.000000 F00095 5 0.000000 1400.000000 /end AXIS_PTS
/begin RECORD_LAYOUT KL_LA_KA_TV_ML_ml_AXIS FIX_NO_AXIS_PTS_X 5 AXIS_PTS_X 0 UWORD INDEX_INCR DIRECT /end RECORD_LAYOUT
/begin CHARACTERISTIC KL_LA_ALTER_S_TV "-" CURVE 0x744A VALUE_KL_LA_ALTER_S_TV 100.000000 F00305 0.000000 1270.000000
 /begin AXIS_DESCR COM_AXIS ml F00095 3 0.000000 1400.000000 AXIS_PTS_REF KL_LA_ALTER_S_TV_ml_AXIS /end AXIS_DESCR
 FUNCTION_LIST Lambda-OBD /end CHARACTERISTIC
/begin RECORD_LAYOUT VALUE_KL_LA_ALTER_S_TV FNC_VALUES 0 UWORD ROW_DIR DIRECT /end RECORD_LAYOUT
/begin AXIS_PTS KL_LA_ALTER_S_TV_ml_AXIS "-" 0x7444 ml KL_LA_ALTER_S_TV_ml_AXIS 100.000000 F00095 3 0.000000 1400.000000 /end AXIS_PTS
/begin RECORD_LAYOUT KL_LA_ALTER_S_TV_ml_AXIS FIX_NO_AXIS_PTS_X 3 AXIS_PTS_X 0 UWORD INDEX_INCR DIRECT /end RECORD_LAYOUT
/begin CHARACTERISTIC KF_LA_ALT_P_FAK_N_RF "-" MAP 0x7462 VALUE_KF_LA_ALT_P_FAK_N_RF 100.000000 F00056 0.000000 1.000000
 /begin AXIS_DESCR COM_AXIS n F00007 4 0.000000 10000.000000 AXIS_PTS_REF KF_LA_ALT_P_FAK_N_RF_n_AXIS /end AXIS_DESCR
 /begin AXIS_DESCR COM_AXIS rf F00068 4 0.000000 2.000000 AXIS_PTS_REF KF_LA_ALT_P_FAK_N_RF_rf_AXIS /end AXIS_DESCR
 FUNCTION_LIST Lambda-OBD /end CHARACTERISTIC
/begin RECORD_LAYOUT VALUE_KF_LA_ALT_P_FAK_N_RF FNC_VALUES 0 UBYTE ROW_DIR DIRECT /end RECORD_LAYOUT
/begin AXIS_PTS KF_LA_ALT_P_FAK_N_RF_n_AXIS "-" 0x7452 n KF_LA_ALT_P_FAK_N_RF_n_AXIS 100.000000 F00007 4 0.000000 10000.000000 /end AXIS_PTS
/begin RECORD_LAYOUT KF_LA_ALT_P_FAK_N_RF_n_AXIS FIX_NO_AXIS_PTS_X 4 AXIS_PTS_X 0 UWORD INDEX_INCR DIRECT /end RECORD_LAYOUT
/begin AXIS_PTS KF_LA_ALT_P_FAK_N_RF_rf_AXIS "-" 0x745A rf KF_LA_ALT_P_FAK_N_RF_rf_AXIS 100.000000 F00068 4 0.000000 2.000000 /end AXIS_PTS
/begin RECORD_LAYOUT KF_LA_ALT_P_FAK_N_RF_rf_AXIS FIX_NO_AXIS_PTS_Y 4 AXIS_PTS_Y 0 UWORD INDEX_INCR DIRECT /end RECORD_LAYOUT
/begin CHARACTERISTIC KF_LA_KONV_QUOT_GREN "-" MAP 0x7480 VALUE_KF_LA_KONV_QUOT_GREN 100.000000 F00285 0.000000 1.000000
 /begin AXIS_DESCR COM_AXIS n F00007 3 0.000000 10000.000000 AXIS_PTS_REF KF_LA_KONV_QUOT_GREN_n_AXIS /end AXIS_DESCR
 /begin AXIS_DESCR COM_AXIS rf F00068 3 0.000000 2.000000 AXIS_PTS_REF KF_LA_KONV_QUOT_GREN_rf_AXIS /end AXIS_DESCR
 FUNCTION_LIST Lambda-OBD /end CHARACTERISTIC
/begin RECORD_LAYOUT VALUE_KF_LA_KONV_QUOT_GREN FNC_VALUES 0 UWORD ROW_DIR DIRECT /end RECORD_LAYOUT
/begin AXIS_PTS KF_LA_KONV_QUOT_GREN_n_AXIS "-" 0x7474 n KF_LA_KONV_QUOT_GREN_n_AXIS 100.000000 F00007 3 0.000000 10000.000000 /end AXIS_PTS
/begin RECORD_LAYOUT KF_LA_KONV_QUOT_GREN_n_AXIS FIX_NO_AXIS_PTS_X 3 AXIS_PTS_X 0 UWORD INDEX_INCR DIRECT /end RECORD_LAYOUT
/begin AXIS_PTS KF_LA_KONV_QUOT_GREN_rf_AXIS "-" 0x747A rf KF_LA_KONV_QUOT_GREN_rf_AXIS 100.000000 F00068 3 0.000000 2.000000 /end AXIS_PTS
/begin RECORD_LAYOUT KF_LA_KONV_QUOT_GREN_rf_AXIS FIX_NO_AXIS_PTS_Y 3 AXIS_PTS_Y 0 UWORD INDEX_INCR DIRECT /end RECORD_LAYOUT
/begin CHARACTERISTIC KF_LA_ALT_SPR_FETT_G "-" MAP 0x74AC VALUE_KF_LA_ALT_SPR_FETT_G 100.000000 F00057 0.000000 2550.000000
 /begin AXIS_DESCR COM_AXIS n F00007 6 0.000000 10000.000000 AXIS_PTS_REF KF_LA_ALT_SPR_FETT_G_n_AXIS /end AXIS_DESCR
 /begin AXIS_DESCR COM_AXIS rf F00068 6 0.000000 2.000000 AXIS_PTS_REF KF_LA_ALT_SPR_FETT_G_rf_AXIS /end AXIS_DESCR
 FUNCTION_LIST Lambda-OBD /end CHARACTERISTIC
/begin RECORD_LAYOUT VALUE_KF_LA_ALT_SPR_FETT_G FNC_VALUES 0 UBYTE ROW_DIR DIRECT /end RECORD_LAYOUT
/begin AXIS_PTS KF_LA_ALT_SPR_FETT_G_n_AXIS "-" 0x7494 n KF_LA_ALT_SPR_FETT_G_n_AXIS 100.000000 F00007 6 0.000000 10000.000000 /end AXIS_PTS
/begin RECORD_LAYOUT KF_LA_ALT_SPR_FETT_G_n_AXIS FIX_NO_AXIS_PTS_X 6 AXIS_PTS_X 0 UWORD INDEX_INCR DIRECT /end RECORD_LAYOUT
/begin AXIS_PTS KF_LA_ALT_SPR_FETT_G_rf_AXIS "-" 0x74A0 rf KF_LA_ALT_SPR_FETT_G_rf_AXIS 100.000000 F00068 6 0.000000 2.000000 /end AXIS_PTS
/begin RECORD_LAYOUT KF_LA_ALT_SPR_FETT_G_rf_AXIS FIX_NO_AXIS_PTS_Y 6 AXIS_PTS_Y 0 UWORD INDEX_INCR DIRECT /end RECORD_LAYOUT
/begin CHARACTERISTIC KF_LA_ALT_SPR_MAGER_ "-" MAP 0x74EA VALUE_KF_LA_ALT_SPR_MAGER_ 100.000000 F00057 0.000000 2550.000000
 /begin AXIS_DESCR COM_AXIS n F00007 6 0.000000 10000.000000 AXIS_PTS_REF KF_LA_ALT_SPR_MAGER__n_AXIS /end AXIS_DESCR
 /begin AXIS_DESCR COM_AXIS rf F00068 6 0.000000 2.000000 AXIS_PTS_REF KF_LA_ALT_SPR_MAGER__rf_AXIS /end AXIS_DESCR
 FUNCTION_LIST Lambda-OBD /end CHARACTERISTIC
/begin RECORD_LAYOUT VALUE_KF_LA_ALT_SPR_MAGER_ FNC_VALUES 0 UBYTE ROW_DIR DIRECT /end RECORD_LAYOUT
/begin AXIS_PTS KF_LA_ALT_SPR_MAGER__n_AXIS "-" 0x74D2 n KF_LA_ALT_SPR_MAGER__n_AXIS 100.000000 F00007 6 0.000000 10000.000000 /end AXIS_PTS
/begin RECORD_LAYOUT KF_LA_ALT_SPR_MAGER__n_AXIS FIX_NO_AXIS_PTS_X 6 AXIS_PTS_X 0 UWORD INDEX_INCR DIRECT /end RECORD_LAYOUT
/begin AXIS_PTS KF_LA_ALT_SPR_MAGER__rf_AXIS "-" 0x74DE rf KF_LA_ALT_SPR_MAGER__rf_AXIS 100.000000 F00068 6 0.000000 2.000000 /end AXIS_PTS
/begin RECORD_LAYOUT KF_LA_ALT_SPR_MAGER__rf_AXIS FIX_NO_AXIS_PTS_Y 6 AXIS_PTS_Y 0 UWORD INDEX_INCR DIRECT /end RECORD_LAYOUT
/begin CHARACTERISTIC KL_LDP_T_GROB "-" CURVE 0x6F62 VALUE_KL_LDP_T_GROB 100.000000 F00017 0.000000 255.000000
 /begin AXIS_DESCR COM_AXIS can_fst F00091 6 0.000000 255.000000 AXIS_PTS_REF KL_LDP_T_GROB_can_fst_AXIS /end AXIS_DESCR
 FUNCTION_LIST Tankleckdiagnose /end CHARACTERISTIC
/begin RECORD_LAYOUT VALUE_KL_LDP_T_GROB FNC_VALUES 0 UBYTE ROW_DIR DIRECT /end RECORD_LAYOUT
/begin AXIS_PTS KL_LDP_T_GROB_can_fst_AXIS "-" 0x6F5C can_fst KL_LDP_T_GROB_can_fst_AXIS 100.000000 F00091 6 0.000000 255.000000 /end AXIS_PTS
/begin RECORD_LAYOUT KL_LDP_T_GROB_can_fst_AXIS FIX_NO_AXIS_PTS_X 6 AXIS_PTS_X 0 UBYTE INDEX_INCR DIRECT /end RECORD_LAYOUT
/begin CHARACTERISTIC KL_LDP_T_FEIN_MIN "-" CURVE 0x6F70 VALUE_KL_LDP_T_FEIN_MIN 100.000000 F00302 0.000000 510.000000
 /begin AXIS_DESCR COM_AXIS can_fst F00091 6 0.000000 255.000000 AXIS_PTS_REF KL_LDP_T_FEIN_MIN_can_fst_AXIS /end AXIS_DESCR
 FUNCTION_LIST Tankleckdiagnose /end CHARACTERISTIC
/begin RECORD_LAYOUT VALUE_KL_LDP_T_FEIN_MIN FNC_VALUES 0 UBYTE ROW_DIR DIRECT /end RECORD_LAYOUT
/begin AXIS_PTS KL_LDP_T_FEIN_MIN_can_fst_AXIS "-" 0x6F6A can_fst KL_LDP_T_FEIN_MIN_can_fst_AXIS 100.000000 F00091 6 0.000000 255.000000 /end AXIS_PTS
/begin RECORD_LAYOUT KL_LDP_T_FEIN_MIN_can_fst_AXIS FIX_NO_AXIS_PTS_X 6 AXIS_PTS_X 0 UBYTE INDEX_INCR DIRECT /end RECORD_LAYOUT
/begin CHARACTERISTIC KL_LDP_T_STABIL "-" CURVE 0x6F7E VALUE_KL_LDP_T_STABIL 100.000000 F00017 0.000000 255.000000
 /begin AXIS_DESCR COM_AXIS can_fst F00091 6 0.000000 255.000000 AXIS_PTS_REF KL_LDP_T_STABIL_can_fst_AXIS /end AXIS_DESCR
 FUNCTION_LIST Tankleckdiagnose /end CHARACTERISTIC
/begin RECORD_LAYOUT VALUE_KL_LDP_T_STABIL FNC_VALUES 0 UBYTE ROW_DIR DIRECT /end RECORD_LAYOUT
/begin AXIS_PTS KL_LDP_T_STABIL_can_fst_AXIS "-" 0x6F78 can_fst KL_LDP_T_STABIL_can_fst_AXIS 100.000000 F00091 6 0.000000 255.000000 /end AXIS_PTS
/begin RECORD_LAYOUT KL_LDP_T_STABIL_can_fst_AXIS FIX_NO_AXIS_PTS_X 6 AXIS_PTS_X 0 UBYTE INDEX_INCR DIRECT /end RECORD_LAYOUT
/begin CHARACTERISTIC KL_LDP_HOEHE_KORR "-" CURVE 0x6F88 VALUE_KL_LDP_HOEHE_KORR 100.000000 F00056 0.000000 1.000000
 /begin AXIS_DESCR COM_AXIS p_umg F00104 2 500.000000 1150.000000 AXIS_PTS_REF KL_LDP_HOEHE_KORR_p_umg_AXIS /end AXIS_DESCR
 FUNCTION_LIST Tankleckdiagnose /end CHARACTERISTIC
/begin RECORD_LAYOUT VALUE_KL_LDP_HOEHE_KORR FNC_VALUES 0 UBYTE ROW_DIR DIRECT /end RECORD_LAYOUT
/begin AXIS_PTS KL_LDP_HOEHE_KORR_p_umg_AXIS "-" 0x6F86 p_umg KL_LDP_HOEHE_KORR_p_umg_AXIS 100.000000 F00104 2 500.000000 1150.000000 /end AXIS_PTS
/begin RECORD_LAYOUT KL_LDP_HOEHE_KORR_p_umg_AXIS FIX_NO_AXIS_PTS_X 2 AXIS_PTS_X 0 UBYTE INDEX_INCR DIRECT /end RECORD_LAYOUT
/begin CHARACTERISTIC KL_LDP_KORR_FAKT "-" CURVE 0x6F96 VALUE_KL_LDP_KORR_FAKT 100.000000 F00085 0.000000 2.000000
 /begin AXIS_DESCR /* ldp_ub_fil */ COM_AXIS ldp_ub_fil F00327 5 0.000000 25.000000 AXIS_PTS_REF KL_LDP_KORR_FAKT_ldp_ub_fil_AXIS /end AXIS_DESCR
 FUNCTION_LIST Tankleckdiagnose /end CHARACTERISTIC
/begin RECORD_LAYOUT VALUE_KL_LDP_KORR_FAKT FNC_VALUES 0 UWORD ROW_DIR DIRECT /end RECORD_LAYOUT
/begin AXIS_PTS KL_LDP_KORR_FAKT_ldp_ub_fil_AXIS "-" 0x6F8C ldp_ub_fil KL_LDP_KORR_FAKT_ldp_ub_fil_AXIS 100.000000 F00327 5 0.000000 25.000000 /end AXIS_PTS
/begin RECORD_LAYOUT KL_LDP_KORR_FAKT_ldp_ub_fil_AXIS FIX_NO_AXIS_PTS_X 5 AXIS_PTS_X 0 UWORD INDEX_INCR DIRECT /end RECORD_LAYOUT
/begin CHARACTERISTIC KL_LDP_FST_MAX_STAND "-" CURVE 0x6FA6 VALUE_KL_LDP_FST_MAX_STAND 100.000000 F00091 0.000000 255.000000
 /begin AXIS_DESCR /* asc_ay */ COM_AXIS asc_ay F00328 4 -12.000000 12.000000 AXIS_PTS_REF KL_LDP_FST_MAX_STAND_asc_ay_AXIS /end AXIS_DESCR
 FUNCTION_LIST Tankleckdiagnose /end CHARACTERISTIC
/begin RECORD_LAYOUT VALUE_KL_LDP_FST_MAX_STAND FNC_VALUES 0 UBYTE ROW_DIR DIRECT /end RECORD_LAYOUT
/begin AXIS_PTS KL_LDP_FST_MAX_STAND_asc_ay_AXIS "-" 0x6FA2 asc_ay KL_LDP_FST_MAX_STAND_asc_ay_AXIS 100.000000 F00328 4 -12.000000 12.000000 /end AXIS_PTS
/begin RECORD_LAYOUT KL_LDP_FST_MAX_STAND_asc_ay_AXIS FIX_NO_AXIS_PTS_X 4 AXIS_PTS_X 0 UBYTE INDEX_INCR DIRECT /end RECORD_LAYOUT
/begin CHARACTERISTIC KL_LL_TI_T "-" CURVE 0x4E20 VALUE_KL_LL_TI_T 100.000000 F00269 0.000000 0.000000
 /begin AXIS_DESCR /* ll_abw */ COM_AXIS ll_abw F00329 6 0.000000 2.000000 AXIS_PTS_REF KL_LL_TI_T_ll_abw_AXIS /end AXIS_DESCR
 FUNCTION_LIST LeerLaufSYNChornisation /end CHARACTERISTIC
/begin RECORD_LAYOUT VALUE_KL_LL_TI_T FNC_VALUES 0 SWORD ROW_DIR DIRECT /end RECORD_LAYOUT
/begin AXIS_PTS KL_LL_TI_T_ll_abw_AXIS "-" 0x4E14 ll_abw KL_LL_TI_T_ll_abw_AXIS 100.000000 F00329 6 0.000000 2.000000 /end AXIS_PTS
/begin RECORD_LAYOUT KL_LL_TI_T_ll_abw_AXIS FIX_NO_AXIS_PTS_X 6 AXIS_PTS_X 0 UWORD INDEX_INCR DIRECT /end RECORD_LAYOUT
/begin CHARACTERISTIC KL_LSHV_T_EIN "-" CURVE 0x781B VALUE_KL_LSHV_T_EIN 100.000000 F00250 0.000000 255.000000
 /begin AXIS_DESCR COM_AXIS tmot F00303 3 -48.000000 207.000000 AXIS_PTS_REF KL_LSHV_T_EIN_tmot_AXIS /end AXIS_DESCR
 FUNCTION_LIST Lamdasondenheizung /end CHARACTERISTIC
/begin RECORD_LAYOUT VALUE_KL_LSHV_T_EIN FNC_VALUES 0 UBYTE ROW_DIR DIRECT /end RECORD_LAYOUT
/begin AXIS_PTS KL_LSHV_T_EIN_tmot_AXIS "-" 0x7818 tmot KL_LSHV_T_EIN_tmot_AXIS 100.000000 F00303 3 -48.000000 207.000000 /end AXIS_PTS
/begin RECORD_LAYOUT KL_LSHV_T_EIN_tmot_AXIS FIX_NO_AXIS_PTS_X 3 AXIS_PTS_X 0 UBYTE INDEX_INCR DIRECT /end RECORD_LAYOUT
/begin CHARACTERISTIC KL_LSHN_T_EIN "-" CURVE 0x7823 VALUE_KL_LSHN_T_EIN 100.000000 F00250 0.000000 255.000000
 /begin AXIS_DESCR COM_AXIS tmot F00303 3 -48.000000 207.000000 AXIS_PTS_REF KL_LSHN_T_EIN_tmot_AXIS /end AXIS_DESCR
 FUNCTION_LIST Lamdasondenheizung /end CHARACTERISTIC
/begin RECORD_LAYOUT VALUE_KL_LSHN_T_EIN FNC_VALUES 0 UBYTE ROW_DIR DIRECT /end RECORD_LAYOUT
/begin AXIS_PTS KL_LSHN_T_EIN_tmot_AXIS "-" 0x7820 tmot KL_LSHN_T_EIN_tmot_AXIS 100.000000 F00303 3 -48.000000 207.000000 /end AXIS_PTS
/begin RECORD_LAYOUT KL_LSHN_T_EIN_tmot_AXIS FIX_NO_AXIS_PTS_X 3 AXIS_PTS_X 0 UBYTE INDEX_INCR DIRECT /end RECORD_LAYOUT
/begin CHARACTERISTIC KL_LSH_RF_AUS "-" CURVE 0x7832 VALUE_KL_LSH_RF_AUS 100.000000 F00068 0.000000 2.000000
 /begin AXIS_DESCR COM_AXIS n F00304 5 0.000000 10000.000000 AXIS_PTS_REF KL_LSH_RF_AUS_n_AXIS /end AXIS_DESCR
 FUNCTION_LIST Lamdasondenheizung /end CHARACTERISTIC
/begin RECORD_LAYOUT VALUE_KL_LSH_RF_AUS FNC_VALUES 0 UWORD ROW_DIR DIRECT /end RECORD_LAYOUT
/begin AXIS_PTS KL_LSH_RF_AUS_n_AXIS "-" 0x7828 n KL_LSH_RF_AUS_n_AXIS 100.000000 F00304 5 0.000000 10000.000000 /end AXIS_PTS
/begin RECORD_LAYOUT KL_LSH_RF_AUS_n_AXIS FIX_NO_AXIS_PTS_X 5 AXIS_PTS_X 0 UWORD INDEX_INCR DIRECT /end RECORD_LAYOUT
/begin CHARACTERISTIC KL_LSHV_UB_TA "-" CURVE 0x7842 VALUE_KL_LSHV_UB_TA 100.000000 F00093 0.000000 99.000000
 /begin AXIS_DESCR COM_AXIS ub F00018 4 0.000000 25.000000 AXIS_PTS_REF KL_LSHV_UB_TA_ub_AXIS /end AXIS_DESCR
 FUNCTION_LIST Lamdasondenheizung /end CHARACTERISTIC
/begin RECORD_LAYOUT VALUE_KL_LSHV_UB_TA FNC_VALUES 0 UBYTE ROW_DIR DIRECT /end RECORD_LAYOUT
/begin AXIS_PTS KL_LSHV_UB_TA_ub_AXIS "-" 0x783E ub KL_LSHV_UB_TA_ub_AXIS 100.000000 F00018 4 0.000000 25.000000 /end AXIS_PTS
/begin RECORD_LAYOUT KL_LSHV_UB_TA_ub_AXIS FIX_NO_AXIS_PTS_X 4 AXIS_PTS_X 0 UBYTE INDEX_INCR DIRECT /end RECORD_LAYOUT
/begin CHARACTERISTIC KL_LSHN_UB_TA "-" CURVE 0x784C VALUE_KL_LSHN_UB_TA 100.000000 F00093 0.000000 99.000000
 /begin AXIS_DESCR COM_AXIS ub F00018 4 0.000000 25.000000 AXIS_PTS_REF KL_LSHN_UB_TA_ub_AXIS /end AXIS_DESCR
 FUNCTION_LIST Lamdasondenheizung /end CHARACTERISTIC
/begin RECORD_LAYOUT VALUE_KL_LSHN_UB_TA FNC_VALUES 0 UBYTE ROW_DIR DIRECT /end RECORD_LAYOUT
/begin AXIS_PTS KL_LSHN_UB_TA_ub_AXIS "-" 0x7848 ub KL_LSHN_UB_TA_ub_AXIS 100.000000 F00018 4 0.000000 25.000000 /end AXIS_PTS
/begin RECORD_LAYOUT KL_LSHN_UB_TA_ub_AXIS FIX_NO_AXIS_PTS_X 4 AXIS_PTS_X 0 UBYTE INDEX_INCR DIRECT /end RECORD_LAYOUT
/begin CHARACTERISTIC KL_LA_SOND_TEMP "-" CURVE 0x7876 VALUE_KL_LA_SOND_TEMP 100.000000 F00303 -48.000000 1252.000000
 /begin AXIS_DESCR /* lshv_r1 */ COM_AXIS lshv_r1 F00331 8 0.000000 100.000000 AXIS_PTS_REF KL_LA_SOND_TEMP_lshv_r1_AXIS /end AXIS_DESCR
 FUNCTION_LIST NO_FUNCTION /end CHARACTERISTIC
/begin RECORD_LAYOUT VALUE_KL_LA_SOND_TEMP FNC_VALUES 0 UWORD ROW_DIR DIRECT /end RECORD_LAYOUT
/begin AXIS_PTS KL_LA_SOND_TEMP_lshv_r1_AXIS "-" 0x7866 lshv_r1 KL_LA_SOND_TEMP_lshv_r1_AXIS 100.000000 F00331 8 0.000000 100.000000 /end AXIS_PTS
/begin RECORD_LAYOUT KL_LA_SOND_TEMP_lshv_r1_AXIS FIX_NO_AXIS_PTS_X 8 AXIS_PTS_X 0 UWORD INDEX_INCR DIRECT /end RECORD_LAYOUT
/begin CHARACTERISTIC KL_LU_START_DLY "-" CURVE 0x5FC3 VALUE_KL_LU_START_DLY 100.000000 F00337 0.000000 255.000000
 /begin AXIS_DESCR COM_AXIS tmot F00014 3 -48.000000 207.000000 AXIS_PTS_REF KL_LU_START_DLY_tmot_AXIS /end AXIS_DESCR
 FUNCTION_LIST Laufunruhe /end CHARACTERISTIC
/begin RECORD_LAYOUT VALUE_KL_LU_START_DLY FNC_VALUES 0 UBYTE ROW_DIR DIRECT /end RECORD_LAYOUT
/begin AXIS_PTS KL_LU_START_DLY_tmot_AXIS "-" 0x5FC0 tmot KL_LU_START_DLY_tmot_AXIS 100.000000 F00014 3 -48.000000 207.000000 /end AXIS_PTS
/begin RECORD_LAYOUT KL_LU_START_DLY_tmot_AXIS FIX_NO_AXIS_PTS_X 3 AXIS_PTS_X 0 UBYTE INDEX_INCR DIRECT /end RECORD_LAYOUT
/begin CHARACTERISTIC KL_LU_START_TRIG_OFF "-" CURVE 0x5FCB VALUE_KL_LU_START_TRIG_OFF 100.000000 F00028 0.000000 25.000000
 /begin AXIS_DESCR COM_AXIS tmot F00014 3 -48.000000 207.000000 AXIS_PTS_REF KL_LU_START_TRIG_OFF_tmot_AXIS /end AXIS_DESCR
 FUNCTION_LIST Laufunruhe /end CHARACTERISTIC
/begin RECORD_LAYOUT VALUE_KL_LU_START_TRIG_OFF FNC_VALUES 0 UBYTE ROW_DIR DIRECT /end RECORD_LAYOUT
/begin AXIS_PTS KL_LU_START_TRIG_OFF_tmot_AXIS "-" 0x5FC8 tmot KL_LU_START_TRIG_OFF_tmot_AXIS 100.000000 F00014 3 -48.000000 207.000000 /end AXIS_PTS
/begin RECORD_LAYOUT KL_LU_START_TRIG_OFF_tmot_AXIS FIX_NO_AXIS_PTS_X 3 AXIS_PTS_X 0 UBYTE INDEX_INCR DIRECT /end RECORD_LAYOUT
/begin CHARACTERISTIC KL_LU_SCHW_KATH "-" CURVE 0x5FD3 VALUE_KL_LU_SCHW_KATH 100.000000 F00131 0.000000 7.000000
 /begin AXIS_DESCR COM_AXIS n40 F00109 3 0.000000 10000.000000 AXIS_PTS_REF KL_LU_SCHW_KATH_n40_AXIS /end AXIS_DESCR
 FUNCTION_LIST Laufunruhe /end CHARACTERISTIC
/begin RECORD_LAYOUT VALUE_KL_LU_SCHW_KATH FNC_VALUES 0 UBYTE ROW_DIR DIRECT /end RECORD_LAYOUT
/begin AXIS_PTS KL_LU_SCHW_KATH_n40_AXIS "-" 0x5FD0 n40 KL_LU_SCHW_KATH_n40_AXIS 100.000000 F00109 3 0.000000 10000.000000 /end AXIS_PTS
/begin RECORD_LAYOUT KL_LU_SCHW_KATH_n40_AXIS FIX_NO_AXIS_PTS_X 3 AXIS_PTS_X 0 UBYTE INDEX_INCR DIRECT /end RECORD_LAYOUT
/begin CHARACTERISTIC KL_LU_ADAP_FILT "-" CURVE 0x5FDE VALUE_KL_LU_ADAP_FILT 100.000000 F00338 0.000000 1.000000
 /begin AXIS_DESCR /* lu_adap_cnt */ COM_AXIS lu_adap_cnt F00336 3 0.000000 65535.000000 AXIS_PTS_REF KL_LU_ADAP_FILT_lu_adap_cnt_AXIS /end AXIS_DESCR
 FUNCTION_LIST Laufunruhe /end CHARACTERISTIC
/begin RECORD_LAYOUT VALUE_KL_LU_ADAP_FILT FNC_VALUES 0 UWORD ROW_DIR DIRECT /end RECORD_LAYOUT
/begin AXIS_PTS KL_LU_ADAP_FILT_lu_adap_cnt_AXIS "-" 0x5FD8 lu_adap_cnt KL_LU_ADAP_FILT_lu_adap_cnt_AXIS 100.000000 F00336 3 0.000000 65535.000000 /end AXIS_PTS
/begin RECORD_LAYOUT KL_LU_ADAP_FILT_lu_adap_cnt_AXIS FIX_NO_AXIS_PTS_X 3 AXIS_PTS_X 0 UWORD INDEX_INCR DIRECT /end RECORD_LAYOUT
/begin CHARACTERISTIC KL_LU_FAKT_1 "-" CURVE 0x5FEE VALUE_KL_LU_FAKT_1 100.000000 F00003 0.000000 3.000000
 /begin AXIS_DESCR COM_AXIS n40 F00109 8 0.000000 10000.000000 AXIS_PTS_REF KL_LU_FAKT_1_n40_AXIS /end AXIS_DESCR
 FUNCTION_LIST Laufunruhe /end CHARACTERISTIC
/begin RECORD_LAYOUT VALUE_KL_LU_FAKT_1 FNC_VALUES 0 UBYTE ROW_DIR DIRECT /end RECORD_LAYOUT
/begin AXIS_PTS KL_LU_FAKT_1_n40_AXIS "-" 0x5FE6 n40 KL_LU_FAKT_1_n40_AXIS 100.000000 F00109 8 0.000000 10000.000000 /end AXIS_PTS
/begin RECORD_LAYOUT KL_LU_FAKT_1_n40_AXIS FIX_NO_AXIS_PTS_X 8 AXIS_PTS_X 0 UBYTE INDEX_INCR DIRECT /end RECORD_LAYOUT
/begin CHARACTERISTIC KL_LU_FAKT_2 "-" CURVE 0x6000 VALUE_KL_LU_FAKT_2 100.000000 F00003 0.000000 3.000000
 /begin AXIS_DESCR COM_AXIS n40 F00109 8 0.000000 10000.000000 AXIS_PTS_REF KL_LU_FAKT_2_n40_AXIS /end AXIS_DESCR
 FUNCTION_LIST Laufunruhe /end CHARACTERISTIC
/begin RECORD_LAYOUT VALUE_KL_LU_FAKT_2 FNC_VALUES 0 UBYTE ROW_DIR DIRECT /end RECORD_LAYOUT
/begin AXIS_PTS KL_LU_FAKT_2_n40_AXIS "-" 0x5FF8 n40 KL_LU_FAKT_2_n40_AXIS 100.000000 F00109 8 0.000000 10000.000000 /end AXIS_PTS
/begin RECORD_LAYOUT KL_LU_FAKT_2_n40_AXIS FIX_NO_AXIS_PTS_X 8 AXIS_PTS_X 0 UBYTE INDEX_INCR DIRECT /end RECORD_LAYOUT
/begin CHARACTERISTIC KL_LU_FAKT_3 "-" CURVE 0x6012 VALUE_KL_LU_FAKT_3 100.000000 F00003 0.000000 3.000000
 /begin AXIS_DESCR COM_AXIS n40 F00109 8 0.000000 10000.000000 AXIS_PTS_REF KL_LU_FAKT_3_n40_AXIS /end AXIS_DESCR
 FUNCTION_LIST Laufunruhe /end CHARACTERISTIC
/begin RECORD_LAYOUT VALUE_KL_LU_FAKT_3 FNC_VALUES 0 UBYTE ROW_DIR DIRECT /end RECORD_LAYOUT
/begin AXIS_PTS KL_LU_FAKT_3_n40_AXIS "-" 0x600A n40 KL_LU_FAKT_3_n40_AXIS 100.000000 F00109 8 0.000000 10000.000000 /end AXIS_PTS
/begin RECORD_LAYOUT KL_LU_FAKT_3_n40_AXIS FIX_NO_AXIS_PTS_X 8 AXIS_PTS_X 0 UBYTE INDEX_INCR DIRECT /end RECORD_LAYOUT
/begin CHARACTERISTIC KL_LU_FAKT_4 "-" CURVE 0x6024 VALUE_KL_LU_FAKT_4 100.000000 F00003 0.000000 3.000000
 /begin AXIS_DESCR COM_AXIS n40 F00109 8 0.000000 10000.000000 AXIS_PTS_REF KL_LU_FAKT_4_n40_AXIS /end AXIS_DESCR
 FUNCTION_LIST Laufunruhe /end CHARACTERISTIC
/begin RECORD_LAYOUT VALUE_KL_LU_FAKT_4 FNC_VALUES 0 UBYTE ROW_DIR DIRECT /end RECORD_LAYOUT
/begin AXIS_PTS KL_LU_FAKT_4_n40_AXIS "-" 0x601C n40 KL_LU_FAKT_4_n40_AXIS 100.000000 F00109 8 0.000000 10000.000000 /end AXIS_PTS
/begin RECORD_LAYOUT KL_LU_FAKT_4_n40_AXIS FIX_NO_AXIS_PTS_X 8 AXIS_PTS_X 0 UBYTE INDEX_INCR DIRECT /end RECORD_LAYOUT
/begin CHARACTERISTIC KL_LU_FAKT_5 "-" CURVE 0x6036 VALUE_KL_LU_FAKT_5 100.000000 F00003 0.000000 3.000000
 /begin AXIS_DESCR COM_AXIS n40 F00109 8 0.000000 10000.000000 AXIS_PTS_REF KL_LU_FAKT_5_n40_AXIS /end AXIS_DESCR
 FUNCTION_LIST Laufunruhe /end CHARACTERISTIC
/begin RECORD_LAYOUT VALUE_KL_LU_FAKT_5 FNC_VALUES 0 UBYTE ROW_DIR DIRECT /end RECORD_LAYOUT
/begin AXIS_PTS KL_LU_FAKT_5_n40_AXIS "-" 0x602E n40 KL_LU_FAKT_5_n40_AXIS 100.000000 F00109 8 0.000000 10000.000000 /end AXIS_PTS
/begin RECORD_LAYOUT KL_LU_FAKT_5_n40_AXIS FIX_NO_AXIS_PTS_X 8 AXIS_PTS_X 0 UBYTE INDEX_INCR DIRECT /end RECORD_LAYOUT
/begin CHARACTERISTIC KL_LU_FAKT_6 "-" CURVE 0x6048 VALUE_KL_LU_FAKT_6 100.000000 F00003 0.000000 3.000000
 /begin AXIS_DESCR COM_AXIS n40 F00109 8 0.000000 10000.000000 AXIS_PTS_REF KL_LU_FAKT_6_n40_AXIS /end AXIS_DESCR
 FUNCTION_LIST Laufunruhe /end CHARACTERISTIC
/begin RECORD_LAYOUT VALUE_KL_LU_FAKT_6 FNC_VALUES 0 UBYTE ROW_DIR DIRECT /end RECORD_LAYOUT
/begin AXIS_PTS KL_LU_FAKT_6_n40_AXIS "-" 0x6040 n40 KL_LU_FAKT_6_n40_AXIS 100.000000 F00109 8 0.000000 10000.000000 /end AXIS_PTS
/begin RECORD_LAYOUT KL_LU_FAKT_6_n40_AXIS FIX_NO_AXIS_PTS_X 8 AXIS_PTS_X 0 UBYTE INDEX_INCR DIRECT /end RECORD_LAYOUT
/begin CHARACTERISTIC KL_LU_FAKT_7 "-" CURVE 0x605A VALUE_KL_LU_FAKT_7 100.000000 F00003 0.000000 3.000000
 /begin AXIS_DESCR COM_AXIS n40 F00109 8 0.000000 10000.000000 AXIS_PTS_REF KL_LU_FAKT_7_n40_AXIS /end AXIS_DESCR
 FUNCTION_LIST Laufunruhe /end CHARACTERISTIC
/begin RECORD_LAYOUT VALUE_KL_LU_FAKT_7 FNC_VALUES 0 UBYTE ROW_DIR DIRECT /end RECORD_LAYOUT
/begin AXIS_PTS KL_LU_FAKT_7_n40_AXIS "-" 0x6052 n40 KL_LU_FAKT_7_n40_AXIS 100.000000 F00109 8 0.000000 10000.000000 /end AXIS_PTS
/begin RECORD_LAYOUT KL_LU_FAKT_7_n40_AXIS FIX_NO_AXIS_PTS_X 8 AXIS_PTS_X 0 UBYTE INDEX_INCR DIRECT /end RECORD_LAYOUT
/begin CHARACTERISTIC KL_LU_FAKT_8 "-" CURVE 0x606C VALUE_KL_LU_FAKT_8 100.000000 F00003 0.000000 3.000000
 /begin AXIS_DESCR COM_AXIS n40 F00109 8 0.000000 10000.000000 AXIS_PTS_REF KL_LU_FAKT_8_n40_AXIS /end AXIS_DESCR
 FUNCTION_LIST Laufunruhe /end CHARACTERISTIC
/begin RECORD_LAYOUT VALUE_KL_LU_FAKT_8 FNC_VALUES 0 UBYTE ROW_DIR DIRECT /end RECORD_LAYOUT
/begin AXIS_PTS KL_LU_FAKT_8_n40_AXIS "-" 0x6064 n40 KL_LU_FAKT_8_n40_AXIS 100.000000 F00109 8 0.000000 10000.000000 /end AXIS_PTS
/begin RECORD_LAYOUT KL_LU_FAKT_8_n40_AXIS FIX_NO_AXIS_PTS_X 8 AXIS_PTS_X 0 UBYTE INDEX_INCR DIRECT /end RECORD_LAYOUT
/begin CHARACTERISTIC KL_LU_FAKT_KRU "-" CURVE 0x607E VALUE_KL_LU_FAKT_KRU 100.000000 F00003 0.000000 3.000000
 /begin AXIS_DESCR COM_AXIS n40 F00109 8 0.000000 10000.000000 AXIS_PTS_REF KL_LU_FAKT_KRU_n40_AXIS /end AXIS_DESCR
 FUNCTION_LIST Laufunruhe /end CHARACTERISTIC
/begin RECORD_LAYOUT VALUE_KL_LU_FAKT_KRU FNC_VALUES 0 UBYTE ROW_DIR DIRECT /end RECORD_LAYOUT
/begin AXIS_PTS KL_LU_FAKT_KRU_n40_AXIS "-" 0x6076 n40 KL_LU_FAKT_KRU_n40_AXIS 100.000000 F00109 8 0.000000 10000.000000 /end AXIS_PTS
/begin RECORD_LAYOUT KL_LU_FAKT_KRU_n40_AXIS FIX_NO_AXIS_PTS_X 8 AXIS_PTS_X 0 UBYTE INDEX_INCR DIRECT /end RECORD_LAYOUT
/begin CHARACTERISTIC KL_LU_FILT_KRU "-" CURVE 0x6090 VALUE_KL_LU_FILT_KRU 100.000000 F00099 0.000000 0.000000
 /begin AXIS_DESCR COM_AXIS n40 F00109 8 0.000000 10000.000000 AXIS_PTS_REF KL_LU_FILT_KRU_n40_AXIS /end AXIS_DESCR
 FUNCTION_LIST Laufunruhe /end CHARACTERISTIC
/begin RECORD_LAYOUT VALUE_KL_LU_FILT_KRU FNC_VALUES 0 UBYTE ROW_DIR DIRECT /end RECORD_LAYOUT
/begin AXIS_PTS KL_LU_FILT_KRU_n40_AXIS "-" 0x6088 n40 KL_LU_FILT_KRU_n40_AXIS 100.000000 F00109 8 0.000000 10000.000000 /end AXIS_PTS
/begin RECORD_LAYOUT KL_LU_FILT_KRU_n40_AXIS FIX_NO_AXIS_PTS_X 8 AXIS_PTS_X 0 UBYTE INDEX_INCR DIRECT /end RECORD_LAYOUT
/begin CHARACTERISTIC KL_LU_SCHW_TMOT "-" CURVE 0x60A0 VALUE_KL_LU_SCHW_TMOT 100.000000 F00131 0.000000 7.000000
 /begin AXIS_DESCR COM_AXIS tmot F00014 6 -48.000000 207.000000 AXIS_PTS_REF KL_LU_SCHW_TMOT_tmot_AXIS /end AXIS_DESCR
 FUNCTION_LIST Laufunruhe /end CHARACTERISTIC
/begin RECORD_LAYOUT VALUE_KL_LU_SCHW_TMOT FNC_VALUES 0 UBYTE ROW_DIR DIRECT /end RECORD_LAYOUT
/begin AXIS_PTS KL_LU_SCHW_TMOT_tmot_AXIS "-" 0x609A tmot KL_LU_SCHW_TMOT_tmot_AXIS 100.000000 F00014 6 -48.000000 207.000000 /end AXIS_PTS
/begin RECORD_LAYOUT KL_LU_SCHW_TMOT_tmot_AXIS FIX_NO_AXIS_PTS_X 6 AXIS_PTS_X 0 UBYTE INDEX_INCR DIRECT /end RECORD_LAYOUT
/begin CHARACTERISTIC KL_LU_RF_MIN "-" CURVE 0x60B8 VALUE_KL_LU_RF_MIN 100.000000 F00068 0.000000 2.000000
 /begin AXIS_DESCR COM_AXIS n F00007 8 0.000000 10000.000000 AXIS_PTS_REF KL_LU_RF_MIN_n_AXIS /end AXIS_DESCR
 FUNCTION_LIST Laufunruhe /end CHARACTERISTIC
/begin RECORD_LAYOUT VALUE_KL_LU_RF_MIN FNC_VALUES 0 UWORD ROW_DIR DIRECT /end RECORD_LAYOUT
/begin AXIS_PTS KL_LU_RF_MIN_n_AXIS "-" 0x60A8 n KL_LU_RF_MIN_n_AXIS 100.000000 F00007 8 0.000000 10000.000000 /end AXIS_PTS
/begin RECORD_LAYOUT KL_LU_RF_MIN_n_AXIS FIX_NO_AXIS_PTS_X 8 AXIS_PTS_X 0 UWORD INDEX_INCR DIRECT /end RECORD_LAYOUT
/begin CHARACTERISTIC KL_LU_MD_DELTA_POS "-" CURVE 0x60DA VALUE_KL_LU_MD_DELTA_POS 100.000000 F00339 0.000000 250.000000
 /begin AXIS_DESCR COM_AXIS md F00145 8 0.000000 1000.000000 AXIS_PTS_REF KL_LU_MD_DELTA_POS_md_AXIS /end AXIS_DESCR
 FUNCTION_LIST Laufunruhe /end CHARACTERISTIC
/begin RECORD_LAYOUT VALUE_KL_LU_MD_DELTA_POS FNC_VALUES 0 UWORD ROW_DIR DIRECT /end RECORD_LAYOUT
/begin AXIS_PTS KL_LU_MD_DELTA_POS_md_AXIS "-" 0x60CA md KL_LU_MD_DELTA_POS_md_AXIS 100.000000 F00145 8 0.000000 1000.000000 /end AXIS_PTS
/begin RECORD_LAYOUT KL_LU_MD_DELTA_POS_md_AXIS FIX_NO_AXIS_PTS_X 8 AXIS_PTS_X 0 UWORD INDEX_INCR DIRECT /end RECORD_LAYOUT
/begin CHARACTERISTIC KL_LU_MD_DELTA_NEG "-" CURVE 0x60FC VALUE_KL_LU_MD_DELTA_NEG 100.000000 F00339 0.000000 100.000000
 /begin AXIS_DESCR COM_AXIS md F00145 8 0.000000 1000.000000 AXIS_PTS_REF KL_LU_MD_DELTA_NEG_md_AXIS /end AXIS_DESCR
 FUNCTION_LIST Laufunruhe /end CHARACTERISTIC
/begin RECORD_LAYOUT VALUE_KL_LU_MD_DELTA_NEG FNC_VALUES 0 UWORD ROW_DIR DIRECT /end RECORD_LAYOUT
/begin AXIS_PTS KL_LU_MD_DELTA_NEG_md_AXIS "-" 0x60EC md KL_LU_MD_DELTA_NEG_md_AXIS 100.000000 F00145 8 0.000000 1000.000000 /end AXIS_PTS
/begin RECORD_LAYOUT KL_LU_MD_DELTA_NEG_md_AXIS FIX_NO_AXIS_PTS_X 8 AXIS_PTS_X 0 UWORD INDEX_INCR DIRECT /end RECORD_LAYOUT
/begin CHARACTERISTIC KF_LU_OFFS_1 "-" MAP 0x6125 VALUE_KF_LU_OFFS_1 100.000000 F00340 -256.000000 254.000000
 /begin AXIS_DESCR COM_AXIS n40 F00109 15 0.000000 10000.000000 AXIS_PTS_REF KF_LU_OFFS_1_n40_AXIS /end AXIS_DESCR
 /begin AXIS_DESCR COM_AXIS rf5 F00116 8 0.000000 1.000000 AXIS_PTS_REF KF_LU_OFFS_1_rf5_AXIS /end AXIS_DESCR
 FUNCTION_LIST Laufunruhe /end CHARACTERISTIC
/begin RECORD_LAYOUT VALUE_KF_LU_OFFS_1 FNC_VALUES 0 SBYTE ROW_DIR DIRECT /end RECORD_LAYOUT
/begin AXIS_PTS KF_LU_OFFS_1_n40_AXIS "-" 0x610E n40 KF_LU_OFFS_1_n40_AXIS 100.000000 F00109 15 0.000000 10000.000000 /end AXIS_PTS
/begin RECORD_LAYOUT KF_LU_OFFS_1_n40_AXIS FIX_NO_AXIS_PTS_X 15 AXIS_PTS_X 0 UBYTE INDEX_INCR DIRECT /end RECORD_LAYOUT
/begin AXIS_PTS KF_LU_OFFS_1_rf5_AXIS "-" 0x611D rf5 KF_LU_OFFS_1_rf5_AXIS 100.000000 F00116 8 0.000000 1.000000 /end AXIS_PTS
/begin RECORD_LAYOUT KF_LU_OFFS_1_rf5_AXIS FIX_NO_AXIS_PTS_Y 8 AXIS_PTS_Y 0 UBYTE INDEX_INCR DIRECT /end RECORD_LAYOUT
/begin CHARACTERISTIC KF_LU_OFFS_2 "-" MAP 0x61B7 VALUE_KF_LU_OFFS_2 100.000000 F00340 -256.000000 254.000000
 /begin AXIS_DESCR COM_AXIS n40 F00109 15 0.000000 10000.000000 AXIS_PTS_REF KF_LU_OFFS_2_n40_AXIS /end AXIS_DESCR
 /begin AXIS_DESCR COM_AXIS rf5 F00116 8 0.000000 1.000000 AXIS_PTS_REF KF_LU_OFFS_2_rf5_AXIS /end AXIS_DESCR
 FUNCTION_LIST Laufunruhe /end CHARACTERISTIC
/begin RECORD_LAYOUT VALUE_KF_LU_OFFS_2 FNC_VALUES 0 SBYTE ROW_DIR DIRECT /end RECORD_LAYOUT
/begin AXIS_PTS KF_LU_OFFS_2_n40_AXIS "-" 0x61A0 n40 KF_LU_OFFS_2_n40_AXIS 100.000000 F00109 15 0.000000 10000.000000 /end AXIS_PTS
/begin RECORD_LAYOUT KF_LU_OFFS_2_n40_AXIS FIX_NO_AXIS_PTS_X 15 AXIS_PTS_X 0 UBYTE INDEX_INCR DIRECT /end RECORD_LAYOUT
/begin AXIS_PTS KF_LU_OFFS_2_rf5_AXIS "-" 0x61AF rf5 KF_LU_OFFS_2_rf5_AXIS 100.000000 F00116 8 0.000000 1.000000 /end AXIS_PTS
/begin RECORD_LAYOUT KF_LU_OFFS_2_rf5_AXIS FIX_NO_AXIS_PTS_Y 8 AXIS_PTS_Y 0 UBYTE INDEX_INCR DIRECT /end RECORD_LAYOUT
/begin CHARACTERISTIC KF_LU_OFFS_3 "-" MAP 0x6249 VALUE_KF_LU_OFFS_3 100.000000 F00340 -256.000000 254.000000
 /begin AXIS_DESCR COM_AXIS n40 F00109 15 0.000000 10000.000000 AXIS_PTS_REF KF_LU_OFFS_3_n40_AXIS /end AXIS_DESCR
 /begin AXIS_DESCR COM_AXIS rf5 F00116 8 0.000000 1.000000 AXIS_PTS_REF KF_LU_OFFS_3_rf5_AXIS /end AXIS_DESCR
 FUNCTION_LIST Laufunruhe /end CHARACTERISTIC
/begin RECORD_LAYOUT VALUE_KF_LU_OFFS_3 FNC_VALUES 0 SBYTE ROW_DIR DIRECT /end RECORD_LAYOUT
/begin AXIS_PTS KF_LU_OFFS_3_n40_AXIS "-" 0x6232 n40 KF_LU_OFFS_3_n40_AXIS 100.000000 F00109 15 0.000000 10000.000000 /end AXIS_PTS
/begin RECORD_LAYOUT KF_LU_OFFS_3_n40_AXIS FIX_NO_AXIS_PTS_X 15 AXIS_PTS_X 0 UBYTE INDEX_INCR DIRECT /end RECORD_LAYOUT
/begin AXIS_PTS KF_LU_OFFS_3_rf5_AXIS "-" 0x6241 rf5 KF_LU_OFFS_3_rf5_AXIS 100.000000 F00116 8 0.000000 1.000000 /end AXIS_PTS
/begin RECORD_LAYOUT KF_LU_OFFS_3_rf5_AXIS FIX_NO_AXIS_PTS_Y 8 AXIS_PTS_Y 0 UBYTE INDEX_INCR DIRECT /end RECORD_LAYOUT
/begin CHARACTERISTIC KF_LU_OFFS_4 "-" MAP 0x62DB VALUE_KF_LU_OFFS_4 100.000000 F00340 -256.000000 254.000000
 /begin AXIS_DESCR COM_AXIS n40 F00109 15 0.000000 10000.000000 AXIS_PTS_REF KF_LU_OFFS_4_n40_AXIS /end AXIS_DESCR
 /begin AXIS_DESCR COM_AXIS rf5 F00116 8 0.000000 1.000000 AXIS_PTS_REF KF_LU_OFFS_4_rf5_AXIS /end AXIS_DESCR
 FUNCTION_LIST Laufunruhe /end CHARACTERISTIC
/begin RECORD_LAYOUT VALUE_KF_LU_OFFS_4 FNC_VALUES 0 SBYTE ROW_DIR DIRECT /end RECORD_LAYOUT
/begin AXIS_PTS KF_LU_OFFS_4_n40_AXIS "-" 0x62C4 n40 KF_LU_OFFS_4_n40_AXIS 100.000000 F00109 15 0.000000 10000.000000 /end AXIS_PTS
/begin RECORD_LAYOUT KF_LU_OFFS_4_n40_AXIS FIX_NO_AXIS_PTS_X 15 AXIS_PTS_X 0 UBYTE INDEX_INCR DIRECT /end RECORD_LAYOUT
/begin AXIS_PTS KF_LU_OFFS_4_rf5_AXIS "-" 0x62D3 rf5 KF_LU_OFFS_4_rf5_AXIS 100.000000 F00116 8 0.000000 1.000000 /end AXIS_PTS
/begin RECORD_LAYOUT KF_LU_OFFS_4_rf5_AXIS FIX_NO_AXIS_PTS_Y 8 AXIS_PTS_Y 0 UBYTE INDEX_INCR DIRECT /end RECORD_LAYOUT
/begin CHARACTERISTIC KF_LU_OFFS_5 "-" MAP 0x636D VALUE_KF_LU_OFFS_5 100.000000 F00340 -256.000000 254.000000
 /begin AXIS_DESCR COM_AXIS n40 F00109 15 0.000000 10000.000000 AXIS_PTS_REF KF_LU_OFFS_5_n40_AXIS /end AXIS_DESCR
 /begin AXIS_DESCR COM_AXIS rf5 F00116 8 0.000000 1.000000 AXIS_PTS_REF KF_LU_OFFS_5_rf5_AXIS /end AXIS_DESCR
 FUNCTION_LIST Laufunruhe /end CHARACTERISTIC
/begin RECORD_LAYOUT VALUE_KF_LU_OFFS_5 FNC_VALUES 0 SBYTE ROW_DIR DIRECT /end RECORD_LAYOUT
/begin AXIS_PTS KF_LU_OFFS_5_n40_AXIS "-" 0x6356 n40 KF_LU_OFFS_5_n40_AXIS 100.000000 F00109 15 0.000000 10000.000000 /end AXIS_PTS
/begin RECORD_LAYOUT KF_LU_OFFS_5_n40_AXIS FIX_NO_AXIS_PTS_X 15 AXIS_PTS_X 0 UBYTE INDEX_INCR DIRECT /end RECORD_LAYOUT
/begin AXIS_PTS KF_LU_OFFS_5_rf5_AXIS "-" 0x6365 rf5 KF_LU_OFFS_5_rf5_AXIS 100.000000 F00116 8 0.000000 1.000000 /end AXIS_PTS
/begin RECORD_LAYOUT KF_LU_OFFS_5_rf5_AXIS FIX_NO_AXIS_PTS_Y 8 AXIS_PTS_Y 0 UBYTE INDEX_INCR DIRECT /end RECORD_LAYOUT
/begin CHARACTERISTIC KF_LU_OFFS_6 "-" MAP 0x63FF VALUE_KF_LU_OFFS_6 100.000000 F00340 -256.000000 254.000000
 /begin AXIS_DESCR COM_AXIS n40 F00109 15 0.000000 10000.000000 AXIS_PTS_REF KF_LU_OFFS_6_n40_AXIS /end AXIS_DESCR
 /begin AXIS_DESCR COM_AXIS rf5 F00116 8 0.000000 1.000000 AXIS_PTS_REF KF_LU_OFFS_6_rf5_AXIS /end AXIS_DESCR
 FUNCTION_LIST Laufunruhe /end CHARACTERISTIC
/begin RECORD_LAYOUT VALUE_KF_LU_OFFS_6 FNC_VALUES 0 SBYTE ROW_DIR DIRECT /end RECORD_LAYOUT
/begin AXIS_PTS KF_LU_OFFS_6_n40_AXIS "-" 0x63E8 n40 KF_LU_OFFS_6_n40_AXIS 100.000000 F00109 15 0.000000 10000.000000 /end AXIS_PTS
/begin RECORD_LAYOUT KF_LU_OFFS_6_n40_AXIS FIX_NO_AXIS_PTS_X 15 AXIS_PTS_X 0 UBYTE INDEX_INCR DIRECT /end RECORD_LAYOUT
/begin AXIS_PTS KF_LU_OFFS_6_rf5_AXIS "-" 0x63F7 rf5 KF_LU_OFFS_6_rf5_AXIS 100.000000 F00116 8 0.000000 1.000000 /end AXIS_PTS
/begin RECORD_LAYOUT KF_LU_OFFS_6_rf5_AXIS FIX_NO_AXIS_PTS_Y 8 AXIS_PTS_Y 0 UBYTE INDEX_INCR DIRECT /end RECORD_LAYOUT
/begin CHARACTERISTIC KF_LU_OFFS_7 "-" MAP 0x6491 VALUE_KF_LU_OFFS_7 100.000000 F00340 -256.000000 254.000000
 /begin AXIS_DESCR COM_AXIS n40 F00109 15 0.000000 10000.000000 AXIS_PTS_REF KF_LU_OFFS_7_n40_AXIS /end AXIS_DESCR
 /begin AXIS_DESCR COM_AXIS rf5 F00116 8 0.000000 1.000000 AXIS_PTS_REF KF_LU_OFFS_7_rf5_AXIS /end AXIS_DESCR
 FUNCTION_LIST Laufunruhe /end CHARACTERISTIC
/begin RECORD_LAYOUT VALUE_KF_LU_OFFS_7 FNC_VALUES 0 SBYTE ROW_DIR DIRECT /end RECORD_LAYOUT
/begin AXIS_PTS KF_LU_OFFS_7_n40_AXIS "-" 0x647A n40 KF_LU_OFFS_7_n40_AXIS 100.000000 F00109 15 0.000000 10000.000000 /end AXIS_PTS
/begin RECORD_LAYOUT KF_LU_OFFS_7_n40_AXIS FIX_NO_AXIS_PTS_X 15 AXIS_PTS_X 0 UBYTE INDEX_INCR DIRECT /end RECORD_LAYOUT
/begin AXIS_PTS KF_LU_OFFS_7_rf5_AXIS "-" 0x6489 rf5 KF_LU_OFFS_7_rf5_AXIS 100.000000 F00116 8 0.000000 1.000000 /end AXIS_PTS
/begin RECORD_LAYOUT KF_LU_OFFS_7_rf5_AXIS FIX_NO_AXIS_PTS_Y 8 AXIS_PTS_Y 0 UBYTE INDEX_INCR DIRECT /end RECORD_LAYOUT
/begin CHARACTERISTIC KF_LU_OFFS_8 "-" MAP 0x6523 VALUE_KF_LU_OFFS_8 100.000000 F00340 -256.000000 254.000000
 /begin AXIS_DESCR COM_AXIS n40 F00109 15 0.000000 10000.000000 AXIS_PTS_REF KF_LU_OFFS_8_n40_AXIS /end AXIS_DESCR
 /begin AXIS_DESCR COM_AXIS rf5 F00116 8 0.000000 1.000000 AXIS_PTS_REF KF_LU_OFFS_8_rf5_AXIS /end AXIS_DESCR
 FUNCTION_LIST Laufunruhe /end CHARACTERISTIC
/begin RECORD_LAYOUT VALUE_KF_LU_OFFS_8 FNC_VALUES 0 SBYTE ROW_DIR DIRECT /end RECORD_LAYOUT
/begin AXIS_PTS KF_LU_OFFS_8_n40_AXIS "-" 0x650C n40 KF_LU_OFFS_8_n40_AXIS 100.000000 F00109 15 0.000000 10000.000000 /end AXIS_PTS
/begin RECORD_LAYOUT KF_LU_OFFS_8_n40_AXIS FIX_NO_AXIS_PTS_X 15 AXIS_PTS_X 0 UBYTE INDEX_INCR DIRECT /end RECORD_LAYOUT
/begin AXIS_PTS KF_LU_OFFS_8_rf5_AXIS "-" 0x651B rf5 KF_LU_OFFS_8_rf5_AXIS 100.000000 F00116 8 0.000000 1.000000 /end AXIS_PTS
/begin RECORD_LAYOUT KF_LU_OFFS_8_rf5_AXIS FIX_NO_AXIS_PTS_Y 8 AXIS_PTS_Y 0 UBYTE INDEX_INCR DIRECT /end RECORD_LAYOUT
/begin CHARACTERISTIC KF_LU_SCHWELLE "-" MAP 0x65C2 VALUE_KF_LU_SCHWELLE 100.000000 F00341 0.000000 32767.000000
 /begin AXIS_DESCR COM_AXIS n F00007 10 0.000000 10000.000000 AXIS_PTS_REF KF_LU_SCHWELLE_n_AXIS /end AXIS_DESCR
 /begin AXIS_DESCR COM_AXIS rf F00068 8 0.000000 2.000000 AXIS_PTS_REF KF_LU_SCHWELLE_rf_AXIS /end AXIS_DESCR
 FUNCTION_LIST Laufunruhe /end CHARACTERISTIC
/begin RECORD_LAYOUT VALUE_KF_LU_SCHWELLE FNC_VALUES 0 UWORD ROW_DIR DIRECT /end RECORD_LAYOUT
/begin AXIS_PTS KF_LU_SCHWELLE_n_AXIS "-" 0x659E n KF_LU_SCHWELLE_n_AXIS 100.000000 F00007 10 0.000000 10000.000000 /end AXIS_PTS
/begin RECORD_LAYOUT KF_LU_SCHWELLE_n_AXIS FIX_NO_AXIS_PTS_X 10 AXIS_PTS_X 0 UWORD INDEX_INCR DIRECT /end RECORD_LAYOUT
/begin AXIS_PTS KF_LU_SCHWELLE_rf_AXIS "-" 0x65B2 rf KF_LU_SCHWELLE_rf_AXIS 100.000000 F00068 8 0.000000 2.000000 /end AXIS_PTS
/begin RECORD_LAYOUT KF_LU_SCHWELLE_rf_AXIS FIX_NO_AXIS_PTS_Y 8 AXIS_PTS_Y 0 UWORD INDEX_INCR DIRECT /end RECORD_LAYOUT
/begin CHARACTERISTIC KL_MD_ZW_OPT_LL "-" CURVE 0x6D3C VALUE_KL_MD_ZW_OPT_LL 100.000000 F00045 -50.000000 60.000000
 /begin AXIS_DESCR COM_AXIS n F00007 6 0.000000 10000.000000 AXIS_PTS_REF KL_MD_ZW_OPT_LL_n_AXIS /end AXIS_DESCR
 FUNCTION_LIST Momentenmanager /end CHARACTERISTIC
/begin RECORD_LAYOUT VALUE_KL_MD_ZW_OPT_LL FNC_VALUES 0 SWORD ROW_DIR DIRECT /end RECORD_LAYOUT
/begin AXIS_PTS KL_MD_ZW_OPT_LL_n_AXIS "-" 0x6D30 n KL_MD_ZW_OPT_LL_n_AXIS 100.000000 F00007 6 0.000000 10000.000000 /end AXIS_PTS
/begin RECORD_LAYOUT KL_MD_ZW_OPT_LL_n_AXIS FIX_NO_AXIS_PTS_X 6 AXIS_PTS_X 0 UWORD INDEX_INCR DIRECT /end RECORD_LAYOUT
/begin CHARACTERISTIC KL_MD_ZW_TMOT "-" CURVE 0x6D56 VALUE_KL_MD_ZW_TMOT 100.000000 F00045 -50.000000 60.000000
 /begin AXIS_DESCR COM_AXIS tmot F00014 6 -48.000000 207.000000 AXIS_PTS_REF KL_MD_ZW_TMOT_tmot_AXIS /end AXIS_DESCR
 FUNCTION_LIST Momentenmanager /end CHARACTERISTIC
/begin RECORD_LAYOUT VALUE_KL_MD_ZW_TMOT FNC_VALUES 0 SWORD ROW_DIR DIRECT /end RECORD_LAYOUT
/begin AXIS_PTS KL_MD_ZW_TMOT_tmot_AXIS "-" 0x6D4A tmot KL_MD_ZW_TMOT_tmot_AXIS 100.000000 F00014 6 -48.000000 207.000000 /end AXIS_PTS
/begin RECORD_LAYOUT KL_MD_ZW_TMOT_tmot_AXIS FIX_NO_AXIS_PTS_X 6 AXIS_PTS_X 0 UWORD INDEX_INCR DIRECT /end RECORD_LAYOUT
/begin CHARACTERISTIC KL_MD_ZW_LA "-" CURVE 0x6DAA VALUE_KL_MD_ZW_LA 100.000000 F00045 -50.000000 60.000000
 /begin AXIS_DESCR /* faktor */ COM_AXIS faktor F00056 6 0.000000 1.000000 AXIS_PTS_REF KL_MD_ZW_LA_faktor_AXIS /end AXIS_DESCR
 FUNCTION_LIST Momentenmanager /end CHARACTERISTIC
/begin RECORD_LAYOUT VALUE_KL_MD_ZW_LA FNC_VALUES 0 SWORD ROW_DIR DIRECT /end RECORD_LAYOUT
/begin AXIS_PTS KL_MD_ZW_LA_faktor_AXIS "-" 0x6D9E faktor KL_MD_ZW_LA_faktor_AXIS 100.000000 F00056 6 0.000000 1.000000 /end AXIS_PTS
/begin RECORD_LAYOUT KL_MD_ZW_LA_faktor_AXIS FIX_NO_AXIS_PTS_X 6 AXIS_PTS_X 0 UWORD INDEX_INCR DIRECT /end RECORD_LAYOUT
/begin CHARACTERISTIC KF_MD_POLYNOM_A "-" MAP 0x6944 VALUE_KF_MD_POLYNOM_A 100.000000 F00345 -320.000000 320.000000
 /begin AXIS_DESCR COM_AXIS rf F00068 12 0.000000 2.000000 AXIS_PTS_REF KF_MD_POLYNOM_A_rf_AXIS /end AXIS_DESCR
 /begin AXIS_DESCR COM_AXIS n F00007 18 0.000000 10000.000000 AXIS_PTS_REF KF_MD_POLYNOM_A_n_AXIS /end AXIS_DESCR
 FUNCTION_LIST Momentenmanager /end CHARACTERISTIC
/begin RECORD_LAYOUT VALUE_KF_MD_POLYNOM_A FNC_VALUES 0 SWORD ROW_DIR DIRECT /end RECORD_LAYOUT
/begin AXIS_PTS KF_MD_POLYNOM_A_rf_AXIS "-" 0x6908 rf KF_MD_POLYNOM_A_rf_AXIS 100.000000 F00068 12 0.000000 2.000000 /end AXIS_PTS
/begin RECORD_LAYOUT KF_MD_POLYNOM_A_rf_AXIS FIX_NO_AXIS_PTS_X 12 AXIS_PTS_X 0 UWORD INDEX_INCR DIRECT /end RECORD_LAYOUT
/begin AXIS_PTS KF_MD_POLYNOM_A_n_AXIS "-" 0x6920 n KF_MD_POLYNOM_A_n_AXIS 100.000000 F00007 18 0.000000 10000.000000 /end AXIS_PTS
/begin RECORD_LAYOUT KF_MD_POLYNOM_A_n_AXIS FIX_NO_AXIS_PTS_Y 18 AXIS_PTS_Y 0 UWORD INDEX_INCR DIRECT /end RECORD_LAYOUT
/begin CHARACTERISTIC KF_MD_POLYNOM_B "-" MAP 0x6B0A VALUE_KF_MD_POLYNOM_B 100.000000 F00345 -320.000000 320.000000
 /begin AXIS_DESCR COM_AXIS rf F00068 4 0.000000 2.000000 AXIS_PTS_REF KF_MD_POLYNOM_B_rf_AXIS /end AXIS_DESCR
 /begin AXIS_DESCR COM_AXIS n F00007 6 0.000000 10000.000000 AXIS_PTS_REF KF_MD_POLYNOM_B_n_AXIS /end AXIS_DESCR
 FUNCTION_LIST Momentenmanager /end CHARACTERISTIC
/begin RECORD_LAYOUT VALUE_KF_MD_POLYNOM_B FNC_VALUES 0 SWORD ROW_DIR DIRECT /end RECORD_LAYOUT
/begin AXIS_PTS KF_MD_POLYNOM_B_rf_AXIS "-" 0x6AF6 rf KF_MD_POLYNOM_B_rf_AXIS 100.000000 F00068 4 0.000000 2.000000 /end AXIS_PTS
/begin RECORD_LAYOUT KF_MD_POLYNOM_B_rf_AXIS FIX_NO_AXIS_PTS_X 4 AXIS_PTS_X 0 UWORD INDEX_INCR DIRECT /end RECORD_LAYOUT
/begin AXIS_PTS KF_MD_POLYNOM_B_n_AXIS "-" 0x6AFE n KF_MD_POLYNOM_B_n_AXIS 100.000000 F00007 6 0.000000 10000.000000 /end AXIS_PTS
/begin RECORD_LAYOUT KF_MD_POLYNOM_B_n_AXIS FIX_NO_AXIS_PTS_Y 6 AXIS_PTS_Y 0 UWORD INDEX_INCR DIRECT /end RECORD_LAYOUT
/begin CHARACTERISTIC KF_MD_ZW_OPT "-" MAP 0x6B7E VALUE_KF_MD_ZW_OPT 100.000000 F00045 -50.000000 60.000000
 /begin AXIS_DESCR COM_AXIS rf F00068 12 0.000000 2.000000 AXIS_PTS_REF KF_MD_ZW_OPT_rf_AXIS /end AXIS_DESCR
 /begin AXIS_DESCR COM_AXIS n F00007 18 0.000000 10000.000000 AXIS_PTS_REF KF_MD_ZW_OPT_n_AXIS /end AXIS_DESCR
 FUNCTION_LIST Momentenmanager /end CHARACTERISTIC
/begin RECORD_LAYOUT VALUE_KF_MD_ZW_OPT FNC_VALUES 0 SWORD ROW_DIR DIRECT /end RECORD_LAYOUT
/begin AXIS_PTS KF_MD_ZW_OPT_rf_AXIS "-" 0x6B42 rf KF_MD_ZW_OPT_rf_AXIS 100.000000 F00068 12 0.000000 2.000000 /end AXIS_PTS
/begin RECORD_LAYOUT KF_MD_ZW_OPT_rf_AXIS FIX_NO_AXIS_PTS_X 12 AXIS_PTS_X 0 UWORD INDEX_INCR DIRECT /end RECORD_LAYOUT
/begin AXIS_PTS KF_MD_ZW_OPT_n_AXIS "-" 0x6B5A n KF_MD_ZW_OPT_n_AXIS 100.000000 F00007 18 0.000000 10000.000000 /end AXIS_PTS
/begin RECORD_LAYOUT KF_MD_ZW_OPT_n_AXIS FIX_NO_AXIS_PTS_Y 18 AXIS_PTS_Y 0 UWORD INDEX_INCR DIRECT /end RECORD_LAYOUT
/begin CHARACTERISTIC KF_MD_LAMBDA "-" MAP 0x6D71 VALUE_KF_MD_LAMBDA 100.000000 F00056 0.000000 1.000000
 /begin AXIS_DESCR COM_AXIS n40 F00109 7 0.000000 10000.000000 AXIS_PTS_REF KF_MD_LAMBDA_n40_AXIS /end AXIS_DESCR
 /begin AXIS_DESCR COM_AXIS rf5 F00116 6 0.000000 1.000000 AXIS_PTS_REF KF_MD_LAMBDA_rf5_AXIS /end AXIS_DESCR
 FUNCTION_LIST Momentenmanager /end CHARACTERISTIC
/begin RECORD_LAYOUT VALUE_KF_MD_LAMBDA FNC_VALUES 0 UBYTE ROW_DIR DIRECT /end RECORD_LAYOUT
/begin AXIS_PTS KF_MD_LAMBDA_n40_AXIS "-" 0x6D64 n40 KF_MD_LAMBDA_n40_AXIS 100.000000 F00109 7 0.000000 10000.000000 /end AXIS_PTS
/begin RECORD_LAYOUT KF_MD_LAMBDA_n40_AXIS FIX_NO_AXIS_PTS_X 7 AXIS_PTS_X 0 UBYTE INDEX_INCR DIRECT /end RECORD_LAYOUT
/begin AXIS_PTS KF_MD_LAMBDA_rf5_AXIS "-" 0x6D6B rf5 KF_MD_LAMBDA_rf5_AXIS 100.000000 F00116 6 0.000000 1.000000 /end AXIS_PTS
/begin RECORD_LAYOUT KF_MD_LAMBDA_rf5_AXIS FIX_NO_AXIS_PTS_Y 6 AXIS_PTS_Y 0 UBYTE INDEX_INCR DIRECT /end RECORD_LAYOUT
/begin CHARACTERISTIC KL_NFF_FENSTER_A "-" CURVE 0x57D2 VALUE_KL_NFF_FENSTER_A 100.000000 F00006 -30.000000 90.000000
 /begin AXIS_DESCR COM_AXIS n F00007 10 0.000000 10000.000000 AXIS_PTS_REF KL_NFF_FENSTER_A_n_AXIS /end AXIS_DESCR
 FUNCTION_LIST Klopfen /end CHARACTERISTIC
/begin RECORD_LAYOUT VALUE_KL_NFF_FENSTER_A FNC_VALUES 0 SWORD ROW_DIR DIRECT /end RECORD_LAYOUT
/begin AXIS_PTS KL_NFF_FENSTER_A_n_AXIS "-" 0x57BE n KL_NFF_FENSTER_A_n_AXIS 100.000000 F00007 10 0.000000 10000.000000 /end AXIS_PTS
/begin RECORD_LAYOUT KL_NFF_FENSTER_A_n_AXIS FIX_NO_AXIS_PTS_X 10 AXIS_PTS_X 0 UWORD INDEX_INCR DIRECT /end RECORD_LAYOUT
/begin CHARACTERISTIC KL_NFF_FENSTER_E "-" CURVE 0x57FC VALUE_KL_NFF_FENSTER_E 100.000000 F00006 -30.000000 90.000000
 /begin AXIS_DESCR COM_AXIS n F00007 10 0.000000 10000.000000 AXIS_PTS_REF KL_NFF_FENSTER_E_n_AXIS /end AXIS_DESCR
 FUNCTION_LIST Klopfen /end CHARACTERISTIC
/begin RECORD_LAYOUT VALUE_KL_NFF_FENSTER_E FNC_VALUES 0 SWORD ROW_DIR DIRECT /end RECORD_LAYOUT
/begin AXIS_PTS KL_NFF_FENSTER_E_n_AXIS "-" 0x57E8 n KL_NFF_FENSTER_E_n_AXIS 100.000000 F00007 10 0.000000 10000.000000 /end AXIS_PTS
/begin RECORD_LAYOUT KL_NFF_FENSTER_E_n_AXIS FIX_NO_AXIS_PTS_X 10 AXIS_PTS_X 0 UWORD INDEX_INCR DIRECT /end RECORD_LAYOUT
/begin CHARACTERISTIC KL_SA_N40_HYS_GANG "-" CURVE 0x4D8A VALUE_KL_SA_N40_HYS_GANG 100.000000 F00109 0.000000 10000.000000
 /begin AXIS_DESCR COM_AXIS gang F00031 8 0.000000 255.000000 AXIS_PTS_REF KL_SA_N40_HYS_GANG_gang_AXIS /end AXIS_DESCR
 FUNCTION_LIST SA_WE /end CHARACTERISTIC
/begin RECORD_LAYOUT VALUE_KL_SA_N40_HYS_GANG FNC_VALUES 0 UBYTE ROW_DIR DIRECT /end RECORD_LAYOUT
/begin AXIS_PTS KL_SA_N40_HYS_GANG_gang_AXIS "-" 0x4D82 gang KL_SA_N40_HYS_GANG_gang_AXIS 100.000000 F00031 8 0.000000 255.000000 /end AXIS_PTS
/begin RECORD_LAYOUT KL_SA_N40_HYS_GANG_gang_AXIS FIX_NO_AXIS_PTS_X 8 AXIS_PTS_X 0 UBYTE INDEX_INCR DIRECT /end RECORD_LAYOUT
/begin CHARACTERISTIC KL_SA_N40_GANG "-" CURVE 0x4D9C VALUE_KL_SA_N40_GANG 100.000000 F00109 0.000000 10000.000000
 /begin AXIS_DESCR COM_AXIS gang F00031 8 0.000000 255.000000 AXIS_PTS_REF KL_SA_N40_GANG_gang_AXIS /end AXIS_DESCR
 FUNCTION_LIST SA_WE /end CHARACTERISTIC
/begin RECORD_LAYOUT VALUE_KL_SA_N40_GANG FNC_VALUES 0 UBYTE ROW_DIR DIRECT /end RECORD_LAYOUT
/begin AXIS_PTS KL_SA_N40_GANG_gang_AXIS "-" 0x4D94 gang KL_SA_N40_GANG_gang_AXIS 100.000000 F00031 8 0.000000 255.000000 /end AXIS_PTS
/begin RECORD_LAYOUT KL_SA_N40_GANG_gang_AXIS FIX_NO_AXIS_PTS_X 8 AXIS_PTS_X 0 UBYTE INDEX_INCR DIRECT /end RECORD_LAYOUT
/begin CHARACTERISTIC KL_SA_N40_TMOT "-" CURVE 0x4DAA VALUE_KL_SA_N40_TMOT 100.000000 F00109 0.000000 10000.000000
 /begin AXIS_DESCR COM_AXIS tmot F00014 4 -48.000000 207.000000 AXIS_PTS_REF KL_SA_N40_TMOT_tmot_AXIS /end AXIS_DESCR
 FUNCTION_LIST SA_WE /end CHARACTERISTIC
/begin RECORD_LAYOUT VALUE_KL_SA_N40_TMOT FNC_VALUES 0 UBYTE ROW_DIR DIRECT /end RECORD_LAYOUT
/begin AXIS_PTS KL_SA_N40_TMOT_tmot_AXIS "-" 0x4DA6 tmot KL_SA_N40_TMOT_tmot_AXIS 100.000000 F00014 4 -48.000000 207.000000 /end AXIS_PTS
/begin RECORD_LAYOUT KL_SA_N40_TMOT_tmot_AXIS FIX_NO_AXIS_PTS_X 4 AXIS_PTS_X 0 UBYTE INDEX_INCR DIRECT /end RECORD_LAYOUT
/begin CHARACTERISTIC KL_SA_N40_DN40 "-" CURVE 0x4DB4 VALUE_KL_SA_N40_DN40 100.000000 F00109 0.000000 10000.000000
 /begin AXIS_DESCR /* dn40 */ COM_AXIS dn40 F00347 4 0.000000 -5080.000000 AXIS_PTS_REF KL_SA_N40_DN40_dn40_AXIS /end AXIS_DESCR
 FUNCTION_LIST SA_WE /end CHARACTERISTIC
/begin RECORD_LAYOUT VALUE_KL_SA_N40_DN40 FNC_VALUES 0 UBYTE ROW_DIR DIRECT /end RECORD_LAYOUT
/begin AXIS_PTS KL_SA_N40_DN40_dn40_AXIS "-" 0x4DB0 dn40 KL_SA_N40_DN40_dn40_AXIS 100.000000 F00347 4 0.000000 -5080.000000 /end AXIS_PTS
/begin RECORD_LAYOUT KL_SA_N40_DN40_dn40_AXIS FIX_NO_AXIS_PTS_X 4 AXIS_PTS_X 0 UBYTE INDEX_INCR DIRECT /end RECORD_LAYOUT
/begin CHARACTERISTIC KF_SA_TIME_TMOT_N40 "-" MAP 0x4DC4 VALUE_KF_SA_TIME_TMOT_N40 100.000000 F00348 0.000000 8.000000
 /begin AXIS_DESCR COM_AXIS tmot F00014 4 -48.000000 207.000000 AXIS_PTS_REF KF_SA_TIME_TMOT_N40_tmot_AXIS /end AXIS_DESCR
 /begin AXIS_DESCR COM_AXIS n40 F00109 6 0.000000 10000.000000 AXIS_PTS_REF KF_SA_TIME_TMOT_N40_n40_AXIS /end AXIS_DESCR
 FUNCTION_LIST SA_WE /end CHARACTERISTIC
/begin RECORD_LAYOUT VALUE_KF_SA_TIME_TMOT_N40 FNC_VALUES 0 UBYTE ROW_DIR DIRECT /end RECORD_LAYOUT
/begin AXIS_PTS KF_SA_TIME_TMOT_N40_tmot_AXIS "-" 0x4DBA tmot KF_SA_TIME_TMOT_N40_tmot_AXIS 100.000000 F00014 4 -48.000000 207.000000 /end AXIS_PTS
/begin RECORD_LAYOUT KF_SA_TIME_TMOT_N40_tmot_AXIS FIX_NO_AXIS_PTS_X 4 AXIS_PTS_X 0 UBYTE INDEX_INCR DIRECT /end RECORD_LAYOUT
/begin AXIS_PTS KF_SA_TIME_TMOT_N40_n40_AXIS "-" 0x4DBE n40 KF_SA_TIME_TMOT_N40_n40_AXIS 100.000000 F00109 6 0.000000 10000.000000 /end AXIS_PTS
/begin RECORD_LAYOUT KF_SA_TIME_TMOT_N40_n40_AXIS FIX_NO_AXIS_PTS_Y 6 AXIS_PTS_Y 0 UBYTE INDEX_INCR DIRECT /end RECORD_LAYOUT
/begin CHARACTERISTIC KL_SK_TR_SW_S "-" CURVE 0x70F0 VALUE_KL_SK_TR_SW_S 100.000000 F00031 -32768.000000 32767.000000
 /begin AXIS_DESCR COM_AXIS x F00031 4 0.000000 65535.000000 AXIS_PTS_REF KL_SK_TR_SW_S_x_AXIS /end AXIS_DESCR
 FUNCTION_LIST Sicherheitskonzept /end CHARACTERISTIC
/begin RECORD_LAYOUT VALUE_KL_SK_TR_SW_S FNC_VALUES 0 SWORD ROW_DIR DIRECT /end RECORD_LAYOUT
/begin AXIS_PTS KL_SK_TR_SW_S_x_AXIS "-" 0x70E8 x KL_SK_TR_SW_S_x_AXIS 100.000000 F00031 4 0.000000 65535.000000 /end AXIS_PTS
/begin RECORD_LAYOUT KL_SK_TR_SW_S_x_AXIS FIX_NO_AXIS_PTS_X 4 AXIS_PTS_X 0 UWORD INDEX_INCR DIRECT /end RECORD_LAYOUT
/begin CHARACTERISTIC KL_SK_TR_UB_S "-" CURVE 0x70FE VALUE_KL_SK_TR_UB_S 100.000000 F00031 0.000000 255.000000
 /begin AXIS_DESCR COM_AXIS x F00031 4 0.000000 255.000000 AXIS_PTS_REF KL_SK_TR_UB_S_x_AXIS /end AXIS_DESCR
 FUNCTION_LIST Sicherheitskonzept /end CHARACTERISTIC
/begin RECORD_LAYOUT VALUE_KL_SK_TR_UB_S FNC_VALUES 0 UBYTE ROW_DIR DIRECT /end RECORD_LAYOUT
/begin AXIS_PTS KL_SK_TR_UB_S_x_AXIS "-" 0x70FA x KL_SK_TR_UB_S_x_AXIS 100.000000 F00031 4 0.000000 255.000000 /end AXIS_PTS
/begin RECORD_LAYOUT KL_SK_TR_UB_S_x_AXIS FIX_NO_AXIS_PTS_X 4 AXIS_PTS_X 0 UBYTE INDEX_INCR DIRECT /end RECORD_LAYOUT
/begin CHARACTERISTIC KF_SK_TR_UW_S "-" MAP 0x70AC VALUE_KF_SK_TR_UW_S 100.000000 F00031 0.000000 65535.000000
 /begin AXIS_DESCR COM_AXIS x F00031 4 0.000000 65535.000000 AXIS_PTS_REF KF_SK_TR_UW_S_x_AXIS /end AXIS_DESCR
 /begin AXIS_DESCR COM_AXIS y F00031 4 0.000000 65535.000000 AXIS_PTS_REF KF_SK_TR_UW_S_y_AXIS /end AXIS_DESCR
 FUNCTION_LIST Sicherheitskonzept /end CHARACTERISTIC
/begin RECORD_LAYOUT VALUE_KF_SK_TR_UW_S FNC_VALUES 0 UWORD ROW_DIR DIRECT /end RECORD_LAYOUT
/begin AXIS_PTS KF_SK_TR_UW_S_x_AXIS "-" 0x709C x KF_SK_TR_UW_S_x_AXIS 100.000000 F00031 4 0.000000 65535.000000 /end AXIS_PTS
/begin RECORD_LAYOUT KF_SK_TR_UW_S_x_AXIS FIX_NO_AXIS_PTS_X 4 AXIS_PTS_X 0 UWORD INDEX_INCR DIRECT /end RECORD_LAYOUT
/begin AXIS_PTS KF_SK_TR_UW_S_y_AXIS "-" 0x70A4 y KF_SK_TR_UW_S_y_AXIS 100.000000 F00031 4 0.000000 65535.000000 /end AXIS_PTS
/begin RECORD_LAYOUT KF_SK_TR_UW_S_y_AXIS FIX_NO_AXIS_PTS_Y 4 AXIS_PTS_Y 0 UWORD INDEX_INCR DIRECT /end RECORD_LAYOUT
/begin CHARACTERISTIC KF_SK_TR_SB_S "-" MAP 0x70D6 VALUE_KF_SK_TR_SB_S 100.000000 F00031 -128.000000 127.000000
 /begin AXIS_DESCR COM_AXIS x F00031 4 0.000000 255.000000 AXIS_PTS_REF KF_SK_TR_SB_S_x_AXIS /end AXIS_DESCR
 /begin AXIS_DESCR COM_AXIS y F00031 4 0.000000 255.000000 AXIS_PTS_REF KF_SK_TR_SB_S_y_AXIS /end AXIS_DESCR
 FUNCTION_LIST Sicherheitskonzept /end CHARACTERISTIC
/begin RECORD_LAYOUT VALUE_KF_SK_TR_SB_S FNC_VALUES 0 SBYTE ROW_DIR DIRECT /end RECORD_LAYOUT
/begin AXIS_PTS KF_SK_TR_SB_S_x_AXIS "-" 0x70CE x KF_SK_TR_SB_S_x_AXIS 100.000000 F00031 4 0.000000 255.000000 /end AXIS_PTS
/begin RECORD_LAYOUT KF_SK_TR_SB_S_x_AXIS FIX_NO_AXIS_PTS_X 4 AXIS_PTS_X 0 UBYTE INDEX_INCR DIRECT /end RECORD_LAYOUT
/begin AXIS_PTS KF_SK_TR_SB_S_y_AXIS "-" 0x70D2 y KF_SK_TR_SB_S_y_AXIS 100.000000 F00031 4 0.000000 255.000000 /end AXIS_PTS
/begin RECORD_LAYOUT KF_SK_TR_SB_S_y_AXIS FIX_NO_AXIS_PTS_Y 4 AXIS_PTS_Y 0 UBYTE INDEX_INCR DIRECT /end RECORD_LAYOUT
/begin CHARACTERISTIC KL_SMG_T_KORR_AB "-" CURVE 0x5A12 VALUE_KL_SMG_T_KORR_AB 100.000000 F00368 0.000000 100.000000
 /begin AXIS_DESCR /* rel_fw */ COM_AXIS rel_fw F00369 6 0.000000 199.000000 AXIS_PTS_REF KL_SMG_T_KORR_AB_rel_fw_AXIS /end AXIS_DESCR
 FUNCTION_LIST smg /end CHARACTERISTIC
/begin RECORD_LAYOUT VALUE_KL_SMG_T_KORR_AB FNC_VALUES 0 UBYTE ROW_DIR DIRECT /end RECORD_LAYOUT
/begin AXIS_PTS KL_SMG_T_KORR_AB_rel_fw_AXIS "-" 0x5A0C rel_fw KL_SMG_T_KORR_AB_rel_fw_AXIS 100.000000 F00369 6 0.000000 199.000000 /end AXIS_PTS
/begin RECORD_LAYOUT KL_SMG_T_KORR_AB_rel_fw_AXIS FIX_NO_AXIS_PTS_X 6 AXIS_PTS_X 0 UBYTE INDEX_INCR DIRECT /end RECORD_LAYOUT
/begin CHARACTERISTIC KL_SMG_N_ABRISS_SCHW "-" CURVE 0x5A1E VALUE_KL_SMG_N_ABRISS_SCHW 100.000000 F00109 0.000000 10000.000000
 /begin AXIS_DESCR /* md_kw */ COM_AXIS md_kw F00370 4 0.000000 600.000000 AXIS_PTS_REF KL_SMG_N_ABRISS_SCHW_md_kw_AXIS /end AXIS_DESCR
 FUNCTION_LIST smg /end CHARACTERISTIC
/begin RECORD_LAYOUT VALUE_KL_SMG_N_ABRISS_SCHW FNC_VALUES 0 UBYTE ROW_DIR DIRECT /end RECORD_LAYOUT
/begin AXIS_PTS KL_SMG_N_ABRISS_SCHW_md_kw_AXIS "-" 0x5A1A md_kw KL_SMG_N_ABRISS_SCHW_md_kw_AXIS 100.000000 F00370 4 0.000000 600.000000 /end AXIS_PTS
/begin RECORD_LAYOUT KL_SMG_N_ABRISS_SCHW_md_kw_AXIS FIX_NO_AXIS_PTS_X 4 AXIS_PTS_X 0 UBYTE INDEX_INCR DIRECT /end RECORD_LAYOUT
/begin CHARACTERISTIC KL_SMG_FW_REL_VIRT "-" CURVE 0x5A27 VALUE_KL_SMG_FW_REL_VIRT 100.000000 F00056 0.000000 1.000000
 /begin AXIS_DESCR /* rschlupf */ COM_AXIS rschlupf F00093 3 0.000000 100.000000 AXIS_PTS_REF KL_SMG_FW_REL_VIRT_rschlupf_AXIS /end AXIS_DESCR
 FUNCTION_LIST smg /end CHARACTERISTIC
/begin RECORD_LAYOUT VALUE_KL_SMG_FW_REL_VIRT FNC_VALUES 0 UBYTE ROW_DIR DIRECT /end RECORD_LAYOUT
/begin AXIS_PTS KL_SMG_FW_REL_VIRT_rschlupf_AXIS "-" 0x5A24 rschlupf KL_SMG_FW_REL_VIRT_rschlupf_AXIS 100.000000 F00093 3 0.000000 100.000000 /end AXIS_PTS
/begin RECORD_LAYOUT KL_SMG_FW_REL_VIRT_rschlupf_AXIS FIX_NO_AXIS_PTS_X 3 AXIS_PTS_X 0 UBYTE INDEX_INCR DIRECT /end RECORD_LAYOUT
/begin CHARACTERISTIC KL_SMG_KI_DAY_MAX "-" CURVE 0x5A2F VALUE_KL_SMG_KI_DAY_MAX 100.000000 F00013 0.000000 12.000000
 /begin AXIS_DESCR /* day */ COM_AXIS day F00371 3 0.000000 25.000000 AXIS_PTS_REF KL_SMG_KI_DAY_MAX_day_AXIS /end AXIS_DESCR
 FUNCTION_LIST smg /end CHARACTERISTIC
/begin RECORD_LAYOUT VALUE_KL_SMG_KI_DAY_MAX FNC_VALUES 0 UBYTE ROW_DIR DIRECT /end RECORD_LAYOUT
/begin AXIS_PTS KL_SMG_KI_DAY_MAX_day_AXIS "-" 0x5A2C day KL_SMG_KI_DAY_MAX_day_AXIS 100.000000 F00371 3 0.000000 25.000000 /end AXIS_PTS
/begin RECORD_LAYOUT KL_SMG_KI_DAY_MAX_day_AXIS FIX_NO_AXIS_PTS_X 3 AXIS_PTS_X 0 UBYTE INDEX_INCR DIRECT /end RECORD_LAYOUT
/begin CHARACTERISTIC KL_SMG_KUPP_M_AB_ZH "-" CURVE 0x5A3C VALUE_KL_SMG_KUPP_M_AB_ZH 100.000000 F00372 0.000000 199.000000
 /begin AXIS_DESCR COM_AXIS t_NORM F00373 8 0.000000 100.000000 AXIS_PTS_REF KL_SMG_KUPP_M_AB_ZH_t_NORM_AXIS /end AXIS_DESCR
 FUNCTION_LIST smg /end CHARACTERISTIC
/begin RECORD_LAYOUT VALUE_KL_SMG_KUPP_M_AB_ZH FNC_VALUES 0 UBYTE ROW_DIR DIRECT /end RECORD_LAYOUT
/begin AXIS_PTS KL_SMG_KUPP_M_AB_ZH_t_NORM_AXIS "-" 0x5A34 t_NORM KL_SMG_KUPP_M_AB_ZH_t_NORM_AXIS 100.000000 F00373 8 0.000000 100.000000 /end AXIS_PTS
/begin RECORD_LAYOUT KL_SMG_KUPP_M_AB_ZH_t_NORM_AXIS FIX_NO_AXIS_PTS_X 8 AXIS_PTS_X 0 UBYTE INDEX_INCR DIRECT /end RECORD_LAYOUT
/begin CHARACTERISTIC KL_SMG_KUPP_M_AB_ZR "-" CURVE 0x5A4E VALUE_KL_SMG_KUPP_M_AB_ZR 100.000000 F00372 0.000000 199.000000
 /begin AXIS_DESCR COM_AXIS t_NORM F00373 8 0.000000 100.000000 AXIS_PTS_REF KL_SMG_KUPP_M_AB_ZR_t_NORM_AXIS /end AXIS_DESCR
 FUNCTION_LIST smg /end CHARACTERISTIC
/begin RECORD_LAYOUT VALUE_KL_SMG_KUPP_M_AB_ZR FNC_VALUES 0 UBYTE ROW_DIR DIRECT /end RECORD_LAYOUT
/begin AXIS_PTS KL_SMG_KUPP_M_AB_ZR_t_NORM_AXIS "-" 0x5A46 t_NORM KL_SMG_KUPP_M_AB_ZR_t_NORM_AXIS 100.000000 F00373 8 0.000000 100.000000 /end AXIS_PTS
/begin RECORD_LAYOUT KL_SMG_KUPP_M_AB_ZR_t_NORM_AXIS FIX_NO_AXIS_PTS_X 8 AXIS_PTS_X 0 UBYTE INDEX_INCR DIRECT /end RECORD_LAYOUT
/begin CHARACTERISTIC KL_SMG_KUPP_M_AB_SH "-" CURVE 0x5A60 VALUE_KL_SMG_KUPP_M_AB_SH 100.000000 F00372 0.000000 199.000000
 /begin AXIS_DESCR COM_AXIS t_NORM F00373 8 0.000000 100.000000 AXIS_PTS_REF KL_SMG_KUPP_M_AB_SH_t_NORM_AXIS /end AXIS_DESCR
 FUNCTION_LIST smg /end CHARACTERISTIC
/begin RECORD_LAYOUT VALUE_KL_SMG_KUPP_M_AB_SH FNC_VALUES 0 UBYTE ROW_DIR DIRECT /end RECORD_LAYOUT
/begin AXIS_PTS KL_SMG_KUPP_M_AB_SH_t_NORM_AXIS "-" 0x5A58 t_NORM KL_SMG_KUPP_M_AB_SH_t_NORM_AXIS 100.000000 F00373 8 0.000000 100.000000 /end AXIS_PTS
/begin RECORD_LAYOUT KL_SMG_KUPP_M_AB_SH_t_NORM_AXIS FIX_NO_AXIS_PTS_X 8 AXIS_PTS_X 0 UBYTE INDEX_INCR DIRECT /end RECORD_LAYOUT
/begin CHARACTERISTIC KL_SMG_KUPP_M_AB_SR "-" CURVE 0x5A72 VALUE_KL_SMG_KUPP_M_AB_SR 100.000000 F00372 0.000000 199.000000
 /begin AXIS_DESCR COM_AXIS t_NORM F00373 8 0.000000 100.000000 AXIS_PTS_REF KL_SMG_KUPP_M_AB_SR_t_NORM_AXIS /end AXIS_DESCR
 FUNCTION_LIST smg /end CHARACTERISTIC
/begin RECORD_LAYOUT VALUE_KL_SMG_KUPP_M_AB_SR FNC_VALUES 0 UBYTE ROW_DIR DIRECT /end RECORD_LAYOUT
/begin AXIS_PTS KL_SMG_KUPP_M_AB_SR_t_NORM_AXIS "-" 0x5A6A t_NORM KL_SMG_KUPP_M_AB_SR_t_NORM_AXIS 100.000000 F00373 8 0.000000 100.000000 /end AXIS_PTS
/begin RECORD_LAYOUT KL_SMG_KUPP_M_AB_SR_t_NORM_AXIS FIX_NO_AXIS_PTS_X 8 AXIS_PTS_X 0 UBYTE INDEX_INCR DIRECT /end RECORD_LAYOUT
/begin CHARACTERISTIC KL_SMG_KUPP_M_SE "-" CURVE 0x5A82 VALUE_KL_SMG_KUPP_M_SE 100.000000 F00374 0.000000 99.000000
 /begin AXIS_DESCR COM_AXIS Kennung F00013 6 0.000000 255.000000 AXIS_PTS_REF KL_SMG_KUPP_M_SE_Kennung_AXIS /end AXIS_DESCR
 FUNCTION_LIST smg /end CHARACTERISTIC
/begin RECORD_LAYOUT VALUE_KL_SMG_KUPP_M_SE FNC_VALUES 0 UBYTE ROW_DIR DIRECT /end RECORD_LAYOUT
/begin AXIS_PTS KL_SMG_KUPP_M_SE_Kennung_AXIS "-" 0x5A7C Kennung KL_SMG_KUPP_M_SE_Kennung_AXIS 100.000000 F00013 6 0.000000 255.000000 /end AXIS_PTS
/begin RECORD_LAYOUT KL_SMG_KUPP_M_SE_Kennung_AXIS FIX_NO_AXIS_PTS_X 6 AXIS_PTS_X 0 UBYTE INDEX_INCR DIRECT /end RECORD_LAYOUT
/begin CHARACTERISTIC KL_SMG_KUPP_M_EKR "-" CURVE 0x5A90 VALUE_KL_SMG_KUPP_M_EKR 100.000000 F00374 0.000000 99.000000
 /begin AXIS_DESCR COM_AXIS Kennung F00013 6 0.000000 255.000000 AXIS_PTS_REF KL_SMG_KUPP_M_EKR_Kennung_AXIS /end AXIS_DESCR
 FUNCTION_LIST smg /end CHARACTERISTIC
/begin RECORD_LAYOUT VALUE_KL_SMG_KUPP_M_EKR FNC_VALUES 0 UBYTE ROW_DIR DIRECT /end RECORD_LAYOUT
/begin AXIS_PTS KL_SMG_KUPP_M_EKR_Kennung_AXIS "-" 0x5A8A Kennung KL_SMG_KUPP_M_EKR_Kennung_AXIS 100.000000 F00013 6 0.000000 255.000000 /end AXIS_PTS
/begin RECORD_LAYOUT KL_SMG_KUPP_M_EKR_Kennung_AXIS FIX_NO_AXIS_PTS_X 6 AXIS_PTS_X 0 UBYTE INDEX_INCR DIRECT /end RECORD_LAYOUT
/begin CHARACTERISTIC KL_SMG_KUPP_M_AUF_Z1 "-" CURVE 0x5AA0 VALUE_KL_SMG_KUPP_M_AUF_Z1 100.000000 F00372 0.000000 199.000000
 /begin AXIS_DESCR COM_AXIS t_NORM F00373 8 0.000000 100.000000 AXIS_PTS_REF KL_SMG_KUPP_M_AUF_Z1_t_NORM_AXIS /end AXIS_DESCR
 FUNCTION_LIST smg /end CHARACTERISTIC
/begin RECORD_LAYOUT VALUE_KL_SMG_KUPP_M_AUF_Z1 FNC_VALUES 0 UBYTE ROW_DIR DIRECT /end RECORD_LAYOUT
/begin AXIS_PTS KL_SMG_KUPP_M_AUF_Z1_t_NORM_AXIS "-" 0x5A98 t_NORM KL_SMG_KUPP_M_AUF_Z1_t_NORM_AXIS 100.000000 F00373 8 0.000000 100.000000 /end AXIS_PTS
/begin RECORD_LAYOUT KL_SMG_KUPP_M_AUF_Z1_t_NORM_AXIS FIX_NO_AXIS_PTS_X 8 AXIS_PTS_X 0 UBYTE INDEX_INCR DIRECT /end RECORD_LAYOUT
/begin CHARACTERISTIC KL_SMG_KUPP_M_AUF_S1 "-" CURVE 0x5AB2 VALUE_KL_SMG_KUPP_M_AUF_S1 100.000000 F00372 0.000000 199.000000
 /begin AXIS_DESCR COM_AXIS t_NORM F00373 8 0.000000 100.000000 AXIS_PTS_REF KL_SMG_KUPP_M_AUF_S1_t_NORM_AXIS /end AXIS_DESCR
 FUNCTION_LIST smg /end CHARACTERISTIC
/begin RECORD_LAYOUT VALUE_KL_SMG_KUPP_M_AUF_S1 FNC_VALUES 0 UBYTE ROW_DIR DIRECT /end RECORD_LAYOUT
/begin AXIS_PTS KL_SMG_KUPP_M_AUF_S1_t_NORM_AXIS "-" 0x5AAA t_NORM KL_SMG_KUPP_M_AUF_S1_t_NORM_AXIS 100.000000 F00373 8 0.000000 100.000000 /end AXIS_PTS
/begin RECORD_LAYOUT KL_SMG_KUPP_M_AUF_S1_t_NORM_AXIS FIX_NO_AXIS_PTS_X 8 AXIS_PTS_X 0 UBYTE INDEX_INCR DIRECT /end RECORD_LAYOUT
/begin CHARACTERISTIC KL_SMG_KUPP_STOP_DN "-" CURVE 0x5AC0 VALUE_KL_SMG_KUPP_STOP_DN 100.000000 F00109 0.000000 1000.000000
 /begin AXIS_DESCR COM_AXIS dn F00375 4 0.000000 25500.000000 AXIS_PTS_REF KL_SMG_KUPP_STOP_DN_dn_AXIS /end AXIS_DESCR
 FUNCTION_LIST smg /end CHARACTERISTIC
/begin RECORD_LAYOUT VALUE_KL_SMG_KUPP_STOP_DN FNC_VALUES 0 UBYTE ROW_DIR DIRECT /end RECORD_LAYOUT
/begin AXIS_PTS KL_SMG_KUPP_STOP_DN_dn_AXIS "-" 0x5ABC dn KL_SMG_KUPP_STOP_DN_dn_AXIS 100.000000 F00375 4 0.000000 25500.000000 /end AXIS_PTS
/begin RECORD_LAYOUT KL_SMG_KUPP_STOP_DN_dn_AXIS FIX_NO_AXIS_PTS_X 4 AXIS_PTS_X 0 UBYTE INDEX_INCR DIRECT /end RECORD_LAYOUT
/begin CHARACTERISTIC KL_SMG_KUPP_STOP_M "-" CURVE 0x5ACA VALUE_KL_SMG_KUPP_STOP_M 100.000000 F00372 0.000000 199.000000
 /begin AXIS_DESCR /* ki */ COM_AXIS ki F00013 4 0.000000 12.000000 AXIS_PTS_REF KL_SMG_KUPP_STOP_M_ki_AXIS /end AXIS_DESCR
 FUNCTION_LIST smg /end CHARACTERISTIC
/begin RECORD_LAYOUT VALUE_KL_SMG_KUPP_STOP_M FNC_VALUES 0 UBYTE ROW_DIR DIRECT /end RECORD_LAYOUT
/begin AXIS_PTS KL_SMG_KUPP_STOP_M_ki_AXIS "-" 0x5AC6 ki KL_SMG_KUPP_STOP_M_ki_AXIS 100.000000 F00013 4 0.000000 12.000000 /end AXIS_PTS
/begin RECORD_LAYOUT KL_SMG_KUPP_STOP_M_ki_AXIS FIX_NO_AXIS_PTS_X 4 AXIS_PTS_X 0 UBYTE INDEX_INCR DIRECT /end RECORD_LAYOUT
/begin CHARACTERISTIC KL_SMG_KUPP_REG_I_AU "-" CURVE 0x5AD4 VALUE_KL_SMG_KUPP_REG_I_AU 100.000000 F00358 0.000000 0.000000
 /begin AXIS_DESCR COM_AXIS n_diff F00109 4 0.000000 10000.000000 AXIS_PTS_REF KL_SMG_KUPP_REG_I_AU_n_diff_AXIS /end AXIS_DESCR
 FUNCTION_LIST smg /end CHARACTERISTIC
/begin RECORD_LAYOUT VALUE_KL_SMG_KUPP_REG_I_AU FNC_VALUES 0 UBYTE ROW_DIR DIRECT /end RECORD_LAYOUT
/begin AXIS_PTS KL_SMG_KUPP_REG_I_AU_n_diff_AXIS "-" 0x5AD0 n_diff KL_SMG_KUPP_REG_I_AU_n_diff_AXIS 100.000000 F00109 4 0.000000 10000.000000 /end AXIS_PTS
/begin RECORD_LAYOUT KL_SMG_KUPP_REG_I_AU_n_diff_AXIS FIX_NO_AXIS_PTS_X 4 AXIS_PTS_X 0 UBYTE INDEX_INCR DIRECT /end RECORD_LAYOUT
/begin CHARACTERISTIC KL_SMG_MOT_M_AB_ZH "-" CURVE 0x5AE2 VALUE_KL_SMG_MOT_M_AB_ZH 100.000000 F00372 0.000000 199.000000
 /begin AXIS_DESCR COM_AXIS t_NORM F00373 8 0.000000 199.000000 AXIS_PTS_REF KL_SMG_MOT_M_AB_ZH_t_NORM_AXIS /end AXIS_DESCR
 FUNCTION_LIST smg /end CHARACTERISTIC
/begin RECORD_LAYOUT VALUE_KL_SMG_MOT_M_AB_ZH FNC_VALUES 0 UBYTE ROW_DIR DIRECT /end RECORD_LAYOUT
/begin AXIS_PTS KL_SMG_MOT_M_AB_ZH_t_NORM_AXIS "-" 0x5ADA t_NORM KL_SMG_MOT_M_AB_ZH_t_NORM_AXIS 100.000000 F00373 8 0.000000 199.000000 /end AXIS_PTS
/begin RECORD_LAYOUT KL_SMG_MOT_M_AB_ZH_t_NORM_AXIS FIX_NO_AXIS_PTS_X 8 AXIS_PTS_X 0 UBYTE INDEX_INCR DIRECT /end RECORD_LAYOUT
/begin CHARACTERISTIC KL_SMG_MOT_M_AB_ZR "-" CURVE 0x5AF4 VALUE_KL_SMG_MOT_M_AB_ZR 100.000000 F00372 0.000000 199.000000
 /begin AXIS_DESCR COM_AXIS t_NORM F00373 8 0.000000 100.000000 AXIS_PTS_REF KL_SMG_MOT_M_AB_ZR_t_NORM_AXIS /end AXIS_DESCR
 FUNCTION_LIST smg /end CHARACTERISTIC
/begin RECORD_LAYOUT VALUE_KL_SMG_MOT_M_AB_ZR FNC_VALUES 0 UBYTE ROW_DIR DIRECT /end RECORD_LAYOUT
/begin AXIS_PTS KL_SMG_MOT_M_AB_ZR_t_NORM_AXIS "-" 0x5AEC t_NORM KL_SMG_MOT_M_AB_ZR_t_NORM_AXIS 100.000000 F00373 8 0.000000 100.000000 /end AXIS_PTS
/begin RECORD_LAYOUT KL_SMG_MOT_M_AB_ZR_t_NORM_AXIS FIX_NO_AXIS_PTS_X 8 AXIS_PTS_X 0 UBYTE INDEX_INCR DIRECT /end RECORD_LAYOUT
/begin CHARACTERISTIC KL_SMG_MOT_M_AB_SH "-" CURVE 0x5B06 VALUE_KL_SMG_MOT_M_AB_SH 100.000000 F00372 0.000000 199.000000
 /begin AXIS_DESCR COM_AXIS t_NORM F00373 8 0.000000 100.000000 AXIS_PTS_REF KL_SMG_MOT_M_AB_SH_t_NORM_AXIS /end AXIS_DESCR
 FUNCTION_LIST smg /end CHARACTERISTIC
/begin RECORD_LAYOUT VALUE_KL_SMG_MOT_M_AB_SH FNC_VALUES 0 UBYTE ROW_DIR DIRECT /end RECORD_LAYOUT
/begin AXIS_PTS KL_SMG_MOT_M_AB_SH_t_NORM_AXIS "-" 0x5AFE t_NORM KL_SMG_MOT_M_AB_SH_t_NORM_AXIS 100.000000 F00373 8 0.000000 100.000000 /end AXIS_PTS
/begin RECORD_LAYOUT KL_SMG_MOT_M_AB_SH_t_NORM_AXIS FIX_NO_AXIS_PTS_X 8 AXIS_PTS_X 0 UBYTE INDEX_INCR DIRECT /end RECORD_LAYOUT
/begin CHARACTERISTIC KL_SMG_MOT_M_AB_SR "-" CURVE 0x5B18 VALUE_KL_SMG_MOT_M_AB_SR 100.000000 F00372 0.000000 199.000000
 /begin AXIS_DESCR COM_AXIS t_NORM F00373 8 0.000000 100.000000 AXIS_PTS_REF KL_SMG_MOT_M_AB_SR_t_NORM_AXIS /end AXIS_DESCR
 FUNCTION_LIST smg /end CHARACTERISTIC
/begin RECORD_LAYOUT VALUE_KL_SMG_MOT_M_AB_SR FNC_VALUES 0 UBYTE ROW_DIR DIRECT /end RECORD_LAYOUT
/begin AXIS_PTS KL_SMG_MOT_M_AB_SR_t_NORM_AXIS "-" 0x5B10 t_NORM KL_SMG_MOT_M_AB_SR_t_NORM_AXIS 100.000000 F00373 8 0.000000 100.000000 /end AXIS_PTS
/begin RECORD_LAYOUT KL_SMG_MOT_M_AB_SR_t_NORM_AXIS FIX_NO_AXIS_PTS_X 8 AXIS_PTS_X 0 UBYTE INDEX_INCR DIRECT /end RECORD_LAYOUT
/begin CHARACTERISTIC KL_SMG_KUPP_M_AB_OFF "-" CURVE 0x5B28 VALUE_KL_SMG_KUPP_M_AB_OFF 100.000000 F00145 0.000000 1000.000000
 /begin AXIS_DESCR COM_AXIS md_fw F00145 3 0.000000 1000.000000 AXIS_PTS_REF KL_SMG_KUPP_M_AB_OFF_md_fw_AXIS /end AXIS_DESCR
 FUNCTION_LIST smg /end CHARACTERISTIC
/begin RECORD_LAYOUT VALUE_KL_SMG_KUPP_M_AB_OFF FNC_VALUES 0 UWORD ROW_DIR DIRECT /end RECORD_LAYOUT
/begin AXIS_PTS KL_SMG_KUPP_M_AB_OFF_md_fw_AXIS "-" 0x5B22 md_fw KL_SMG_KUPP_M_AB_OFF_md_fw_AXIS 100.000000 F00145 3 0.000000 1000.000000 /end AXIS_PTS
/begin RECORD_LAYOUT KL_SMG_KUPP_M_AB_OFF_md_fw_AXIS FIX_NO_AXIS_PTS_X 3 AXIS_PTS_X 0 UWORD INDEX_INCR DIRECT /end RECORD_LAYOUT
/begin CHARACTERISTIC KL_SMG_N_ZIEL_OFF_MA "-" CURVE 0x5B34 VALUE_KL_SMG_N_ZIEL_OFF_MA 100.000000 F00368 0.000000 100.000000
 /begin AXIS_DESCR COM_AXIS toel F00014 4 -48.000000 207.000000 AXIS_PTS_REF KL_SMG_N_ZIEL_OFF_MA_toel_AXIS /end AXIS_DESCR
 FUNCTION_LIST smg /end CHARACTERISTIC
/begin RECORD_LAYOUT VALUE_KL_SMG_N_ZIEL_OFF_MA FNC_VALUES 0 UBYTE ROW_DIR DIRECT /end RECORD_LAYOUT
/begin AXIS_PTS KL_SMG_N_ZIEL_OFF_MA_toel_AXIS "-" 0x5B30 toel KL_SMG_N_ZIEL_OFF_MA_toel_AXIS 100.000000 F00014 4 -48.000000 207.000000 /end AXIS_PTS
/begin RECORD_LAYOUT KL_SMG_N_ZIEL_OFF_MA_toel_AXIS FIX_NO_AXIS_PTS_X 4 AXIS_PTS_X 0 UBYTE INDEX_INCR DIRECT /end RECORD_LAYOUT
/begin CHARACTERISTIC KL_SMG_MOT_N_REG_P_K "-" CURVE 0x5B40 VALUE_KL_SMG_MOT_N_REG_P_K 100.000000 F00376 1.000000 2.000000
 /begin AXIS_DESCR COM_AXIS n_diff F00109 6 0.000000 10000.000000 AXIS_PTS_REF KL_SMG_MOT_N_REG_P_K_n_diff_AXIS /end AXIS_DESCR
 FUNCTION_LIST smg /end CHARACTERISTIC
/begin RECORD_LAYOUT VALUE_KL_SMG_MOT_N_REG_P_K FNC_VALUES 0 UBYTE ROW_DIR DIRECT /end RECORD_LAYOUT
/begin AXIS_PTS KL_SMG_MOT_N_REG_P_K_n_diff_AXIS "-" 0x5B3A n_diff KL_SMG_MOT_N_REG_P_K_n_diff_AXIS 100.000000 F00109 6 0.000000 10000.000000 /end AXIS_PTS
/begin RECORD_LAYOUT KL_SMG_MOT_N_REG_P_K_n_diff_AXIS FIX_NO_AXIS_PTS_X 6 AXIS_PTS_X 0 UBYTE INDEX_INCR DIRECT /end RECORD_LAYOUT
/begin CHARACTERISTIC KL_SMG_MOT_N_REG_P_U "-" CURVE 0x5B4E VALUE_KL_SMG_MOT_N_REG_P_U 100.000000 F00359 0.000000 2.000000
 /begin AXIS_DESCR COM_AXIS n_soll F00109 6 0.000000 10200.000000 AXIS_PTS_REF KL_SMG_MOT_N_REG_P_U_n_soll_AXIS /end AXIS_DESCR
 FUNCTION_LIST smg /end CHARACTERISTIC
/begin RECORD_LAYOUT VALUE_KL_SMG_MOT_N_REG_P_U FNC_VALUES 0 UBYTE ROW_DIR DIRECT /end RECORD_LAYOUT
/begin AXIS_PTS KL_SMG_MOT_N_REG_P_U_n_soll_AXIS "-" 0x5B48 n_soll KL_SMG_MOT_N_REG_P_U_n_soll_AXIS 100.000000 F00109 6 0.000000 10200.000000 /end AXIS_PTS
/begin RECORD_LAYOUT KL_SMG_MOT_N_REG_P_U_n_soll_AXIS FIX_NO_AXIS_PTS_X 6 AXIS_PTS_X 0 UBYTE INDEX_INCR DIRECT /end RECORD_LAYOUT
/begin CHARACTERISTIC KL_SMG_MOT_N_REG_P_D "-" CURVE 0x5B5C VALUE_KL_SMG_MOT_N_REG_P_D 100.000000 F00359 0.000000 2.000000
 /begin AXIS_DESCR COM_AXIS n_soll F00109 6 0.000000 10200.000000 AXIS_PTS_REF KL_SMG_MOT_N_REG_P_D_n_soll_AXIS /end AXIS_DESCR
 FUNCTION_LIST smg /end CHARACTERISTIC
/begin RECORD_LAYOUT VALUE_KL_SMG_MOT_N_REG_P_D FNC_VALUES 0 UBYTE ROW_DIR DIRECT /end RECORD_LAYOUT
/begin AXIS_PTS KL_SMG_MOT_N_REG_P_D_n_soll_AXIS "-" 0x5B56 n_soll KL_SMG_MOT_N_REG_P_D_n_soll_AXIS 100.000000 F00109 6 0.000000 10200.000000 /end AXIS_PTS
/begin RECORD_LAYOUT KL_SMG_MOT_N_REG_P_D_n_soll_AXIS FIX_NO_AXIS_PTS_X 6 AXIS_PTS_X 0 UBYTE INDEX_INCR DIRECT /end RECORD_LAYOUT
/begin CHARACTERISTIC KL_SMG_MOT_N_REG_D_U "-" CURVE 0x5B6A VALUE_KL_SMG_MOT_N_REG_D_U 100.000000 F00187 0.000000 25.000000
 /begin AXIS_DESCR COM_AXIS n_soll F00109 6 0.000000 10200.000000 AXIS_PTS_REF KL_SMG_MOT_N_REG_D_U_n_soll_AXIS /end AXIS_DESCR
 FUNCTION_LIST smg /end CHARACTERISTIC
/begin RECORD_LAYOUT VALUE_KL_SMG_MOT_N_REG_D_U FNC_VALUES 0 UBYTE ROW_DIR DIRECT /end RECORD_LAYOUT
/begin AXIS_PTS KL_SMG_MOT_N_REG_D_U_n_soll_AXIS "-" 0x5B64 n_soll KL_SMG_MOT_N_REG_D_U_n_soll_AXIS 100.000000 F00109 6 0.000000 10200.000000 /end AXIS_PTS
/begin RECORD_LAYOUT KL_SMG_MOT_N_REG_D_U_n_soll_AXIS FIX_NO_AXIS_PTS_X 6 AXIS_PTS_X 0 UBYTE INDEX_INCR DIRECT /end RECORD_LAYOUT
/begin CHARACTERISTIC KL_SMG_MOT_N_REG_D_D "-" CURVE 0x5B78 VALUE_KL_SMG_MOT_N_REG_D_D 100.000000 F00187 0.000000 25.000000
 /begin AXIS_DESCR COM_AXIS n_soll F00109 6 0.000000 10200.000000 AXIS_PTS_REF KL_SMG_MOT_N_REG_D_D_n_soll_AXIS /end AXIS_DESCR
 FUNCTION_LIST smg /end CHARACTERISTIC
/begin RECORD_LAYOUT VALUE_KL_SMG_MOT_N_REG_D_D FNC_VALUES 0 UBYTE ROW_DIR DIRECT /end RECORD_LAYOUT
/begin AXIS_PTS KL_SMG_MOT_N_REG_D_D_n_soll_AXIS "-" 0x5B72 n_soll KL_SMG_MOT_N_REG_D_D_n_soll_AXIS 100.000000 F00109 6 0.000000 10200.000000 /end AXIS_PTS
/begin RECORD_LAYOUT KL_SMG_MOT_N_REG_D_D_n_soll_AXIS FIX_NO_AXIS_PTS_X 6 AXIS_PTS_X 0 UBYTE INDEX_INCR DIRECT /end RECORD_LAYOUT
/begin CHARACTERISTIC KL_SMG_MOT_DN_SOLL "-" CURVE 0x5B8C VALUE_KL_SMG_MOT_DN_SOLL 100.000000 F00142 0.000000 8000.000000
 /begin AXIS_DESCR COM_AXIS n_diff F00007 6 0.000000 65535.000000 AXIS_PTS_REF KL_SMG_MOT_DN_SOLL_n_diff_AXIS /end AXIS_DESCR
 FUNCTION_LIST smg /end CHARACTERISTIC
/begin RECORD_LAYOUT VALUE_KL_SMG_MOT_DN_SOLL FNC_VALUES 0 UWORD ROW_DIR DIRECT /end RECORD_LAYOUT
/begin AXIS_PTS KL_SMG_MOT_DN_SOLL_n_diff_AXIS "-" 0x5B80 n_diff KL_SMG_MOT_DN_SOLL_n_diff_AXIS 100.000000 F00007 6 0.000000 65535.000000 /end AXIS_PTS
/begin RECORD_LAYOUT KL_SMG_MOT_DN_SOLL_n_diff_AXIS FIX_NO_AXIS_PTS_X 6 AXIS_PTS_X 0 UWORD INDEX_INCR DIRECT /end RECORD_LAYOUT
/begin CHARACTERISTIC KL_SMG_MOT_DN_REG_P "-" CURVE 0x5B9E VALUE_KL_SMG_MOT_DN_REG_P 100.000000 F00377 0.000000 0.000000
 /begin AXIS_DESCR COM_AXIS n_diff F00109 4 0.000000 10000.000000 AXIS_PTS_REF KL_SMG_MOT_DN_REG_P_n_diff_AXIS /end AXIS_DESCR
 FUNCTION_LIST smg /end CHARACTERISTIC
/begin RECORD_LAYOUT VALUE_KL_SMG_MOT_DN_REG_P FNC_VALUES 0 UBYTE ROW_DIR DIRECT /end RECORD_LAYOUT
/begin AXIS_PTS KL_SMG_MOT_DN_REG_P_n_diff_AXIS "-" 0x5B9A n_diff KL_SMG_MOT_DN_REG_P_n_diff_AXIS 100.000000 F00109 4 0.000000 10000.000000 /end AXIS_PTS
/begin RECORD_LAYOUT KL_SMG_MOT_DN_REG_P_n_diff_AXIS FIX_NO_AXIS_PTS_X 4 AXIS_PTS_X 0 UBYTE INDEX_INCR DIRECT /end RECORD_LAYOUT
/begin CHARACTERISTIC KL_SMG_MOT_J_MOTOR "-" CURVE 0x5BA7 VALUE_KL_SMG_MOT_J_MOTOR 100.000000 F00349 0.000000 1.000000
 /begin AXIS_DESCR /* n_ziel */ COM_AXIS n_ziel F00109 3 0.000000 10000.000000 AXIS_PTS_REF KL_SMG_MOT_J_MOTOR_n_ziel_AXIS /end AXIS_DESCR
 FUNCTION_LIST smg /end CHARACTERISTIC
/begin RECORD_LAYOUT VALUE_KL_SMG_MOT_J_MOTOR FNC_VALUES 0 UBYTE ROW_DIR DIRECT /end RECORD_LAYOUT
/begin AXIS_PTS KL_SMG_MOT_J_MOTOR_n_ziel_AXIS "-" 0x5BA4 n_ziel KL_SMG_MOT_J_MOTOR_n_ziel_AXIS 100.000000 F00109 3 0.000000 10000.000000 /end AXIS_PTS
/begin RECORD_LAYOUT KL_SMG_MOT_J_MOTOR_n_ziel_AXIS FIX_NO_AXIS_PTS_X 3 AXIS_PTS_X 0 UBYTE INDEX_INCR DIRECT /end RECORD_LAYOUT
/begin CHARACTERISTIC KL_SMG_N_ZIEL_OFF_ZR "-" CURVE 0x5BAF VALUE_KL_SMG_N_ZIEL_OFF_ZR 100.000000 F00378 0.000000 1275.000000
 /begin AXIS_DESCR /* ki */ COM_AXIS ki F00013 3 0.000000 255.000000 AXIS_PTS_REF KL_SMG_N_ZIEL_OFF_ZR_ki_AXIS /end AXIS_DESCR
 FUNCTION_LIST smg /end CHARACTERISTIC
/begin RECORD_LAYOUT VALUE_KL_SMG_N_ZIEL_OFF_ZR FNC_VALUES 0 UBYTE ROW_DIR DIRECT /end RECORD_LAYOUT
/begin AXIS_PTS KL_SMG_N_ZIEL_OFF_ZR_ki_AXIS "-" 0x5BAC ki KL_SMG_N_ZIEL_OFF_ZR_ki_AXIS 100.000000 F00013 3 0.000000 255.000000 /end AXIS_PTS
/begin RECORD_LAYOUT KL_SMG_N_ZIEL_OFF_ZR_ki_AXIS FIX_NO_AXIS_PTS_X 3 AXIS_PTS_X 0 UBYTE INDEX_INCR DIRECT /end RECORD_LAYOUT
/begin CHARACTERISTIC KL_SMG_N_ZIEL_OFF_RA "-" CURVE 0x5BBC VALUE_KL_SMG_N_ZIEL_OFF_RA 100.000000 F00007 0.000000 2000.000000
 /begin AXIS_DESCR COM_AXIS m_k_1 F00145 4 0.000000 6554.000000 AXIS_PTS_REF KL_SMG_N_ZIEL_OFF_RA_m_k_1_AXIS /end AXIS_DESCR
 FUNCTION_LIST smg /end CHARACTERISTIC
/begin RECORD_LAYOUT VALUE_KL_SMG_N_ZIEL_OFF_RA FNC_VALUES 0 UWORD ROW_DIR DIRECT /end RECORD_LAYOUT
/begin AXIS_PTS KL_SMG_N_ZIEL_OFF_RA_m_k_1_AXIS "-" 0x5BB4 m_k_1 KL_SMG_N_ZIEL_OFF_RA_m_k_1_AXIS 100.000000 F00145 4 0.000000 6554.000000 /end AXIS_PTS
/begin RECORD_LAYOUT KL_SMG_N_ZIEL_OFF_RA_m_k_1_AXIS FIX_NO_AXIS_PTS_X 4 AXIS_PTS_X 0 UWORD INDEX_INCR DIRECT /end RECORD_LAYOUT
/begin CHARACTERISTIC KL_SMG_N_ZIEL_OFF_AH "-" CURVE 0x5BC9 VALUE_KL_SMG_N_ZIEL_OFF_AH 100.000000 F00378 0.000000 1275.000000
 /begin AXIS_DESCR COM_AXIS ax F00371 3 0.000000 25.000000 AXIS_PTS_REF KL_SMG_N_ZIEL_OFF_AH_ax_AXIS /end AXIS_DESCR
 FUNCTION_LIST smg /end CHARACTERISTIC
/begin RECORD_LAYOUT VALUE_KL_SMG_N_ZIEL_OFF_AH FNC_VALUES 0 UBYTE ROW_DIR DIRECT /end RECORD_LAYOUT
/begin AXIS_PTS KL_SMG_N_ZIEL_OFF_AH_ax_AXIS "-" 0x5BC6 ax KL_SMG_N_ZIEL_OFF_AH_ax_AXIS 100.000000 F00371 3 0.000000 25.000000 /end AXIS_PTS
/begin RECORD_LAYOUT KL_SMG_N_ZIEL_OFF_AH_ax_AXIS FIX_NO_AXIS_PTS_X 3 AXIS_PTS_X 0 UBYTE INDEX_INCR DIRECT /end RECORD_LAYOUT
/begin CHARACTERISTIC KL_SMG_MOT_M_MAX_AH "-" CURVE 0x5BD1 VALUE_KL_SMG_MOT_M_MAX_AH 100.000000 F00362 0.000000 255.000000
 /begin AXIS_DESCR /* ax_berg */ COM_AXIS ax_berg F00371 3 0.000000 25.000000 AXIS_PTS_REF KL_SMG_MOT_M_MAX_AH_ax_berg_AXIS /end AXIS_DESCR
 FUNCTION_LIST smg /end CHARACTERISTIC
/begin RECORD_LAYOUT VALUE_KL_SMG_MOT_M_MAX_AH FNC_VALUES 0 UBYTE ROW_DIR DIRECT /end RECORD_LAYOUT
/begin AXIS_PTS KL_SMG_MOT_M_MAX_AH_ax_berg_AXIS "-" 0x5BCE ax_berg KL_SMG_MOT_M_MAX_AH_ax_berg_AXIS 100.000000 F00371 3 0.000000 25.000000 /end AXIS_PTS
/begin RECORD_LAYOUT KL_SMG_MOT_M_MAX_AH_ax_berg_AXIS FIX_NO_AXIS_PTS_X 3 AXIS_PTS_X 0 UBYTE INDEX_INCR DIRECT /end RECORD_LAYOUT
/begin CHARACTERISTIC KL_SMG_PROG_MAX_TOEL "-" CURVE 0x5BDA VALUE_KL_SMG_PROG_MAX_TOEL 100.000000 F00379 1.000000 12.000000
 /begin AXIS_DESCR COM_AXIS toel F00014 4 -48.000000 207.000000 AXIS_PTS_REF KL_SMG_PROG_MAX_TOEL_toel_AXIS /end AXIS_DESCR
 FUNCTION_LIST smg /end CHARACTERISTIC
/begin RECORD_LAYOUT VALUE_KL_SMG_PROG_MAX_TOEL FNC_VALUES 0 UBYTE ROW_DIR DIRECT /end RECORD_LAYOUT
/begin AXIS_PTS KL_SMG_PROG_MAX_TOEL_toel_AXIS "-" 0x5BD6 toel KL_SMG_PROG_MAX_TOEL_toel_AXIS 100.000000 F00014 4 -48.000000 207.000000 /end AXIS_PTS
/begin RECORD_LAYOUT KL_SMG_PROG_MAX_TOEL_toel_AXIS FIX_NO_AXIS_PTS_X 4 AXIS_PTS_X 0 UBYTE INDEX_INCR DIRECT /end RECORD_LAYOUT
/begin CHARACTERISTIC KL_SMG_PROG_MIN_BERG "-" CURVE 0x5BE4 VALUE_KL_SMG_PROG_MIN_BERG 100.000000 F00379 1.000000 12.000000
 /begin AXIS_DESCR COM_AXIS ax F00193 4 0.000000 12.000000 AXIS_PTS_REF KL_SMG_PROG_MIN_BERG_ax_AXIS /end AXIS_DESCR
 FUNCTION_LIST smg /end CHARACTERISTIC
/begin RECORD_LAYOUT VALUE_KL_SMG_PROG_MIN_BERG FNC_VALUES 0 UBYTE ROW_DIR DIRECT /end RECORD_LAYOUT
/begin AXIS_PTS KL_SMG_PROG_MIN_BERG_ax_AXIS "-" 0x5BE0 ax KL_SMG_PROG_MIN_BERG_ax_AXIS 100.000000 F00193 4 0.000000 12.000000 /end AXIS_PTS
/begin RECORD_LAYOUT KL_SMG_PROG_MIN_BERG_ax_AXIS FIX_NO_AXIS_PTS_X 4 AXIS_PTS_X 0 UBYTE INDEX_INCR DIRECT /end RECORD_LAYOUT
/begin CHARACTERISTIC KL_SMG_MOT_ANF_M_RAM "-" CURVE 0x5BED VALUE_KL_SMG_MOT_ANF_M_RAM 100.000000 F00181 0.000000 2550.000000
 /begin AXIS_DESCR COM_AXIS FW F00093 3 0.000000 255.000000 AXIS_PTS_REF KL_SMG_MOT_ANF_M_RAM_FW_AXIS /end AXIS_DESCR
 FUNCTION_LIST smg /end CHARACTERISTIC
/begin RECORD_LAYOUT VALUE_KL_SMG_MOT_ANF_M_RAM FNC_VALUES 0 UBYTE ROW_DIR DIRECT /end RECORD_LAYOUT
/begin AXIS_PTS KL_SMG_MOT_ANF_M_RAM_FW_AXIS "-" 0x5BEA FW KL_SMG_MOT_ANF_M_RAM_FW_AXIS 100.000000 F00093 3 0.000000 255.000000 /end AXIS_PTS
/begin RECORD_LAYOUT KL_SMG_MOT_ANF_M_RAM_FW_AXIS FIX_NO_AXIS_PTS_X 3 AXIS_PTS_X 0 UBYTE INDEX_INCR DIRECT /end RECORD_LAYOUT
/begin CHARACTERISTIC KF_SMG_KI_AB_K "-" MAP 0x5C00 VALUE_KF_SMG_KI_AB_K 100.000000 F00031 0.000000 12.000000
 /begin AXIS_DESCR COM_AXIS FW F00093 8 1.000000 255.000000 AXIS_PTS_REF KF_SMG_KI_AB_K_FW_AXIS /end AXIS_DESCR
 /begin AXIS_DESCR COM_AXIS n F00109 6 0.000000 10000.000000 AXIS_PTS_REF KF_SMG_KI_AB_K_n_AXIS /end AXIS_DESCR
 FUNCTION_LIST smg /end CHARACTERISTIC
/begin RECORD_LAYOUT VALUE_KF_SMG_KI_AB_K FNC_VALUES 0 UBYTE ROW_DIR DIRECT /end RECORD_LAYOUT
/begin AXIS_PTS KF_SMG_KI_AB_K_FW_AXIS "-" 0x5BF2 FW KF_SMG_KI_AB_K_FW_AXIS 100.000000 F00093 8 1.000000 255.000000 /end AXIS_PTS
/begin RECORD_LAYOUT KF_SMG_KI_AB_K_FW_AXIS FIX_NO_AXIS_PTS_X 8 AXIS_PTS_X 0 UBYTE INDEX_INCR DIRECT /end RECORD_LAYOUT
/begin AXIS_PTS KF_SMG_KI_AB_K_n_AXIS "-" 0x5BFA n KF_SMG_KI_AB_K_n_AXIS 100.000000 F00109 6 0.000000 10000.000000 /end AXIS_PTS
/begin RECORD_LAYOUT KF_SMG_KI_AB_K_n_AXIS FIX_NO_AXIS_PTS_Y 6 AXIS_PTS_Y 0 UBYTE INDEX_INCR DIRECT /end RECORD_LAYOUT
/begin CHARACTERISTIC KF_SMG_KI_AB_S "-" MAP 0x5C40 VALUE_KF_SMG_KI_AB_S 100.000000 F00031 0.000000 12.000000
 /begin AXIS_DESCR COM_AXIS FW F00093 8 1.000000 255.000000 AXIS_PTS_REF KF_SMG_KI_AB_S_FW_AXIS /end AXIS_DESCR
 /begin AXIS_DESCR COM_AXIS n F00109 6 0.000000 10000.000000 AXIS_PTS_REF KF_SMG_KI_AB_S_n_AXIS /end AXIS_DESCR
 FUNCTION_LIST smg /end CHARACTERISTIC
/begin RECORD_LAYOUT VALUE_KF_SMG_KI_AB_S FNC_VALUES 0 UBYTE ROW_DIR DIRECT /end RECORD_LAYOUT
/begin AXIS_PTS KF_SMG_KI_AB_S_FW_AXIS "-" 0x5C32 FW KF_SMG_KI_AB_S_FW_AXIS 100.000000 F00093 8 1.000000 255.000000 /end AXIS_PTS
/begin RECORD_LAYOUT KF_SMG_KI_AB_S_FW_AXIS FIX_NO_AXIS_PTS_X 8 AXIS_PTS_X 0 UBYTE INDEX_INCR DIRECT /end RECORD_LAYOUT
/begin AXIS_PTS KF_SMG_KI_AB_S_n_AXIS "-" 0x5C3A n KF_SMG_KI_AB_S_n_AXIS 100.000000 F00109 6 0.000000 10000.000000 /end AXIS_PTS
/begin RECORD_LAYOUT KF_SMG_KI_AB_S_n_AXIS FIX_NO_AXIS_PTS_Y 6 AXIS_PTS_Y 0 UBYTE INDEX_INCR DIRECT /end RECORD_LAYOUT
/begin CHARACTERISTIC KF_SMG_KI_SCHA_K "-" MAP 0x5C80 VALUE_KF_SMG_KI_SCHA_K 100.000000 F00031 0.000000 12.000000
 /begin AXIS_DESCR COM_AXIS FW F00093 8 1.000000 255.000000 AXIS_PTS_REF KF_SMG_KI_SCHA_K_FW_AXIS /end AXIS_DESCR
 /begin AXIS_DESCR COM_AXIS n F00109 6 0.000000 10000.000000 AXIS_PTS_REF KF_SMG_KI_SCHA_K_n_AXIS /end AXIS_DESCR
 FUNCTION_LIST smg /end CHARACTERISTIC
/begin RECORD_LAYOUT VALUE_KF_SMG_KI_SCHA_K FNC_VALUES 0 UBYTE ROW_DIR DIRECT /end RECORD_LAYOUT
/begin AXIS_PTS KF_SMG_KI_SCHA_K_FW_AXIS "-" 0x5C72 FW KF_SMG_KI_SCHA_K_FW_AXIS 100.000000 F00093 8 1.000000 255.000000 /end AXIS_PTS
/begin RECORD_LAYOUT KF_SMG_KI_SCHA_K_FW_AXIS FIX_NO_AXIS_PTS_X 8 AXIS_PTS_X 0 UBYTE INDEX_INCR DIRECT /end RECORD_LAYOUT
/begin AXIS_PTS KF_SMG_KI_SCHA_K_n_AXIS "-" 0x5C7A n KF_SMG_KI_SCHA_K_n_AXIS 100.000000 F00109 6 0.000000 10000.000000 /end AXIS_PTS
/begin RECORD_LAYOUT KF_SMG_KI_SCHA_K_n_AXIS FIX_NO_AXIS_PTS_Y 6 AXIS_PTS_Y 0 UBYTE INDEX_INCR DIRECT /end RECORD_LAYOUT
/begin CHARACTERISTIC KF_SMG_KI_SCHA_S "-" MAP 0x5CC0 VALUE_KF_SMG_KI_SCHA_S 100.000000 F00031 0.000000 12.000000
 /begin AXIS_DESCR COM_AXIS FW F00093 8 1.000000 255.000000 AXIS_PTS_REF KF_SMG_KI_SCHA_S_FW_AXIS /end AXIS_DESCR
 /begin AXIS_DESCR COM_AXIS n F00109 6 0.000000 10000.000000 AXIS_PTS_REF KF_SMG_KI_SCHA_S_n_AXIS /end AXIS_DESCR
 FUNCTION_LIST smg /end CHARACTERISTIC
/begin RECORD_LAYOUT VALUE_KF_SMG_KI_SCHA_S FNC_VALUES 0 UBYTE ROW_DIR DIRECT /end RECORD_LAYOUT
/begin AXIS_PTS KF_SMG_KI_SCHA_S_FW_AXIS "-" 0x5CB2 FW KF_SMG_KI_SCHA_S_FW_AXIS 100.000000 F00093 8 1.000000 255.000000 /end AXIS_PTS
/begin RECORD_LAYOUT KF_SMG_KI_SCHA_S_FW_AXIS FIX_NO_AXIS_PTS_X 8 AXIS_PTS_X 0 UBYTE INDEX_INCR DIRECT /end RECORD_LAYOUT
/begin AXIS_PTS KF_SMG_KI_SCHA_S_n_AXIS "-" 0x5CBA n KF_SMG_KI_SCHA_S_n_AXIS 100.000000 F00109 6 0.000000 10000.000000 /end AXIS_PTS
/begin RECORD_LAYOUT KF_SMG_KI_SCHA_S_n_AXIS FIX_NO_AXIS_PTS_Y 6 AXIS_PTS_Y 0 UBYTE INDEX_INCR DIRECT /end RECORD_LAYOUT
/begin CHARACTERISTIC KF_SMG_KI_AUF_K "-" MAP 0x5D00 VALUE_KF_SMG_KI_AUF_K 100.000000 F00031 0.000000 12.000000
 /begin AXIS_DESCR COM_AXIS FW F00093 8 1.000000 255.000000 AXIS_PTS_REF KF_SMG_KI_AUF_K_FW_AXIS /end AXIS_DESCR
 /begin AXIS_DESCR COM_AXIS n F00109 6 0.000000 10000.000000 AXIS_PTS_REF KF_SMG_KI_AUF_K_n_AXIS /end AXIS_DESCR
 FUNCTION_LIST smg /end CHARACTERISTIC
/begin RECORD_LAYOUT VALUE_KF_SMG_KI_AUF_K FNC_VALUES 0 UBYTE ROW_DIR DIRECT /end RECORD_LAYOUT
/begin AXIS_PTS KF_SMG_KI_AUF_K_FW_AXIS "-" 0x5CF2 FW KF_SMG_KI_AUF_K_FW_AXIS 100.000000 F00093 8 1.000000 255.000000 /end AXIS_PTS
/begin RECORD_LAYOUT KF_SMG_KI_AUF_K_FW_AXIS FIX_NO_AXIS_PTS_X 8 AXIS_PTS_X 0 UBYTE INDEX_INCR DIRECT /end RECORD_LAYOUT
/begin AXIS_PTS KF_SMG_KI_AUF_K_n_AXIS "-" 0x5CFA n KF_SMG_KI_AUF_K_n_AXIS 100.000000 F00109 6 0.000000 10000.000000 /end AXIS_PTS
/begin RECORD_LAYOUT KF_SMG_KI_AUF_K_n_AXIS FIX_NO_AXIS_PTS_Y 6 AXIS_PTS_Y 0 UBYTE INDEX_INCR DIRECT /end RECORD_LAYOUT
/begin CHARACTERISTIC KF_SMG_KI_AUF_S "-" MAP 0x5D40 VALUE_KF_SMG_KI_AUF_S 100.000000 F00031 0.000000 12.000000
 /begin AXIS_DESCR COM_AXIS FW F00093 8 1.000000 255.000000 AXIS_PTS_REF KF_SMG_KI_AUF_S_FW_AXIS /end AXIS_DESCR
 /begin AXIS_DESCR COM_AXIS n F00109 6 0.000000 10000.000000 AXIS_PTS_REF KF_SMG_KI_AUF_S_n_AXIS /end AXIS_DESCR
 FUNCTION_LIST smg /end CHARACTERISTIC
/begin RECORD_LAYOUT VALUE_KF_SMG_KI_AUF_S FNC_VALUES 0 UBYTE ROW_DIR DIRECT /end RECORD_LAYOUT
/begin AXIS_PTS KF_SMG_KI_AUF_S_FW_AXIS "-" 0x5D32 FW KF_SMG_KI_AUF_S_FW_AXIS 100.000000 F00093 8 1.000000 255.000000 /end AXIS_PTS
/begin RECORD_LAYOUT KF_SMG_KI_AUF_S_FW_AXIS FIX_NO_AXIS_PTS_X 8 AXIS_PTS_X 0 UBYTE INDEX_INCR DIRECT /end RECORD_LAYOUT
/begin AXIS_PTS KF_SMG_KI_AUF_S_n_AXIS "-" 0x5D3A n KF_SMG_KI_AUF_S_n_AXIS 100.000000 F00109 6 0.000000 10000.000000 /end AXIS_PTS
/begin RECORD_LAYOUT KF_SMG_KI_AUF_S_n_AXIS FIX_NO_AXIS_PTS_Y 6 AXIS_PTS_Y 0 UBYTE INDEX_INCR DIRECT /end RECORD_LAYOUT
/begin CHARACTERISTIC KF_SMG_KI_AB_SCH_K "-" MAP 0x5D7C VALUE_KF_SMG_KI_AB_SCH_K 100.000000 F00031 0.000000 12.000000
 /begin AXIS_DESCR COM_AXIS ax F00380 4 0.000000 -12.000000 AXIS_PTS_REF KF_SMG_KI_AB_SCH_K_ax_AXIS /end AXIS_DESCR
 /begin AXIS_DESCR COM_AXIS n F00109 6 0.000000 10000.000000 AXIS_PTS_REF KF_SMG_KI_AB_SCH_K_n_AXIS /end AXIS_DESCR
 FUNCTION_LIST smg /end CHARACTERISTIC
/begin RECORD_LAYOUT VALUE_KF_SMG_KI_AB_SCH_K FNC_VALUES 0 UBYTE ROW_DIR DIRECT /end RECORD_LAYOUT
/begin AXIS_PTS KF_SMG_KI_AB_SCH_K_ax_AXIS "-" 0x5D72 ax KF_SMG_KI_AB_SCH_K_ax_AXIS 100.000000 F00380 4 0.000000 -12.000000 /end AXIS_PTS
/begin RECORD_LAYOUT KF_SMG_KI_AB_SCH_K_ax_AXIS FIX_NO_AXIS_PTS_X 4 AXIS_PTS_X 0 UBYTE INDEX_INCR DIRECT /end RECORD_LAYOUT
/begin AXIS_PTS KF_SMG_KI_AB_SCH_K_n_AXIS "-" 0x5D76 n KF_SMG_KI_AB_SCH_K_n_AXIS 100.000000 F00109 6 0.000000 10000.000000 /end AXIS_PTS
/begin RECORD_LAYOUT KF_SMG_KI_AB_SCH_K_n_AXIS FIX_NO_AXIS_PTS_Y 6 AXIS_PTS_Y 0 UBYTE INDEX_INCR DIRECT /end RECORD_LAYOUT
/begin CHARACTERISTIC KF_SMG_KI_AB_SCH_S "-" MAP 0x5DA0 VALUE_KF_SMG_KI_AB_SCH_S 100.000000 F00031 0.000000 12.000000
 /begin AXIS_DESCR COM_AXIS ax F00380 4 0.000000 -12.000000 AXIS_PTS_REF KF_SMG_KI_AB_SCH_S_ax_AXIS /end AXIS_DESCR
 /begin AXIS_DESCR COM_AXIS n F00109 6 0.000000 10000.000000 AXIS_PTS_REF KF_SMG_KI_AB_SCH_S_n_AXIS /end AXIS_DESCR
 FUNCTION_LIST smg /end CHARACTERISTIC
/begin RECORD_LAYOUT VALUE_KF_SMG_KI_AB_SCH_S FNC_VALUES 0 UBYTE ROW_DIR DIRECT /end RECORD_LAYOUT
/begin AXIS_PTS KF_SMG_KI_AB_SCH_S_ax_AXIS "-" 0x5D96 ax KF_SMG_KI_AB_SCH_S_ax_AXIS 100.000000 F00380 4 0.000000 -12.000000 /end AXIS_PTS
/begin RECORD_LAYOUT KF_SMG_KI_AB_SCH_S_ax_AXIS FIX_NO_AXIS_PTS_X 4 AXIS_PTS_X 0 UBYTE INDEX_INCR DIRECT /end RECORD_LAYOUT
/begin AXIS_PTS KF_SMG_KI_AB_SCH_S_n_AXIS "-" 0x5D9A n KF_SMG_KI_AB_SCH_S_n_AXIS 100.000000 F00109 6 0.000000 10000.000000 /end AXIS_PTS
/begin RECORD_LAYOUT KF_SMG_KI_AB_SCH_S_n_AXIS FIX_NO_AXIS_PTS_Y 6 AXIS_PTS_Y 0 UBYTE INDEX_INCR DIRECT /end RECORD_LAYOUT
/begin CHARACTERISTIC KF_SMG_KI_SCHA_SCH_K "-" MAP 0x5DC4 VALUE_KF_SMG_KI_SCHA_SCH_K 100.000000 F00031 0.000000 12.000000
 /begin AXIS_DESCR COM_AXIS ax F00380 4 0.000000 -12.000000 AXIS_PTS_REF KF_SMG_KI_SCHA_SCH_K_ax_AXIS /end AXIS_DESCR
 /begin AXIS_DESCR COM_AXIS n F00109 6 0.000000 10000.000000 AXIS_PTS_REF KF_SMG_KI_SCHA_SCH_K_n_AXIS /end AXIS_DESCR
 FUNCTION_LIST smg /end CHARACTERISTIC
/begin RECORD_LAYOUT VALUE_KF_SMG_KI_SCHA_SCH_K FNC_VALUES 0 UBYTE ROW_DIR DIRECT /end RECORD_LAYOUT
/begin AXIS_PTS KF_SMG_KI_SCHA_SCH_K_ax_AXIS "-" 0x5DBA ax KF_SMG_KI_SCHA_SCH_K_ax_AXIS 100.000000 F00380 4 0.000000 -12.000000 /end AXIS_PTS
/begin RECORD_LAYOUT KF_SMG_KI_SCHA_SCH_K_ax_AXIS FIX_NO_AXIS_PTS_X 4 AXIS_PTS_X 0 UBYTE INDEX_INCR DIRECT /end RECORD_LAYOUT
/begin AXIS_PTS KF_SMG_KI_SCHA_SCH_K_n_AXIS "-" 0x5DBE n KF_SMG_KI_SCHA_SCH_K_n_AXIS 100.000000 F00109 6 0.000000 10000.000000 /end AXIS_PTS
/begin RECORD_LAYOUT KF_SMG_KI_SCHA_SCH_K_n_AXIS FIX_NO_AXIS_PTS_Y 6 AXIS_PTS_Y 0 UBYTE INDEX_INCR DIRECT /end RECORD_LAYOUT
/begin CHARACTERISTIC KF_SMG_KI_SCHA_SCH_S "-" MAP 0x5DE8 VALUE_KF_SMG_KI_SCHA_SCH_S 100.000000 F00031 0.000000 12.000000
 /begin AXIS_DESCR COM_AXIS ax F00380 4 0.000000 -12.000000 AXIS_PTS_REF KF_SMG_KI_SCHA_SCH_S_ax_AXIS /end AXIS_DESCR
 /begin AXIS_DESCR COM_AXIS n F00109 6 0.000000 10000.000000 AXIS_PTS_REF KF_SMG_KI_SCHA_SCH_S_n_AXIS /end AXIS_DESCR
 FUNCTION_LIST smg /end CHARACTERISTIC
/begin RECORD_LAYOUT VALUE_KF_SMG_KI_SCHA_SCH_S FNC_VALUES 0 UBYTE ROW_DIR DIRECT /end RECORD_LAYOUT
/begin AXIS_PTS KF_SMG_KI_SCHA_SCH_S_ax_AXIS "-" 0x5DDE ax KF_SMG_KI_SCHA_SCH_S_ax_AXIS 100.000000 F00380 4 0.000000 -12.000000 /end AXIS_PTS
/begin RECORD_LAYOUT KF_SMG_KI_SCHA_SCH_S_ax_AXIS FIX_NO_AXIS_PTS_X 4 AXIS_PTS_X 0 UBYTE INDEX_INCR DIRECT /end RECORD_LAYOUT
/begin AXIS_PTS KF_SMG_KI_SCHA_SCH_S_n_AXIS "-" 0x5DE2 n KF_SMG_KI_SCHA_SCH_S_n_AXIS 100.000000 F00109 6 0.000000 10000.000000 /end AXIS_PTS
/begin RECORD_LAYOUT KF_SMG_KI_SCHA_SCH_S_n_AXIS FIX_NO_AXIS_PTS_Y 6 AXIS_PTS_Y 0 UBYTE INDEX_INCR DIRECT /end RECORD_LAYOUT
/begin CHARACTERISTIC KF_SMG_KI_AUF_SCH_K "-" MAP 0x5E0C VALUE_KF_SMG_KI_AUF_SCH_K 100.000000 F00031 0.000000 12.000000
 /begin AXIS_DESCR COM_AXIS ax F00380 4 0.000000 -12.000000 AXIS_PTS_REF KF_SMG_KI_AUF_SCH_K_ax_AXIS /end AXIS_DESCR
 /begin AXIS_DESCR COM_AXIS n F00109 6 0.000000 10000.000000 AXIS_PTS_REF KF_SMG_KI_AUF_SCH_K_n_AXIS /end AXIS_DESCR
 FUNCTION_LIST smg /end CHARACTERISTIC
/begin RECORD_LAYOUT VALUE_KF_SMG_KI_AUF_SCH_K FNC_VALUES 0 UBYTE ROW_DIR DIRECT /end RECORD_LAYOUT
/begin AXIS_PTS KF_SMG_KI_AUF_SCH_K_ax_AXIS "-" 0x5E02 ax KF_SMG_KI_AUF_SCH_K_ax_AXIS 100.000000 F00380 4 0.000000 -12.000000 /end AXIS_PTS
/begin RECORD_LAYOUT KF_SMG_KI_AUF_SCH_K_ax_AXIS FIX_NO_AXIS_PTS_X 4 AXIS_PTS_X 0 UBYTE INDEX_INCR DIRECT /end RECORD_LAYOUT
/begin AXIS_PTS KF_SMG_KI_AUF_SCH_K_n_AXIS "-" 0x5E06 n KF_SMG_KI_AUF_SCH_K_n_AXIS 100.000000 F00109 6 0.000000 10000.000000 /end AXIS_PTS
/begin RECORD_LAYOUT KF_SMG_KI_AUF_SCH_K_n_AXIS FIX_NO_AXIS_PTS_Y 6 AXIS_PTS_Y 0 UBYTE INDEX_INCR DIRECT /end RECORD_LAYOUT
/begin CHARACTERISTIC KF_SMG_KI_AUF_SCH_S "-" MAP 0x5E30 VALUE_KF_SMG_KI_AUF_SCH_S 100.000000 F00031 0.000000 12.000000
 /begin AXIS_DESCR COM_AXIS ax F00380 4 0.000000 -12.000000 AXIS_PTS_REF KF_SMG_KI_AUF_SCH_S_ax_AXIS /end AXIS_DESCR
 /begin AXIS_DESCR COM_AXIS n F00109 6 0.000000 10000.000000 AXIS_PTS_REF KF_SMG_KI_AUF_SCH_S_n_AXIS /end AXIS_DESCR
 FUNCTION_LIST smg /end CHARACTERISTIC
/begin RECORD_LAYOUT VALUE_KF_SMG_KI_AUF_SCH_S FNC_VALUES 0 UBYTE ROW_DIR DIRECT /end RECORD_LAYOUT
/begin AXIS_PTS KF_SMG_KI_AUF_SCH_S_ax_AXIS "-" 0x5E26 ax KF_SMG_KI_AUF_SCH_S_ax_AXIS 100.000000 F00380 4 0.000000 -12.000000 /end AXIS_PTS
/begin RECORD_LAYOUT KF_SMG_KI_AUF_SCH_S_ax_AXIS FIX_NO_AXIS_PTS_X 4 AXIS_PTS_X 0 UBYTE INDEX_INCR DIRECT /end RECORD_LAYOUT
/begin AXIS_PTS KF_SMG_KI_AUF_SCH_S_n_AXIS "-" 0x5E2A n KF_SMG_KI_AUF_SCH_S_n_AXIS 100.000000 F00109 6 0.000000 10000.000000 /end AXIS_PTS
/begin RECORD_LAYOUT KF_SMG_KI_AUF_SCH_S_n_AXIS FIX_NO_AXIS_PTS_Y 6 AXIS_PTS_Y 0 UBYTE INDEX_INCR DIRECT /end RECORD_LAYOUT
/begin CHARACTERISTIC KF_SMG_T_ABREGEL "-" MAP 0x5E5B VALUE_KF_SMG_T_ABREGEL 100.000000 F00057 10.000000 2450.000000
 /begin AXIS_DESCR COM_AXIS Kennung F00031 12 0.000000 255.000000 AXIS_PTS_REF KF_SMG_T_ABREGEL_Kennung_AXIS /end AXIS_DESCR
 /begin AXIS_DESCR /* Istgang */ COM_AXIS Istgang F00031 5 0.000000 255.000000 AXIS_PTS_REF KF_SMG_T_ABREGEL_Istgang_AXIS /end AXIS_DESCR
 FUNCTION_LIST smg /end CHARACTERISTIC
/begin RECORD_LAYOUT VALUE_KF_SMG_T_ABREGEL FNC_VALUES 0 UBYTE ROW_DIR DIRECT /end RECORD_LAYOUT
/begin AXIS_PTS KF_SMG_T_ABREGEL_Kennung_AXIS "-" 0x5E4A Kennung KF_SMG_T_ABREGEL_Kennung_AXIS 100.000000 F00031 12 0.000000 255.000000 /end AXIS_PTS
/begin RECORD_LAYOUT KF_SMG_T_ABREGEL_Kennung_AXIS FIX_NO_AXIS_PTS_X 12 AXIS_PTS_X 0 UBYTE INDEX_INCR DIRECT /end RECORD_LAYOUT
/begin AXIS_PTS KF_SMG_T_ABREGEL_Istgang_AXIS "-" 0x5E56 Istgang KF_SMG_T_ABREGEL_Istgang_AXIS 100.000000 F00031 5 0.000000 255.000000 /end AXIS_PTS
/begin RECORD_LAYOUT KF_SMG_T_ABREGEL_Istgang_AXIS FIX_NO_AXIS_PTS_Y 5 AXIS_PTS_Y 0 UBYTE INDEX_INCR DIRECT /end RECORD_LAYOUT
/begin CHARACTERISTIC KF_SMG_T_AUFREGEL "-" MAP 0x5EAB VALUE_KF_SMG_T_AUFREGEL 100.000000 F00057 10.000000 2450.000000
 /begin AXIS_DESCR COM_AXIS Kennung F00031 12 0.000000 255.000000 AXIS_PTS_REF KF_SMG_T_AUFREGEL_Kennung_AXIS /end AXIS_DESCR
 /begin AXIS_DESCR /* Istgang */ COM_AXIS Istgang F00031 5 0.000000 255.000000 AXIS_PTS_REF KF_SMG_T_AUFREGEL_Istgang_AXIS /end AXIS_DESCR
 FUNCTION_LIST smg /end CHARACTERISTIC
/begin RECORD_LAYOUT VALUE_KF_SMG_T_AUFREGEL FNC_VALUES 0 UBYTE ROW_DIR DIRECT /end RECORD_LAYOUT
/begin AXIS_PTS KF_SMG_T_AUFREGEL_Kennung_AXIS "-" 0x5E9A Kennung KF_SMG_T_AUFREGEL_Kennung_AXIS 100.000000 F00031 12 0.000000 255.000000 /end AXIS_PTS
/begin RECORD_LAYOUT KF_SMG_T_AUFREGEL_Kennung_AXIS FIX_NO_AXIS_PTS_X 12 AXIS_PTS_X 0 UBYTE INDEX_INCR DIRECT /end RECORD_LAYOUT
/begin AXIS_PTS KF_SMG_T_AUFREGEL_Istgang_AXIS "-" 0x5EA6 Istgang KF_SMG_T_AUFREGEL_Istgang_AXIS 100.000000 F00031 5 0.000000 255.000000 /end AXIS_PTS
/begin RECORD_LAYOUT KF_SMG_T_AUFREGEL_Istgang_AXIS FIX_NO_AXIS_PTS_Y 5 AXIS_PTS_Y 0 UBYTE INDEX_INCR DIRECT /end RECORD_LAYOUT
/begin CHARACTERISTIC KF_SMG_BW_NULL "-" MAP 0x5EF6 VALUE_KF_SMG_BW_NULL 100.000000 F00031 0.000000 15.000000
 /begin AXIS_DESCR /* KI_AB */ COM_AXIS KI_AB F00031 6 1.000000 12.000000 AXIS_PTS_REF KF_SMG_BW_NULL_KI_AB_AXIS /end AXIS_DESCR
 /begin AXIS_DESCR /* KI_SCHA */ COM_AXIS KI_SCHA F00031 6 1.000000 12.000000 AXIS_PTS_REF KF_SMG_BW_NULL_KI_SCHA_AXIS /end AXIS_DESCR
 FUNCTION_LIST smg /end CHARACTERISTIC
/begin RECORD_LAYOUT VALUE_KF_SMG_BW_NULL FNC_VALUES 0 UBYTE ROW_DIR DIRECT /end RECORD_LAYOUT
/begin AXIS_PTS KF_SMG_BW_NULL_KI_AB_AXIS "-" 0x5EEA KI_AB KF_SMG_BW_NULL_KI_AB_AXIS 100.000000 F00031 6 1.000000 12.000000 /end AXIS_PTS
/begin RECORD_LAYOUT KF_SMG_BW_NULL_KI_AB_AXIS FIX_NO_AXIS_PTS_X 6 AXIS_PTS_X 0 UBYTE INDEX_INCR DIRECT /end RECORD_LAYOUT
/begin AXIS_PTS KF_SMG_BW_NULL_KI_SCHA_AXIS "-" 0x5EF0 KI_SCHA KF_SMG_BW_NULL_KI_SCHA_AXIS 100.000000 F00031 6 1.000000 12.000000 /end AXIS_PTS
/begin RECORD_LAYOUT KF_SMG_BW_NULL_KI_SCHA_AXIS FIX_NO_AXIS_PTS_Y 6 AXIS_PTS_Y 0 UBYTE INDEX_INCR DIRECT /end RECORD_LAYOUT
/begin CHARACTERISTIC KF_SMG_N_ZIEL_OFF_K "-" MAP 0x5F26 VALUE_KF_SMG_N_ZIEL_OFF_K 100.000000 F00368 0.000000 100.000000
 /begin AXIS_DESCR COM_AXIS ax F00380 4 0.000000 -12.000000 AXIS_PTS_REF KF_SMG_N_ZIEL_OFF_K_ax_AXIS /end AXIS_DESCR
 /begin AXIS_DESCR COM_AXIS n F00109 6 0.000000 10000.000000 AXIS_PTS_REF KF_SMG_N_ZIEL_OFF_K_n_AXIS /end AXIS_DESCR
 FUNCTION_LIST smg /end CHARACTERISTIC
/begin RECORD_LAYOUT VALUE_KF_SMG_N_ZIEL_OFF_K FNC_VALUES 0 UBYTE ROW_DIR DIRECT /end RECORD_LAYOUT
/begin AXIS_PTS KF_SMG_N_ZIEL_OFF_K_ax_AXIS "-" 0x5F1C ax KF_SMG_N_ZIEL_OFF_K_ax_AXIS 100.000000 F00380 4 0.000000 -12.000000 /end AXIS_PTS
/begin RECORD_LAYOUT KF_SMG_N_ZIEL_OFF_K_ax_AXIS FIX_NO_AXIS_PTS_X 4 AXIS_PTS_X 0 UBYTE INDEX_INCR DIRECT /end RECORD_LAYOUT
/begin AXIS_PTS KF_SMG_N_ZIEL_OFF_K_n_AXIS "-" 0x5F20 n KF_SMG_N_ZIEL_OFF_K_n_AXIS 100.000000 F00109 6 0.000000 10000.000000 /end AXIS_PTS
/begin RECORD_LAYOUT KF_SMG_N_ZIEL_OFF_K_n_AXIS FIX_NO_AXIS_PTS_Y 6 AXIS_PTS_Y 0 UBYTE INDEX_INCR DIRECT /end RECORD_LAYOUT
/begin CHARACTERISTIC KF_SMG_N_ZIEL_OFF_S "-" MAP 0x5F4A VALUE_KF_SMG_N_ZIEL_OFF_S 100.000000 F00368 0.000000 100.000000
 /begin AXIS_DESCR COM_AXIS ax F00380 4 0.000000 -12.000000 AXIS_PTS_REF KF_SMG_N_ZIEL_OFF_S_ax_AXIS /end AXIS_DESCR
 /begin AXIS_DESCR COM_AXIS n F00109 6 0.000000 10000.000000 AXIS_PTS_REF KF_SMG_N_ZIEL_OFF_S_n_AXIS /end AXIS_DESCR
 FUNCTION_LIST smg /end CHARACTERISTIC
/begin RECORD_LAYOUT VALUE_KF_SMG_N_ZIEL_OFF_S FNC_VALUES 0 UBYTE ROW_DIR DIRECT /end RECORD_LAYOUT
/begin AXIS_PTS KF_SMG_N_ZIEL_OFF_S_ax_AXIS "-" 0x5F40 ax KF_SMG_N_ZIEL_OFF_S_ax_AXIS 100.000000 F00380 4 0.000000 -12.000000 /end AXIS_PTS
/begin RECORD_LAYOUT KF_SMG_N_ZIEL_OFF_S_ax_AXIS FIX_NO_AXIS_PTS_X 4 AXIS_PTS_X 0 UBYTE INDEX_INCR DIRECT /end RECORD_LAYOUT
/begin AXIS_PTS KF_SMG_N_ZIEL_OFF_S_n_AXIS "-" 0x5F44 n KF_SMG_N_ZIEL_OFF_S_n_AXIS 100.000000 F00109 6 0.000000 10000.000000 /end AXIS_PTS
/begin RECORD_LAYOUT KF_SMG_N_ZIEL_OFF_S_n_AXIS FIX_NO_AXIS_PTS_Y 6 AXIS_PTS_Y 0 UBYTE INDEX_INCR DIRECT /end RECORD_LAYOUT
/begin CHARACTERISTIC KF_SMG_SK_M_OFF_ST_0 "-" MAP 0x5F70 VALUE_KF_SMG_SK_M_OFF_ST_0 100.000000 F00145 0.000000 1000.000000
 /begin AXIS_DESCR COM_AXIS md_fw F00145 3 0.000000 1000.000000 AXIS_PTS_REF KF_SMG_SK_M_OFF_ST_0_md_fw_AXIS /end AXIS_DESCR
 /begin AXIS_DESCR COM_AXIS n_diff F00007 3 0.000000 10000.000000 AXIS_PTS_REF KF_SMG_SK_M_OFF_ST_0_n_diff_AXIS /end AXIS_DESCR
 FUNCTION_LIST smg /end CHARACTERISTIC
/begin RECORD_LAYOUT VALUE_KF_SMG_SK_M_OFF_ST_0 FNC_VALUES 0 UWORD ROW_DIR DIRECT /end RECORD_LAYOUT
/begin AXIS_PTS KF_SMG_SK_M_OFF_ST_0_md_fw_AXIS "-" 0x5F64 md_fw KF_SMG_SK_M_OFF_ST_0_md_fw_AXIS 100.000000 F00145 3 0.000000 1000.000000 /end AXIS_PTS
/begin RECORD_LAYOUT KF_SMG_SK_M_OFF_ST_0_md_fw_AXIS FIX_NO_AXIS_PTS_X 3 AXIS_PTS_X 0 UWORD INDEX_INCR DIRECT /end RECORD_LAYOUT
/begin AXIS_PTS KF_SMG_SK_M_OFF_ST_0_n_diff_AXIS "-" 0x5F6A n_diff KF_SMG_SK_M_OFF_ST_0_n_diff_AXIS 100.000000 F00007 3 0.000000 10000.000000 /end AXIS_PTS
/begin RECORD_LAYOUT KF_SMG_SK_M_OFF_ST_0_n_diff_AXIS FIX_NO_AXIS_PTS_Y 3 AXIS_PTS_Y 0 UWORD INDEX_INCR DIRECT /end RECORD_LAYOUT
/begin CHARACTERISTIC KL_TE_N_RF "-" CURVE 0x4C04 VALUE_KL_TE_N_RF 100.000000 F00068 0.000000 2.000000
 /begin AXIS_DESCR COM_AXIS n F00007 6 0.000000 10000.000000 AXIS_PTS_REF KL_TE_N_RF_n_AXIS /end AXIS_DESCR
 FUNCTION_LIST Tankentlueftung /end CHARACTERISTIC
/begin RECORD_LAYOUT VALUE_KL_TE_N_RF FNC_VALUES 0 UWORD ROW_DIR DIRECT /end RECORD_LAYOUT
/begin AXIS_PTS KL_TE_N_RF_n_AXIS "-" 0x4BF8 n KL_TE_N_RF_n_AXIS 100.000000 F00007 6 0.000000 10000.000000 /end AXIS_PTS
/begin RECORD_LAYOUT KL_TE_N_RF_n_AXIS FIX_NO_AXIS_PTS_X 6 AXIS_PTS_X 0 UWORD INDEX_INCR DIRECT /end RECORD_LAYOUT
/begin CHARACTERISTIC KL_TE_TVTE_LL "-" CURVE 0x4C18 VALUE_KL_TE_TVTE_LL 100.000000 F00246 0.000000 99.000000
 /begin AXIS_DESCR COM_AXIS ml F00095 3 0.000000 1400.000000 AXIS_PTS_REF KL_TE_TVTE_LL_ml_AXIS /end AXIS_DESCR
 FUNCTION_LIST Tankentlueftung /end CHARACTERISTIC
/begin RECORD_LAYOUT VALUE_KL_TE_TVTE_LL FNC_VALUES 0 UWORD ROW_DIR DIRECT /end RECORD_LAYOUT
/begin AXIS_PTS KL_TE_TVTE_LL_ml_AXIS "-" 0x4C12 ml KL_TE_TVTE_LL_ml_AXIS 100.000000 F00095 3 0.000000 1400.000000 /end AXIS_PTS
/begin RECORD_LAYOUT KL_TE_TVTE_LL_ml_AXIS FIX_NO_AXIS_PTS_X 3 AXIS_PTS_X 0 UWORD INDEX_INCR DIRECT /end RECORD_LAYOUT
/begin CHARACTERISTIC KF_TE_N_RF_TVTE "-" MAP 0x4C40 VALUE_KF_TE_N_RF_TVTE 100.000000 F00397 0.000000 99.000000
 /begin AXIS_DESCR COM_AXIS n F00007 8 0.000000 10000.000000 AXIS_PTS_REF KF_TE_N_RF_TVTE_n_AXIS /end AXIS_DESCR
 /begin AXIS_DESCR COM_AXIS rf F00068 8 0.000000 2.000000 AXIS_PTS_REF KF_TE_N_RF_TVTE_rf_AXIS /end AXIS_DESCR
 FUNCTION_LIST Tankentlueftung /end CHARACTERISTIC
/begin RECORD_LAYOUT VALUE_KF_TE_N_RF_TVTE FNC_VALUES 0 UBYTE ROW_DIR DIRECT /end RECORD_LAYOUT
/begin AXIS_PTS KF_TE_N_RF_TVTE_n_AXIS "-" 0x4C20 n KF_TE_N_RF_TVTE_n_AXIS 100.000000 F00007 8 0.000000 10000.000000 /end AXIS_PTS
/begin RECORD_LAYOUT KF_TE_N_RF_TVTE_n_AXIS FIX_NO_AXIS_PTS_X 8 AXIS_PTS_X 0 UWORD INDEX_INCR DIRECT /end RECORD_LAYOUT
/begin AXIS_PTS KF_TE_N_RF_TVTE_rf_AXIS "-" 0x4C30 rf KF_TE_N_RF_TVTE_rf_AXIS 100.000000 F00068 8 0.000000 2.000000 /end AXIS_PTS
/begin RECORD_LAYOUT KF_TE_N_RF_TVTE_rf_AXIS FIX_NO_AXIS_PTS_Y 8 AXIS_PTS_Y 0 UWORD INDEX_INCR DIRECT /end RECORD_LAYOUT
/begin CHARACTERISTIC KF_TEA_FMIN_N_RF "-" MAP 0x4C92 VALUE_KF_TEA_FMIN_N_RF 100.000000 F00100 0.000000 2.000000
 /begin AXIS_DESCR COM_AXIS n F00007 4 0.000000 10000.000000 AXIS_PTS_REF KF_TEA_FMIN_N_RF_n_AXIS /end AXIS_DESCR
 /begin AXIS_DESCR COM_AXIS rf F00068 4 0.000000 2.000000 AXIS_PTS_REF KF_TEA_FMIN_N_RF_rf_AXIS /end AXIS_DESCR
 FUNCTION_LIST Tankentlueftung /end CHARACTERISTIC
/begin RECORD_LAYOUT VALUE_KF_TEA_FMIN_N_RF FNC_VALUES 0 UWORD ROW_DIR DIRECT /end RECORD_LAYOUT
/begin AXIS_PTS KF_TEA_FMIN_N_RF_n_AXIS "-" 0x4C82 n KF_TEA_FMIN_N_RF_n_AXIS 100.000000 F00007 4 0.000000 10000.000000 /end AXIS_PTS
/begin RECORD_LAYOUT KF_TEA_FMIN_N_RF_n_AXIS FIX_NO_AXIS_PTS_X 4 AXIS_PTS_X 0 UWORD INDEX_INCR DIRECT /end RECORD_LAYOUT
/begin AXIS_PTS KF_TEA_FMIN_N_RF_rf_AXIS "-" 0x4C8A rf KF_TEA_FMIN_N_RF_rf_AXIS 100.000000 F00068 4 0.000000 2.000000 /end AXIS_PTS
/begin RECORD_LAYOUT KF_TEA_FMIN_N_RF_rf_AXIS FIX_NO_AXIS_PTS_Y 4 AXIS_PTS_Y 0 UWORD INDEX_INCR DIRECT /end RECORD_LAYOUT
/begin CHARACTERISTIC KF_TEA_FMIN1_N_RF "-" MAP 0x4CC4 VALUE_KF_TEA_FMIN1_N_RF 100.000000 F00100 0.000000 2.000000
 /begin AXIS_DESCR COM_AXIS n F00007 4 0.000000 10000.000000 AXIS_PTS_REF KF_TEA_FMIN1_N_RF_n_AXIS /end AXIS_DESCR
 /begin AXIS_DESCR COM_AXIS rf F00068 4 0.000000 2.000000 AXIS_PTS_REF KF_TEA_FMIN1_N_RF_rf_AXIS /end AXIS_DESCR
 FUNCTION_LIST Tankentlueftung /end CHARACTERISTIC
/begin RECORD_LAYOUT VALUE_KF_TEA_FMIN1_N_RF FNC_VALUES 0 UWORD ROW_DIR DIRECT /end RECORD_LAYOUT
/begin AXIS_PTS KF_TEA_FMIN1_N_RF_n_AXIS "-" 0x4CB4 n KF_TEA_FMIN1_N_RF_n_AXIS 100.000000 F00007 4 0.000000 10000.000000 /end AXIS_PTS
/begin RECORD_LAYOUT KF_TEA_FMIN1_N_RF_n_AXIS FIX_NO_AXIS_PTS_X 4 AXIS_PTS_X 0 UWORD INDEX_INCR DIRECT /end RECORD_LAYOUT
/begin AXIS_PTS KF_TEA_FMIN1_N_RF_rf_AXIS "-" 0x4CBC rf KF_TEA_FMIN1_N_RF_rf_AXIS 100.000000 F00068 4 0.000000 2.000000 /end AXIS_PTS
/begin RECORD_LAYOUT KF_TEA_FMIN1_N_RF_rf_AXIS FIX_NO_AXIS_PTS_Y 4 AXIS_PTS_Y 0 UWORD INDEX_INCR DIRECT /end RECORD_LAYOUT
/begin CHARACTERISTIC KF_TEA_FSETZ_N_RF "-" MAP 0x4D02 VALUE_KF_TEA_FSETZ_N_RF 100.000000 F00097 0.000000 2.000000
 /begin AXIS_DESCR COM_AXIS n F00007 7 0.000000 10000.000000 AXIS_PTS_REF KF_TEA_FSETZ_N_RF_n_AXIS /end AXIS_DESCR
 /begin AXIS_DESCR COM_AXIS rf F00068 7 0.000000 2.000000 AXIS_PTS_REF KF_TEA_FSETZ_N_RF_rf_AXIS /end AXIS_DESCR
 FUNCTION_LIST Tankentlueftung /end CHARACTERISTIC
/begin RECORD_LAYOUT VALUE_KF_TEA_FSETZ_N_RF FNC_VALUES 0 UWORD ROW_DIR DIRECT /end RECORD_LAYOUT
/begin AXIS_PTS KF_TEA_FSETZ_N_RF_n_AXIS "-" 0x4CE6 n KF_TEA_FSETZ_N_RF_n_AXIS 100.000000 F00007 7 0.000000 10000.000000 /end AXIS_PTS
/begin RECORD_LAYOUT KF_TEA_FSETZ_N_RF_n_AXIS FIX_NO_AXIS_PTS_X 7 AXIS_PTS_X 0 UWORD INDEX_INCR DIRECT /end RECORD_LAYOUT
/begin AXIS_PTS KF_TEA_FSETZ_N_RF_rf_AXIS "-" 0x4CF4 rf KF_TEA_FSETZ_N_RF_rf_AXIS 100.000000 F00068 7 0.000000 2.000000 /end AXIS_PTS
/begin RECORD_LAYOUT KF_TEA_FSETZ_N_RF_rf_AXIS FIX_NO_AXIS_PTS_Y 7 AXIS_PTS_Y 0 UWORD INDEX_INCR DIRECT /end RECORD_LAYOUT
/begin CHARACTERISTIC KL_TI_N_KS "-" CURVE 0x407F VALUE_KL_TI_N_KS 100.000000 F00056 0.000000 1.000000
 /begin AXIS_DESCR COM_AXIS n40 F00109 3 0.000000 10000.000000 AXIS_PTS_REF KL_TI_N_KS_n40_AXIS /end AXIS_DESCR
 FUNCTION_LIST Einspritzung /end CHARACTERISTIC
/begin RECORD_LAYOUT VALUE_KL_TI_N_KS FNC_VALUES 0 UBYTE ROW_DIR DIRECT /end RECORD_LAYOUT
/begin AXIS_PTS KL_TI_N_KS_n40_AXIS "-" 0x407C n40 KL_TI_N_KS_n40_AXIS 100.000000 F00109 3 0.000000 10000.000000 /end AXIS_PTS
/begin RECORD_LAYOUT KL_TI_N_KS_n40_AXIS FIX_NO_AXIS_PTS_X 3 AXIS_PTS_X 0 UBYTE INDEX_INCR DIRECT /end RECORD_LAYOUT
/begin CHARACTERISTIC KL_TI_N_ZWD_LL "-" CURVE 0x408A VALUE_KL_TI_N_ZWD_LL 100.000000 F00056 0.000000 1.000000
 /begin AXIS_DESCR COM_AXIS n40 F00109 6 0.000000 10000.000000 AXIS_PTS_REF KL_TI_N_ZWD_LL_n40_AXIS /end AXIS_DESCR
 FUNCTION_LIST Einspritzung /end CHARACTERISTIC
/begin RECORD_LAYOUT VALUE_KL_TI_N_ZWD_LL FNC_VALUES 0 UBYTE ROW_DIR DIRECT /end RECORD_LAYOUT
/begin AXIS_PTS KL_TI_N_ZWD_LL_n40_AXIS "-" 0x4084 n40 KL_TI_N_ZWD_LL_n40_AXIS 100.000000 F00109 6 0.000000 10000.000000 /end AXIS_PTS
/begin RECORD_LAYOUT KL_TI_N_ZWD_LL_n40_AXIS FIX_NO_AXIS_PTS_X 6 AXIS_PTS_X 0 UBYTE INDEX_INCR DIRECT /end RECORD_LAYOUT
/begin CHARACTERISTIC KL_TI_NO "-" CURVE 0x4098 VALUE_KL_TI_NO 100.000000 F00085 0.000000 64.000000
 /begin AXIS_DESCR /* no-Zaehler */ COM_AXIS no-Zaehler F00411 3 0.000000 65535.000000 AXIS_PTS_REF KL_TI_NO_no-Zaehler_AXIS /end AXIS_DESCR
 FUNCTION_LIST Einspritzung /end CHARACTERISTIC
/begin RECORD_LAYOUT VALUE_KL_TI_NO FNC_VALUES 0 UWORD ROW_DIR DIRECT /end RECORD_LAYOUT
/begin AXIS_PTS KL_TI_NO_no-Zaehler_AXIS "-" 0x4092 no-Zaehler KL_TI_NO_no-Zaehler_AXIS 100.000000 F00411 3 0.000000 65535.000000 /end AXIS_PTS
/begin RECORD_LAYOUT KL_TI_NO_no-Zaehler_AXIS FIX_NO_AXIS_PTS_X 3 AXIS_PTS_X 0 UWORD INDEX_INCR DIRECT /end RECORD_LAYOUT
/begin CHARACTERISTIC KL_TI_NO_VSP "-" CURVE 0x40A8 VALUE_KL_TI_NO_VSP 100.000000 F00085 0.000000 64.000000
 /begin AXIS_DESCR /* no-Zaehler */ COM_AXIS no-Zaehler F00411 4 0.000000 65535.000000 AXIS_PTS_REF KL_TI_NO_VSP_no-Zaehler_AXIS /end AXIS_DESCR
 FUNCTION_LIST Einspritzung /end CHARACTERISTIC
/begin RECORD_LAYOUT VALUE_KL_TI_NO_VSP FNC_VALUES 0 UWORD ROW_DIR DIRECT /end RECORD_LAYOUT
/begin AXIS_PTS KL_TI_NO_VSP_no-Zaehler_AXIS "-" 0x40A0 no-Zaehler KL_TI_NO_VSP_no-Zaehler_AXIS 100.000000 F00411 4 0.000000 65535.000000 /end AXIS_PTS
/begin RECORD_LAYOUT KL_TI_NO_VSP_no-Zaehler_AXIS FIX_NO_AXIS_PTS_X 4 AXIS_PTS_X 0 UWORD INDEX_INCR DIRECT /end RECORD_LAYOUT
/begin CHARACTERISTIC KL_TI_TAN_HS "-" CURVE 0x40BA VALUE_KL_TI_TAN_HS 100.000000 F00085 0.000000 64.000000
 /begin AXIS_DESCR COM_AXIS tan F00014 4 -48.000000 207.000000 AXIS_PTS_REF KL_TI_TAN_HS_tan_AXIS /end AXIS_DESCR
 FUNCTION_LIST Einspritzung /end CHARACTERISTIC
/begin RECORD_LAYOUT VALUE_KL_TI_TAN_HS FNC_VALUES 0 UWORD ROW_DIR DIRECT /end RECORD_LAYOUT
/begin AXIS_PTS KL_TI_TAN_HS_tan_AXIS "-" 0x40B2 tan KL_TI_TAN_HS_tan_AXIS 100.000000 F00014 4 -48.000000 207.000000 /end AXIS_PTS
/begin RECORD_LAYOUT KL_TI_TAN_HS_tan_AXIS FIX_NO_AXIS_PTS_X 4 AXIS_PTS_X 0 UWORD INDEX_INCR DIRECT /end RECORD_LAYOUT
/begin CHARACTERISTIC KL_TI_TAN_NAS "-" CURVE 0x40CC VALUE_KL_TI_TAN_NAS 100.000000 F00085 0.000000 64.000000
 /begin AXIS_DESCR COM_AXIS tan F00014 4 -48.000000 207.000000 AXIS_PTS_REF KL_TI_TAN_NAS_tan_AXIS /end AXIS_DESCR
 FUNCTION_LIST Einspritzung /end CHARACTERISTIC
/begin RECORD_LAYOUT VALUE_KL_TI_TAN_NAS FNC_VALUES 0 UWORD ROW_DIR DIRECT /end RECORD_LAYOUT
/begin AXIS_PTS KL_TI_TAN_NAS_tan_AXIS "-" 0x40C4 tan KL_TI_TAN_NAS_tan_AXIS 100.000000 F00014 4 -48.000000 207.000000 /end AXIS_PTS
/begin RECORD_LAYOUT KL_TI_TAN_NAS_tan_AXIS FIX_NO_AXIS_PTS_X 4 AXIS_PTS_X 0 UWORD INDEX_INCR DIRECT /end RECORD_LAYOUT
/begin CHARACTERISTIC KL_TI_TMOT_B2 "-" CURVE 0x40D8 VALUE_KL_TI_TMOT_B2 100.000000 F00109 0.000000 10000.000000
 /begin AXIS_DESCR COM_AXIS tmot F00014 2 -48.000000 207.000000 AXIS_PTS_REF KL_TI_TMOT_B2_tmot_AXIS /end AXIS_DESCR
 FUNCTION_LIST Einspritzung /end CHARACTERISTIC
/begin RECORD_LAYOUT VALUE_KL_TI_TMOT_B2 FNC_VALUES 0 UBYTE ROW_DIR DIRECT /end RECORD_LAYOUT
/begin AXIS_PTS KL_TI_TMOT_B2_tmot_AXIS "-" 0x40D6 tmot KL_TI_TMOT_B2_tmot_AXIS 100.000000 F00014 2 -48.000000 207.000000 /end AXIS_PTS
/begin RECORD_LAYOUT KL_TI_TMOT_B2_tmot_AXIS FIX_NO_AXIS_PTS_X 2 AXIS_PTS_X 0 UBYTE INDEX_INCR DIRECT /end RECORD_LAYOUT
/begin CHARACTERISTIC KL_TI_TMOT_KS "-" CURVE 0x40EC VALUE_KL_TI_TMOT_KS 100.000000 F00085 0.000000 64.000000
 /begin AXIS_DESCR COM_AXIS tmot F00014 8 -48.000000 207.000000 AXIS_PTS_REF KL_TI_TMOT_KS_tmot_AXIS /end AXIS_DESCR
 FUNCTION_LIST Einspritzung /end CHARACTERISTIC
/begin RECORD_LAYOUT VALUE_KL_TI_TMOT_KS FNC_VALUES 0 UWORD ROW_DIR DIRECT /end RECORD_LAYOUT
/begin AXIS_PTS KL_TI_TMOT_KS_tmot_AXIS "-" 0x40DC tmot KL_TI_TMOT_KS_tmot_AXIS 100.000000 F00014 8 -48.000000 207.000000 /end AXIS_PTS
/begin RECORD_LAYOUT KL_TI_TMOT_KS_tmot_AXIS FIX_NO_AXIS_PTS_X 8 AXIS_PTS_X 0 UWORD INDEX_INCR DIRECT /end RECORD_LAYOUT
/begin CHARACTERISTIC KL_TI_TMOT_NAS "-" CURVE 0x4104 VALUE_KL_TI_TMOT_NAS 100.000000 F00056 0.000000 1.000000
 /begin AXIS_DESCR COM_AXIS tmot F00014 6 -48.000000 207.000000 AXIS_PTS_REF KL_TI_TMOT_NAS_tmot_AXIS /end AXIS_DESCR
 FUNCTION_LIST Einspritzung /end CHARACTERISTIC
/begin RECORD_LAYOUT VALUE_KL_TI_TMOT_NAS FNC_VALUES 0 UBYTE ROW_DIR DIRECT /end RECORD_LAYOUT
/begin AXIS_PTS KL_TI_TMOT_NAS_tmot_AXIS "-" 0x40FE tmot KL_TI_TMOT_NAS_tmot_AXIS 100.000000 F00014 6 -48.000000 207.000000 /end AXIS_PTS
/begin RECORD_LAYOUT KL_TI_TMOT_NAS_tmot_AXIS FIX_NO_AXIS_PTS_X 6 AXIS_PTS_X 0 UBYTE INDEX_INCR DIRECT /end RECORD_LAYOUT
/begin CHARACTERISTIC KL_TI_TMOT_VSP "-" CURVE 0x411C VALUE_KL_TI_TMOT_VSP 100.000000 F00085 0.000000 64.000000
 /begin AXIS_DESCR COM_AXIS tmot F00014 8 -48.000000 207.000000 AXIS_PTS_REF KL_TI_TMOT_VSP_tmot_AXIS /end AXIS_DESCR
 FUNCTION_LIST Einspritzung /end CHARACTERISTIC
/begin RECORD_LAYOUT VALUE_KL_TI_TMOT_VSP FNC_VALUES 0 UWORD ROW_DIR DIRECT /end RECORD_LAYOUT
/begin AXIS_PTS KL_TI_TMOT_VSP_tmot_AXIS "-" 0x410C tmot KL_TI_TMOT_VSP_tmot_AXIS 100.000000 F00014 8 -48.000000 207.000000 /end AXIS_PTS
/begin RECORD_LAYOUT KL_TI_TMOT_VSP_tmot_AXIS FIX_NO_AXIS_PTS_X 8 AXIS_PTS_X 0 UWORD INDEX_INCR DIRECT /end RECORD_LAYOUT
/begin CHARACTERISTIC KL_TI_UB "-" CURVE 0x4138 VALUE_KL_TI_UB 100.000000 F00269 0.000000 65.000000
 /begin AXIS_DESCR COM_AXIS ub F00018 5 0.000000 20.000000 AXIS_PTS_REF KL_TI_UB_ub_AXIS /end AXIS_DESCR
 FUNCTION_LIST Einspritzung /end CHARACTERISTIC
/begin RECORD_LAYOUT VALUE_KL_TI_UB FNC_VALUES 0 UWORD ROW_DIR DIRECT /end RECORD_LAYOUT
/begin AXIS_PTS KL_TI_UB_ub_AXIS "-" 0x412E ub KL_TI_UB_ub_AXIS 100.000000 F00018 5 0.000000 20.000000 /end AXIS_PTS
/begin RECORD_LAYOUT KL_TI_UB_ub_AXIS FIX_NO_AXIS_PTS_X 5 AXIS_PTS_X 0 UWORD INDEX_INCR DIRECT /end RECORD_LAYOUT
/begin CHARACTERISTIC KL_TI_WE_OFF_S "-" CURVE 0x4150 VALUE_KL_TI_WE_OFF_S 100.000000 F00085 0.000000 2.000000
 /begin AXIS_DESCR /* off_time */ COM_AXIS off_time F00412 6 0.000000 4095.000000 AXIS_PTS_REF KL_TI_WE_OFF_S_off_time_AXIS /end AXIS_DESCR
 FUNCTION_LIST Einspritzung /end CHARACTERISTIC
/begin RECORD_LAYOUT VALUE_KL_TI_WE_OFF_S FNC_VALUES 0 UWORD ROW_DIR DIRECT /end RECORD_LAYOUT
/begin AXIS_PTS KL_TI_WE_OFF_S_off_time_AXIS "-" 0x4144 off_time KL_TI_WE_OFF_S_off_time_AXIS 100.000000 F00412 6 0.000000 4095.000000 /end AXIS_PTS
/begin RECORD_LAYOUT KL_TI_WE_OFF_S_off_time_AXIS FIX_NO_AXIS_PTS_X 6 AXIS_PTS_X 0 UWORD INDEX_INCR DIRECT /end RECORD_LAYOUT
/begin CHARACTERISTIC KL_TI_WE_OFF_H "-" CURVE 0x416A VALUE_KL_TI_WE_OFF_H 100.000000 F00085 0.000000 2.000000
 /begin AXIS_DESCR /* off_time */ COM_AXIS off_time F00412 6 0.000000 4095.000000 AXIS_PTS_REF KL_TI_WE_OFF_H_off_time_AXIS /end AXIS_DESCR
 FUNCTION_LIST Einspritzung /end CHARACTERISTIC
/begin RECORD_LAYOUT VALUE_KL_TI_WE_OFF_H FNC_VALUES 0 UWORD ROW_DIR DIRECT /end RECORD_LAYOUT
/begin AXIS_PTS KL_TI_WE_OFF_H_off_time_AXIS "-" 0x415E off_time KL_TI_WE_OFF_H_off_time_AXIS 100.000000 F00412 6 0.000000 4095.000000 /end AXIS_PTS
/begin RECORD_LAYOUT KL_TI_WE_OFF_H_off_time_AXIS FIX_NO_AXIS_PTS_X 6 AXIS_PTS_X 0 UWORD INDEX_INCR DIRECT /end RECORD_LAYOUT
/begin CHARACTERISTIC KL_TI_WE_IGN_S "-" CURVE 0x417E VALUE_KL_TI_WE_IGN_S 100.000000 F00056 0.000000 1.000000
 /begin AXIS_DESCR /* ti_we_ign */ COM_AXIS ti_we_ign F00413 6 0.000000 255.000000 AXIS_PTS_REF KL_TI_WE_IGN_S_ti_we_ign_AXIS /end AXIS_DESCR
 FUNCTION_LIST Einspritzung /end CHARACTERISTIC
/begin RECORD_LAYOUT VALUE_KL_TI_WE_IGN_S FNC_VALUES 0 UBYTE ROW_DIR DIRECT /end RECORD_LAYOUT
/begin AXIS_PTS KL_TI_WE_IGN_S_ti_we_ign_AXIS "-" 0x4178 ti_we_ign KL_TI_WE_IGN_S_ti_we_ign_AXIS 100.000000 F00413 6 0.000000 255.000000 /end AXIS_PTS
/begin RECORD_LAYOUT KL_TI_WE_IGN_S_ti_we_ign_AXIS FIX_NO_AXIS_PTS_X 6 AXIS_PTS_X 0 UBYTE INDEX_INCR DIRECT /end RECORD_LAYOUT
/begin CHARACTERISTIC KL_TI_WE_IGN_H "-" CURVE 0x418C VALUE_KL_TI_WE_IGN_H 100.000000 F00056 0.000000 1.000000
 /begin AXIS_DESCR /* ti_we_ign */ COM_AXIS ti_we_ign F00413 6 0.000000 255.000000 AXIS_PTS_REF KL_TI_WE_IGN_H_ti_we_ign_AXIS /end AXIS_DESCR
 FUNCTION_LIST Einspritzung /end CHARACTERISTIC
/begin RECORD_LAYOUT VALUE_KL_TI_WE_IGN_H FNC_VALUES 0 UBYTE ROW_DIR DIRECT /end RECORD_LAYOUT
/begin AXIS_PTS KL_TI_WE_IGN_H_ti_we_ign_AXIS "-" 0x4186 ti_we_ign KL_TI_WE_IGN_H_ti_we_ign_AXIS 100.000000 F00413 6 0.000000 255.000000 /end AXIS_PTS
/begin RECORD_LAYOUT KL_TI_WE_IGN_H_ti_we_ign_AXIS FIX_NO_AXIS_PTS_X 6 AXIS_PTS_X 0 UBYTE INDEX_INCR DIRECT /end RECORD_LAYOUT
/begin CHARACTERISTIC KL_TIENDE_N "-" CURVE 0x41A2 VALUE_KL_TIENDE_N 100.000000 F00006 0.000000 6553.000000
 /begin AXIS_DESCR COM_AXIS n F00007 7 0.000000 10000.000000 AXIS_PTS_REF KL_TIENDE_N_n_AXIS /end AXIS_DESCR
 FUNCTION_LIST Einspritzung /end CHARACTERISTIC
/begin RECORD_LAYOUT VALUE_KL_TIENDE_N FNC_VALUES 0 UWORD ROW_DIR DIRECT /end RECORD_LAYOUT
/begin AXIS_PTS KL_TIENDE_N_n_AXIS "-" 0x4194 n KL_TIENDE_N_n_AXIS 100.000000 F00007 7 0.000000 10000.000000 /end AXIS_PTS
/begin RECORD_LAYOUT KL_TIENDE_N_n_AXIS FIX_NO_AXIS_PTS_X 7 AXIS_PTS_X 0 UWORD INDEX_INCR DIRECT /end RECORD_LAYOUT
/begin CHARACTERISTIC KL_TIENDE_N_NSP "-" CURVE 0x41C0 VALUE_KL_TIENDE_N_NSP 100.000000 F00006 0.000000 6553.000000
 /begin AXIS_DESCR COM_AXIS n F00007 7 0.000000 10000.000000 AXIS_PTS_REF KL_TIENDE_N_NSP_n_AXIS /end AXIS_DESCR
 FUNCTION_LIST Einspritzung /end CHARACTERISTIC
/begin RECORD_LAYOUT VALUE_KL_TIENDE_N_NSP FNC_VALUES 0 UWORD ROW_DIR DIRECT /end RECORD_LAYOUT
/begin AXIS_PTS KL_TIENDE_N_NSP_n_AXIS "-" 0x41B2 n KL_TIENDE_N_NSP_n_AXIS 100.000000 F00007 7 0.000000 10000.000000 /end AXIS_PTS
/begin RECORD_LAYOUT KL_TIENDE_N_NSP_n_AXIS FIX_NO_AXIS_PTS_X 7 AXIS_PTS_X 0 UWORD INDEX_INCR DIRECT /end RECORD_LAYOUT
/begin CHARACTERISTIC KL_TI_KATS_RF_SCHW_N "-" CURVE 0x41D8 VALUE_KL_TI_KATS_RF_SCHW_N 100.000000 F00068 0.000000 2.000000
 /begin AXIS_DESCR COM_AXIS n F00007 4 0.000000 10000.000000 AXIS_PTS_REF KL_TI_KATS_RF_SCHW_N_n_AXIS /end AXIS_DESCR
 FUNCTION_LIST Einspritzung /end CHARACTERISTIC
/begin RECORD_LAYOUT VALUE_KL_TI_KATS_RF_SCHW_N FNC_VALUES 0 UWORD ROW_DIR DIRECT /end RECORD_LAYOUT
/begin AXIS_PTS KL_TI_KATS_RF_SCHW_N_n_AXIS "-" 0x41D0 n KL_TI_KATS_RF_SCHW_N_n_AXIS 100.000000 F00007 4 0.000000 10000.000000 /end AXIS_PTS
/begin RECORD_LAYOUT KL_TI_KATS_RF_SCHW_N_n_AXIS FIX_NO_AXIS_PTS_X 4 AXIS_PTS_X 0 UWORD INDEX_INCR DIRECT /end RECORD_LAYOUT
/begin CHARACTERISTIC KL_TI_KATS_DELTA_ML "-" CURVE 0x41E6 VALUE_KL_TI_KATS_DELTA_ML 100.000000 F00414 0.000000 0.000000
 /begin AXIS_DESCR COM_AXIS ml F00107 4 0.000000 1400.000000 AXIS_PTS_REF KL_TI_KATS_DELTA_ML_ml_AXIS /end AXIS_DESCR
 FUNCTION_LIST Einspritzung /end CHARACTERISTIC
/begin RECORD_LAYOUT VALUE_KL_TI_KATS_DELTA_ML FNC_VALUES 0 UBYTE ROW_DIR DIRECT /end RECORD_LAYOUT
/begin AXIS_PTS KL_TI_KATS_DELTA_ML_ml_AXIS "-" 0x41E2 ml KL_TI_KATS_DELTA_ML_ml_AXIS 100.000000 F00107 4 0.000000 1400.000000 /end AXIS_PTS
/begin RECORD_LAYOUT KL_TI_KATS_DELTA_ML_ml_AXIS FIX_NO_AXIS_PTS_X 4 AXIS_PTS_X 0 UBYTE INDEX_INCR DIRECT /end RECORD_LAYOUT
/begin CHARACTERISTIC KL_TI_PT_KORR "-" CURVE 0x41F0 VALUE_KL_TI_PT_KORR 100.000000 F00056 0.000000 1.000000
 /begin AXIS_DESCR /* RF_PT_KORR */ COM_AXIS RF_PT_KORR F00056 4 0.000000 1.000000 AXIS_PTS_REF KL_TI_PT_KORR_RF_PT_KORR_AXIS /end AXIS_DESCR
 FUNCTION_LIST Einspritzung /end CHARACTERISTIC
/begin RECORD_LAYOUT VALUE_KL_TI_PT_KORR FNC_VALUES 0 UBYTE ROW_DIR DIRECT /end RECORD_LAYOUT
/begin AXIS_PTS KL_TI_PT_KORR_RF_PT_KORR_AXIS "-" 0x41EC RF_PT_KORR KL_TI_PT_KORR_RF_PT_KORR_AXIS 100.000000 F00056 4 0.000000 1.000000 /end AXIS_PTS
/begin RECORD_LAYOUT KL_TI_PT_KORR_RF_PT_KORR_AXIS FIX_NO_AXIS_PTS_X 4 AXIS_PTS_X 0 UBYTE INDEX_INCR DIRECT /end RECORD_LAYOUT
/begin CHARACTERISTIC KL_TI_TMOT_TAN_OFFS "-" CURVE 0x41FA VALUE_KL_TI_TMOT_TAN_OFFS 100.000000 F00099 0.000000 1.000000
 /begin AXIS_DESCR /* TEMPDIF */ COM_AXIS TEMPDIF F00243 4 0.000000 255.000000 AXIS_PTS_REF KL_TI_TMOT_TAN_OFFS_TEMPDIF_AXIS /end AXIS_DESCR
 FUNCTION_LIST Einspritzung /end CHARACTERISTIC
/begin RECORD_LAYOUT VALUE_KL_TI_TMOT_TAN_OFFS FNC_VALUES 0 UBYTE ROW_DIR DIRECT /end RECORD_LAYOUT
/begin AXIS_PTS KL_TI_TMOT_TAN_OFFS_TEMPDIF_AXIS "-" 0x41F6 TEMPDIF KL_TI_TMOT_TAN_OFFS_TEMPDIF_AXIS 100.000000 F00243 4 0.000000 255.000000 /end AXIS_PTS
/begin RECORD_LAYOUT KL_TI_TMOT_TAN_OFFS_TEMPDIF_AXIS FIX_NO_AXIS_PTS_X 4 AXIS_PTS_X 0 UBYTE INDEX_INCR DIRECT /end RECORD_LAYOUT
/begin CHARACTERISTIC KL_TI_N_VL_ZYL1 "-" CURVE 0x4218 VALUE_KL_TI_N_VL_ZYL1 100.000000 F00056 0.000000 1.000000
 /begin AXIS_DESCR COM_AXIS n F00007 12 0.000000 10000.000000 AXIS_PTS_REF KL_TI_N_VL_ZYL1_n_AXIS /end AXIS_DESCR
 FUNCTION_LIST Einspritzung /end CHARACTERISTIC
/begin RECORD_LAYOUT VALUE_KL_TI_N_VL_ZYL1 FNC_VALUES 0 UWORD ROW_DIR DIRECT /end RECORD_LAYOUT
/begin AXIS_PTS KL_TI_N_VL_ZYL1_n_AXIS "-" 0x4200 n KL_TI_N_VL_ZYL1_n_AXIS 100.000000 F00007 12 0.000000 10000.000000 /end AXIS_PTS
/begin RECORD_LAYOUT KL_TI_N_VL_ZYL1_n_AXIS FIX_NO_AXIS_PTS_X 12 AXIS_PTS_X 0 UWORD INDEX_INCR DIRECT /end RECORD_LAYOUT
/begin CHARACTERISTIC KL_TI_N_VL_ZYL2 "-" CURVE 0x424A VALUE_KL_TI_N_VL_ZYL2 100.000000 F00056 0.000000 1.000000
 /begin AXIS_DESCR COM_AXIS n F00007 12 0.000000 10000.000000 AXIS_PTS_REF KL_TI_N_VL_ZYL2_n_AXIS /end AXIS_DESCR
 FUNCTION_LIST Einspritzung /end CHARACTERISTIC
/begin RECORD_LAYOUT VALUE_KL_TI_N_VL_ZYL2 FNC_VALUES 0 UWORD ROW_DIR DIRECT /end RECORD_LAYOUT
/begin AXIS_PTS KL_TI_N_VL_ZYL2_n_AXIS "-" 0x4232 n KL_TI_N_VL_ZYL2_n_AXIS 100.000000 F00007 12 0.000000 10000.000000 /end AXIS_PTS
/begin RECORD_LAYOUT KL_TI_N_VL_ZYL2_n_AXIS FIX_NO_AXIS_PTS_X 12 AXIS_PTS_X 0 UWORD INDEX_INCR DIRECT /end RECORD_LAYOUT
/begin CHARACTERISTIC KL_TI_N_VL_ZYL3 "-" CURVE 0x427C VALUE_KL_TI_N_VL_ZYL3 100.000000 F00056 0.000000 1.000000
 /begin AXIS_DESCR COM_AXIS n F00007 12 0.000000 10000.000000 AXIS_PTS_REF KL_TI_N_VL_ZYL3_n_AXIS /end AXIS_DESCR
 FUNCTION_LIST Einspritzung /end CHARACTERISTIC
/begin RECORD_LAYOUT VALUE_KL_TI_N_VL_ZYL3 FNC_VALUES 0 UWORD ROW_DIR DIRECT /end RECORD_LAYOUT
/begin AXIS_PTS KL_TI_N_VL_ZYL3_n_AXIS "-" 0x4264 n KL_TI_N_VL_ZYL3_n_AXIS 100.000000 F00007 12 0.000000 10000.000000 /end AXIS_PTS
/begin RECORD_LAYOUT KL_TI_N_VL_ZYL3_n_AXIS FIX_NO_AXIS_PTS_X 12 AXIS_PTS_X 0 UWORD INDEX_INCR DIRECT /end RECORD_LAYOUT
/begin CHARACTERISTIC KL_TI_N_VL_ZYL4 "-" CURVE 0x42AE VALUE_KL_TI_N_VL_ZYL4 100.000000 F00056 0.000000 1.000000
 /begin AXIS_DESCR COM_AXIS n F00007 12 0.000000 10000.000000 AXIS_PTS_REF KL_TI_N_VL_ZYL4_n_AXIS /end AXIS_DESCR
 FUNCTION_LIST Einspritzung /end CHARACTERISTIC
/begin RECORD_LAYOUT VALUE_KL_TI_N_VL_ZYL4 FNC_VALUES 0 UWORD ROW_DIR DIRECT /end RECORD_LAYOUT
/begin AXIS_PTS KL_TI_N_VL_ZYL4_n_AXIS "-" 0x4296 n KL_TI_N_VL_ZYL4_n_AXIS 100.000000 F00007 12 0.000000 10000.000000 /end AXIS_PTS
/begin RECORD_LAYOUT KL_TI_N_VL_ZYL4_n_AXIS FIX_NO_AXIS_PTS_X 12 AXIS_PTS_X 0 UWORD INDEX_INCR DIRECT /end RECORD_LAYOUT
/begin CHARACTERISTIC KL_TI_N_VL_ZYL5 "-" CURVE 0x42E0 VALUE_KL_TI_N_VL_ZYL5 100.000000 F00056 0.000000 1.000000
 /begin AXIS_DESCR COM_AXIS n F00007 12 0.000000 10000.000000 AXIS_PTS_REF KL_TI_N_VL_ZYL5_n_AXIS /end AXIS_DESCR
 FUNCTION_LIST Einspritzung /end CHARACTERISTIC
/begin RECORD_LAYOUT VALUE_KL_TI_N_VL_ZYL5 FNC_VALUES 0 UWORD ROW_DIR DIRECT /end RECORD_LAYOUT
/begin AXIS_PTS KL_TI_N_VL_ZYL5_n_AXIS "-" 0x42C8 n KL_TI_N_VL_ZYL5_n_AXIS 100.000000 F00007 12 0.000000 10000.000000 /end AXIS_PTS
/begin RECORD_LAYOUT KL_TI_N_VL_ZYL5_n_AXIS FIX_NO_AXIS_PTS_X 12 AXIS_PTS_X 0 UWORD INDEX_INCR DIRECT /end RECORD_LAYOUT
/begin CHARACTERISTIC KL_TI_N_VL_ZYL6 "-" CURVE 0x4312 VALUE_KL_TI_N_VL_ZYL6 100.000000 F00056 0.000000 1.000000
 /begin AXIS_DESCR COM_AXIS n F00007 12 0.000000 10000.000000 AXIS_PTS_REF KL_TI_N_VL_ZYL6_n_AXIS /end AXIS_DESCR
 FUNCTION_LIST Einspritzung /end CHARACTERISTIC
/begin RECORD_LAYOUT VALUE_KL_TI_N_VL_ZYL6 FNC_VALUES 0 UWORD ROW_DIR DIRECT /end RECORD_LAYOUT
/begin AXIS_PTS KL_TI_N_VL_ZYL6_n_AXIS "-" 0x42FA n KL_TI_N_VL_ZYL6_n_AXIS 100.000000 F00007 12 0.000000 10000.000000 /end AXIS_PTS
/begin RECORD_LAYOUT KL_TI_N_VL_ZYL6_n_AXIS FIX_NO_AXIS_PTS_X 12 AXIS_PTS_X 0 UWORD INDEX_INCR DIRECT /end RECORD_LAYOUT
/begin CHARACTERISTIC KL_TI_N_VL_ZYL7 "-" CURVE 0x4344 VALUE_KL_TI_N_VL_ZYL7 100.000000 F00056 0.000000 1.000000
 /begin AXIS_DESCR COM_AXIS n F00007 12 0.000000 10000.000000 AXIS_PTS_REF KL_TI_N_VL_ZYL7_n_AXIS /end AXIS_DESCR
 FUNCTION_LIST Einspritzung /end CHARACTERISTIC
/begin RECORD_LAYOUT VALUE_KL_TI_N_VL_ZYL7 FNC_VALUES 0 UWORD ROW_DIR DIRECT /end RECORD_LAYOUT
/begin AXIS_PTS KL_TI_N_VL_ZYL7_n_AXIS "-" 0x432C n KL_TI_N_VL_ZYL7_n_AXIS 100.000000 F00007 12 0.000000 10000.000000 /end AXIS_PTS
/begin RECORD_LAYOUT KL_TI_N_VL_ZYL7_n_AXIS FIX_NO_AXIS_PTS_X 12 AXIS_PTS_X 0 UWORD INDEX_INCR DIRECT /end RECORD_LAYOUT
/begin CHARACTERISTIC KL_TI_N_VL_ZYL8 "-" CURVE 0x4376 VALUE_KL_TI_N_VL_ZYL8 100.000000 F00056 0.000000 1.000000
 /begin AXIS_DESCR COM_AXIS n F00007 12 0.000000 10000.000000 AXIS_PTS_REF KL_TI_N_VL_ZYL8_n_AXIS /end AXIS_DESCR
 FUNCTION_LIST Einspritzung /end CHARACTERISTIC
/begin RECORD_LAYOUT VALUE_KL_TI_N_VL_ZYL8 FNC_VALUES 0 UWORD ROW_DIR DIRECT /end RECORD_LAYOUT
/begin AXIS_PTS KL_TI_N_VL_ZYL8_n_AXIS "-" 0x435E n KL_TI_N_VL_ZYL8_n_AXIS 100.000000 F00007 12 0.000000 10000.000000 /end AXIS_PTS
/begin RECORD_LAYOUT KL_TI_N_VL_ZYL8_n_AXIS FIX_NO_AXIS_PTS_X 12 AXIS_PTS_X 0 UWORD INDEX_INCR DIRECT /end RECORD_LAYOUT
/begin CHARACTERISTIC KL_TI_START_F_P_UMG "-" CURVE 0x4394 VALUE_KL_TI_START_F_P_UMG 100.000000 F00056 0.000000 1.000000
 /begin AXIS_DESCR COM_AXIS p_umg F00104 4 500.000000 1150.000000 AXIS_PTS_REF KL_TI_START_F_P_UMG_p_umg_AXIS /end AXIS_DESCR
 FUNCTION_LIST Einspritzung /end CHARACTERISTIC
/begin RECORD_LAYOUT VALUE_KL_TI_START_F_P_UMG FNC_VALUES 0 UBYTE ROW_DIR DIRECT /end RECORD_LAYOUT
/begin AXIS_PTS KL_TI_START_F_P_UMG_p_umg_AXIS "-" 0x4390 p_umg KL_TI_START_F_P_UMG_p_umg_AXIS 100.000000 F00104 4 500.000000 1150.000000 /end AXIS_PTS
/begin RECORD_LAYOUT KL_TI_START_F_P_UMG_p_umg_AXIS FIX_NO_AXIS_PTS_X 4 AXIS_PTS_X 0 UBYTE INDEX_INCR DIRECT /end RECORD_LAYOUT
/begin CHARACTERISTIC KL_TI_WKS_ML_TMOT "-" CURVE 0x43A2 VALUE_KL_TI_WKS_ML_TMOT 100.000000 F00250 0.000000 65535.000000
 /begin AXIS_DESCR COM_AXIS tmot F00014 4 -48.000000 207.000000 AXIS_PTS_REF KL_TI_WKS_ML_TMOT_tmot_AXIS /end AXIS_DESCR
 FUNCTION_LIST Einspritzung /end CHARACTERISTIC
/begin RECORD_LAYOUT VALUE_KL_TI_WKS_ML_TMOT FNC_VALUES 0 UWORD ROW_DIR DIRECT /end RECORD_LAYOUT
/begin AXIS_PTS KL_TI_WKS_ML_TMOT_tmot_AXIS "-" 0x439A tmot KL_TI_WKS_ML_TMOT_tmot_AXIS 100.000000 F00014 4 -48.000000 207.000000 /end AXIS_PTS
/begin RECORD_LAYOUT KL_TI_WKS_ML_TMOT_tmot_AXIS FIX_NO_AXIS_PTS_X 4 AXIS_PTS_X 0 UWORD INDEX_INCR DIRECT /end RECORD_LAYOUT
/begin CHARACTERISTIC KL_TI_WKS_MS_TMOT "-" CURVE 0x43B0 VALUE_KL_TI_WKS_MS_TMOT 100.000000 F00415 0.000000 255.000000
 /begin AXIS_DESCR COM_AXIS tmot F00014 4 -48.000000 207.000000 AXIS_PTS_REF KL_TI_WKS_MS_TMOT_tmot_AXIS /end AXIS_DESCR
 FUNCTION_LIST Einspritzung /end CHARACTERISTIC
/begin RECORD_LAYOUT VALUE_KL_TI_WKS_MS_TMOT FNC_VALUES 0 UBYTE ROW_DIR DIRECT /end RECORD_LAYOUT
/begin AXIS_PTS KL_TI_WKS_MS_TMOT_tmot_AXIS "-" 0x43AC tmot KL_TI_WKS_MS_TMOT_tmot_AXIS 100.000000 F00014 4 -48.000000 207.000000 /end AXIS_PTS
/begin RECORD_LAYOUT KL_TI_WKS_MS_TMOT_tmot_AXIS FIX_NO_AXIS_PTS_X 4 AXIS_PTS_X 0 UBYTE INDEX_INCR DIRECT /end RECORD_LAYOUT
/begin CHARACTERISTIC KL_N_MAX "-" CURVE 0x43C6 VALUE_KL_N_MAX 100.000000 F00007 0.000000 10000.000000
 /begin AXIS_DESCR COM_AXIS gang F00013 8 0.000000 10.000000 AXIS_PTS_REF KL_N_MAX_gang_AXIS /end AXIS_DESCR
 FUNCTION_LIST Einspritzung /end CHARACTERISTIC
/begin RECORD_LAYOUT VALUE_KL_N_MAX FNC_VALUES 0 UWORD ROW_DIR DIRECT /end RECORD_LAYOUT
/begin AXIS_PTS KL_N_MAX_gang_AXIS "-" 0x43B6 gang KL_N_MAX_gang_AXIS 100.000000 F00013 8 0.000000 10.000000 /end AXIS_PTS
/begin RECORD_LAYOUT KL_N_MAX_gang_AXIS FIX_NO_AXIS_PTS_X 8 AXIS_PTS_X 0 UWORD INDEX_INCR DIRECT /end RECORD_LAYOUT
/begin CHARACTERISTIC KL_N_MAX_SK "-" CURVE 0x43E2 VALUE_KL_N_MAX_SK 100.000000 F00007 0.000000 10000.000000
 /begin AXIS_DESCR /* sk_stufe */ COM_AXIS sk_stufe F00031 5 0.000000 3.000000 AXIS_PTS_REF KL_N_MAX_SK_sk_stufe_AXIS /end AXIS_DESCR
 FUNCTION_LIST Einspritzung /end CHARACTERISTIC
/begin RECORD_LAYOUT VALUE_KL_N_MAX_SK FNC_VALUES 0 UWORD ROW_DIR DIRECT /end RECORD_LAYOUT
/begin AXIS_PTS KL_N_MAX_SK_sk_stufe_AXIS "-" 0x43D8 sk_stufe KL_N_MAX_SK_sk_stufe_AXIS 100.000000 F00031 5 0.000000 3.000000 /end AXIS_PTS
/begin RECORD_LAYOUT KL_N_MAX_SK_sk_stufe_AXIS FIX_NO_AXIS_PTS_X 5 AXIS_PTS_X 0 UWORD INDEX_INCR DIRECT /end RECORD_LAYOUT
/begin COMPU_METHOD F00376 "-*-" FORM "%1.2" "-" FORMULA "(128+x)/128" /end COMPU_METHOD
/begin COMPU_METHOD F00315 "-*-" FORM "%3.2" "msec" FORMULA "(x*10)/512" /end COMPU_METHOD
/begin COMPU_METHOD F00369 "-*-" FORM "%3.1" "%" FORMULA "(x*100)/128" /end COMPU_METHOD
/begin COMPU_METHOD F00372 "-*-" FORM "%3.1" "%FW" FORMULA "(x*100)/128" /end COMPU_METHOD
/begin COMPU_METHOD F00373 "-*-" FORM "%2.0" "%t_END" FORMULA "(x*100)/128" /end COMPU_METHOD
/begin COMPU_METHOD F00397 "-*-" FORM "%2.2" "%" FORMULA "(x*100)/256" /end COMPU_METHOD
/begin COMPU_METHOD F00310 "-*-" FORM "%3.2" "sec" FORMULA "(x*8)/1000" /end COMPU_METHOD
/begin COMPU_METHOD F00328 "-*-" FORM "%2.1" "m/(s*s)" FORMULA "(x-128)/10" /end COMPU_METHOD
/begin COMPU_METHOD F00316 "-*-" FORM "%5.1" "mV" FORMULA "(x-32767)" /end COMPU_METHOD
/begin COMPU_METHOD F00368 "-*-" FORM "%2.1" "%" FORMULA "(x/128)*100" /end COMPU_METHOD
/begin COMPU_METHOD F00414 "-*-" FORM "%1.4" "%/s" FORMULA "(x/8192)*10" /end COMPU_METHOD
/begin COMPU_METHOD F00380 "-*-" FORM "%2.1" "m/(s*s)" FORMULA "-x/10" /end COMPU_METHOD
/begin COMPU_METHOD F00340 "-*-" FORM "%3.0" "us" FORMULA "2*x" /end COMPU_METHOD
/begin COMPU_METHOD F00093 "-*-" FORM "%2.0" "%" FORMULA "x" /end COMPU_METHOD
/begin COMPU_METHOD F00013 "-*-" FORM "%5.0" "-" FORMULA "x" /end COMPU_METHOD
/begin COMPU_METHOD F00411 "-*-" FORM "%5.0" "1/No-Udr" FORMULA "x" /end COMPU_METHOD
/begin COMPU_METHOD F00336 "-*-" FORM "%5.0" "2*U" FORMULA "x" /end COMPU_METHOD
/begin COMPU_METHOD F00413 "-*-" FORM "%3.0" "ign" FORMULA "x" /end COMPU_METHOD
/begin COMPU_METHOD F00004 "-*-" FORM "%3.0" "km/h" FORMULA "x" /end COMPU_METHOD
/begin COMPU_METHOD F00091 "-*-" FORM "%3.0" "l" FORMULA "x" /end COMPU_METHOD
/begin COMPU_METHOD F00415 "-*-" FORM "%3.2" "min." FORMULA "x" /end COMPU_METHOD
/begin COMPU_METHOD F00222 "-*-" FORM "%4.0" "mV" FORMULA "x" /end COMPU_METHOD
/begin COMPU_METHOD F00362 "-*-" FORM "%3.0" "Nm" FORMULA "x" /end COMPU_METHOD
/begin COMPU_METHOD F00379 "-*-" FORM "%2.0" "Prog" FORMULA "x" /end COMPU_METHOD
/begin COMPU_METHOD F00281 "-*-" FORM "%5.0" "qmm" FORMULA "x" /end COMPU_METHOD
/begin COMPU_METHOD F00017 "-*-" FORM "%3.0" "s" FORMULA "x" /end COMPU_METHOD
/begin COMPU_METHOD F00250 "-*-" FORM "%3.0" "sec" FORMULA "x" /end COMPU_METHOD
/begin COMPU_METHOD F00337 "-*-" FORM "%3.0" "Segm." FORMULA "x" /end COMPU_METHOD
/begin COMPU_METHOD F00304 "-*-" FORM "%5.0" "U/min" FORMULA "x" /end COMPU_METHOD
/begin COMPU_METHOD F00007 "-*-" FORM "%4.0" "Upm" FORMULA "x" /end COMPU_METHOD
/begin COMPU_METHOD F00142 "-*-" FORM "%4.0" "Upm/s" FORMULA "x" /end COMPU_METHOD
/begin COMPU_METHOD F00341 "-*-" FORM "%5.0" "us" FORMULA "x" /end COMPU_METHOD
/begin COMPU_METHOD F00243 "-*-" FORM "%3.0" "°C" FORMULA "x" /end COMPU_METHOD
/begin COMPU_METHOD F00011 "-*-" FORM "%2.0" "øKW" FORMULA "x" /end COMPU_METHOD
/begin COMPU_METHOD F00031 "-*-" FORM "%3.2" "-" FORMULA "X" /end COMPU_METHOD
/begin COMPU_METHOD F00216 "-*-" FORM "%3.2" "ms" FORMULA "X" /end COMPU_METHOD
/begin COMPU_METHOD F00347 "-*-" FORM "%4.0" "Upm/s" FORMULA "x*(-40)" /end COMPU_METHOD
/begin COMPU_METHOD F00348 "-*-" FORM "%1.2" "s" FORMULA "x*0.032" /end COMPU_METHOD
/begin COMPU_METHOD F00057 "-*-" FORM "%6.0" "ms" FORMULA "x*10" /end COMPU_METHOD
/begin COMPU_METHOD F00305 "-*-" FORM "%6.0" "msec" FORMULA "x*10" /end COMPU_METHOD
/begin COMPU_METHOD F00181 "-*-" FORM "%4.0" "Nm/s" FORMULA "x*10" /end COMPU_METHOD
/begin COMPU_METHOD F00375 "-*-" FORM "%5.0" "Upm/s" FORMULA "x*100" /end COMPU_METHOD
/begin COMPU_METHOD F00191 "-*-" FORM "%4.1" "%" FORMULA "x*100/1024" /end COMPU_METHOD
/begin COMPU_METHOD F00246 "-*-" FORM "%2.1" "%" FORMULA "x*100/256" /end COMPU_METHOD
/begin COMPU_METHOD F00290 "-*-" FORM "%3.2" "%" FORMULA "x*100/32768" /end COMPU_METHOD
/begin COMPU_METHOD F00292 "-*-" FORM "%2.2" "%/seg" FORMULA "x*100/32768" /end COMPU_METHOD
/begin COMPU_METHOD F00296 "-*-" FORM "%2.2" "%/Seg." FORMULA "x*100/32768" /end COMPU_METHOD
/begin COMPU_METHOD F00312 "-*-" FORM "%1.3" "1/sec" FORMULA "x*100/32768" /end COMPU_METHOD
/begin COMPU_METHOD F00370 "-*-" FORM "%3.0" "-" FORMULA "x*12.8" /end COMPU_METHOD
/begin COMPU_METHOD F00287 "-*-" FORM "%4.0" "øC" FORMULA "x*16-50" /end COMPU_METHOD
/begin COMPU_METHOD F00302 "-*-" FORM "%3.0" "s" FORMULA "x*2" /end COMPU_METHOD
/begin COMPU_METHOD F00104 "-*-" FORM "%4.0" "mbar" FORMULA "x*3+500" /end COMPU_METHOD
/begin COMPU_METHOD F00109 "-*-" FORM "%4.0" "Upm" FORMULA "x*40" /end COMPU_METHOD
/begin COMPU_METHOD F00378 "-*-" FORM "%4.0" "Upm" FORMULA "x*5" /end COMPU_METHOD
/begin COMPU_METHOD F00289 "-*-" FORM "%2.2" "ms/øKW" FORMULA "x*64/1000" /end COMPU_METHOD
/begin COMPU_METHOD F00301 "-*-" FORM "%1.2" "ms" FORMULA "x*64/10000" /end COMPU_METHOD
/begin COMPU_METHOD F00107 "-*-" FORM "%4.0" "kg/h" FORMULA "x*8" /end COMPU_METHOD
/begin COMPU_METHOD F00303 "-*-" FORM "%3.0" "°C" FORMULA "x-48" /end COMPU_METHOD
/begin COMPU_METHOD F00014 "-*-" FORM "%3.0" "øC" FORMULA "x-48" /end COMPU_METHOD
/begin COMPU_METHOD F00048 "-*-" FORM "%3.2" "%" FORMULA "x/10" /end COMPU_METHOD
/begin COMPU_METHOD F00193 "-*-" FORM "%2.1" "m/(s*s)" FORMULA "x/10" /end COMPU_METHOD
/begin COMPU_METHOD F00371 "-*-" FORM "%2.1" "m/s2" FORMULA "x/10" /end COMPU_METHOD
/begin COMPU_METHOD F00145 "-*-" FORM "%2.1" "Nm" FORMULA "x/10" /end COMPU_METHOD
/begin COMPU_METHOD F00339 "-*-" FORM "%3.1" "Nm/Segm" FORMULA "x/10" /end COMPU_METHOD
/begin COMPU_METHOD F00187 "-*-" FORM "%2.2" "Nm/Upm" FORMULA "x/10" /end COMPU_METHOD
/begin COMPU_METHOD F00331 "-*-" FORM "%4.1" "Ohm" FORMULA "x/10" /end COMPU_METHOD
/begin COMPU_METHOD F00028 "-*-" FORM "%2.1" "s" FORMULA "x/10" /end COMPU_METHOD
/begin COMPU_METHOD F00018 "-*-" FORM "%2.1" "V" FORMULA "x/10" /end COMPU_METHOD
/begin COMPU_METHOD F00045 "-*-" FORM "%2.1" "ø" FORMULA "x/10" /end COMPU_METHOD
/begin COMPU_METHOD F00006 "-*-" FORM "%2.1" "øKW" FORMULA "x/10" /end COMPU_METHOD
/begin COMPU_METHOD F00291 "-*-" FORM "%2.1" "øKW/10ms" FORMULA "x/10" /end COMPU_METHOD
/begin COMPU_METHOD F00345 "-*-" FORM "%3.2" "10E-4" FORMULA "x/100" /end COMPU_METHOD
/begin COMPU_METHOD F00359 "-*-" FORM "%1.2" "Nm/Upm" FORMULA "x/100" /end COMPU_METHOD
/begin COMPU_METHOD F00027 "-*-" FORM "%1.1" "s" FORMULA "x/100" /end COMPU_METHOD
/begin COMPU_METHOD F00068 "-*-" FORM "%1.3" "-" FORMULA "x/1000" /end COMPU_METHOD
/begin COMPU_METHOD F00295 "-*-" FORM "%1.3" "1/seg" FORMULA "x/1000" /end COMPU_METHOD
/begin COMPU_METHOD F00269 "-*-" FORM "%2.2" "ms" FORMULA "x/1000" /end COMPU_METHOD
/begin COMPU_METHOD F00377 "-*-" FORM "%1.3" "Nms/Upm" FORMULA "x/1000" /end COMPU_METHOD
/begin COMPU_METHOD F00358 "-*-" FORM "%1.4" "Nms/Upm" FORMULA "x/10000" /end COMPU_METHOD
/begin COMPU_METHOD F00085 "-*-" FORM "%1.3" "-" FORMULA "x/1024" /end COMPU_METHOD
/begin COMPU_METHOD F00056 "-*-" FORM "%1.2" "-" FORMULA "x/128" /end COMPU_METHOD
/begin COMPU_METHOD F00349 "-*-" FORM "%1.2" "Nms2" FORMULA "x/128" /end COMPU_METHOD
/begin COMPU_METHOD F00412 "-*-" FORM "%4.2" "sec" FORMULA "x/16" /end COMPU_METHOD
/begin COMPU_METHOD F00097 "-*-" FORM "%1.4" "-" FORMULA "x/16384" /end COMPU_METHOD
/begin COMPU_METHOD F00374 "-*-" FORM "%2.1" "%M_K" FORMULA "x/2.56" /end COMPU_METHOD
/begin COMPU_METHOD F00116 "-*-" FORM "%1.3" "-" FORMULA "x/200" /end COMPU_METHOD
/begin COMPU_METHOD F00311 "-*-" FORM "%1.3" "-" FORMULA "x/2048" /end COMPU_METHOD
/begin COMPU_METHOD F00285 "-*-" FORM "%3.2" "-" FORMULA "x/255" /end COMPU_METHOD
/begin COMPU_METHOD F00099 "-*-" FORM "%1.2" "-" FORMULA "x/256" /end COMPU_METHOD
/begin COMPU_METHOD F00131 "-*-" FORM "%1.2" "-" FORMULA "x/32" /end COMPU_METHOD
/begin COMPU_METHOD F00100 "-*-" FORM "%1.2" "-" FORMULA "x/32768" /end COMPU_METHOD
/begin COMPU_METHOD F00095 "-*-" FORM "%2.1" "kg/h" FORMULA "x/4" /end COMPU_METHOD
/begin COMPU_METHOD F00338 "-*-" FORM "%1.4" "1/2U" FORMULA "x/4048" /end COMPU_METHOD
/begin COMPU_METHOD F00003 "-*-" FORM "%1.2" "-" FORMULA "x/64" /end COMPU_METHOD
/begin COMPU_METHOD F00327 "-*-" FORM "%2.2" "V" FORMULA "x/640" /end COMPU_METHOD
/begin COMPU_METHOD F00329 "-*-" FORM "%1.3" "%" FORMULA "x/655.36" /end COMPU_METHOD
/end MODULE
